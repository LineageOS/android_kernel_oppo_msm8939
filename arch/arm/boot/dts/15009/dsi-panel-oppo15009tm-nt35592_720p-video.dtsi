/* Copyright (c) 2013, The Linux Foundation. All rights reserved.
 *
 * This program is free software; you can redistribute it and/or modify
 * it under the terms of the GNU General Public License version 2 and
 * only version 2 as published by the Free Software Foundation.
 *
 * This program is distributed in the hope that it will be useful,
 * but WITHOUT ANY WARRANTY; without even the implied warranty of
 * MERCHANTABILITY or FITNESS FOR A PARTICULAR PURPOSE.  See the
 * GNU General Public License for more details.
 */

/*---------------------------------------------------------------------------
 * This file is autogenerated file using gcdb parser. Please do not edit it.
 * Update input XML file to add a new entry or update variable in this file
 * VERSION = "1.0"
 *---------------------------------------------------------------------------*/
&mdss_mdp {
	dsi_oppo15009tm_nt35592_720p_vid: qcom,mdss_dsi_oppo15009tm_nt35592_720p_video {
		qcom,mdss-dsi-panel-name = "oppo15009tm nt35592 720p video mode dsi panel";
		qcom,mdss-dsi-panel-manufacture = "Tianma";
		qcom,mdss-dsi-panel-version = "NT35592";
		qcom,mdss-dsi-panel-controller = <&mdss_dsi0>;
		qcom,mdss-dsi-panel-type = "dsi_video_mode";
		qcom,mdss-dsi-panel-destination = "display_1";
		qcom,mdss-dsi-panel-framerate = <61>;
		qcom,mdss-dsi-virtual-channel-id = <0>;
		qcom,mdss-dsi-stream = <0>;
		qcom,mdss-dsi-panel-width = <720>;
		qcom,mdss-dsi-panel-height = <1280>;
		qcom,mdss-dsi-h-front-porch = <160>;
		qcom,mdss-dsi-h-back-porch = <160>;
		qcom,mdss-dsi-h-pulse-width = <2>;
		qcom,mdss-dsi-h-sync-skew = <0>;
		qcom,mdss-dsi-v-back-porch = <4>;
		qcom,mdss-dsi-v-front-porch = <6>;
		qcom,mdss-dsi-v-pulse-width = <1>;
		qcom,mdss-dsi-h-left-border = <0>;
		qcom,mdss-dsi-h-right-border = <0>;
		qcom,mdss-dsi-v-top-border = <0>;
		qcom,mdss-dsi-v-bottom-border = <0>;
		qcom,mdss-dsi-bpp = <24>;
		qcom,mdss-dsi-color-order = <0>;
		qcom,mdss-dsi-underflow-color = <0xff>;
		qcom,mdss-dsi-border-color = <0>;
		qcom,mdss-dsi-on-command = [29 01 00 00 00 00 02 FF 01
			29 01 00 00 00 00 02 FB 01
			29 01 00 00 00 00 02 75 00
			29 01 00 00 00 00 02 76 9E
			29 01 00 00 00 00 02 77 00
			29 01 00 00 00 00 02 78 B0
			29 01 00 00 00 00 02 79 00
			29 01 00 00 00 00 02 7A C7
			29 01 00 00 00 00 02 7B 00
			29 01 00 00 00 00 02 7C D3
			29 01 00 00 00 00 02 7D 00
			29 01 00 00 00 00 02 7E E5
			29 01 00 00 00 00 02 7F 00
			29 01 00 00 00 00 02 80 EA
			29 01 00 00 00 00 02 81 00
			29 01 00 00 00 00 02 82 F6
			29 01 00 00 00 00 02 83 01
			29 01 00 00 00 00 02 84 03
			29 01 00 00 00 00 02 85 01
			29 01 00 00 00 00 02 86 0E
			29 01 00 00 00 00 02 87 01
			29 01 00 00 00 00 02 88 32
			29 01 00 00 00 00 02 89 01
			29 01 00 00 00 00 02 8A 52
			29 01 00 00 00 00 02 8B 01
			29 01 00 00 00 00 02 8C 83
			29 01 00 00 00 00 02 8D 01
			29 01 00 00 00 00 02 8E AF
			29 01 00 00 00 00 02 8F 01
			29 01 00 00 00 00 02 90 F1
			29 01 00 00 00 00 02 91 02
			29 01 00 00 00 00 02 92 2B
			29 01 00 00 00 00 02 93 02
			29 01 00 00 00 00 02 94 2D
			29 01 00 00 00 00 02 95 02
			29 01 00 00 00 00 02 96 62
			29 01 00 00 00 00 02 97 02
			29 01 00 00 00 00 02 98 9E
			29 01 00 00 00 00 02 99 02
			29 01 00 00 00 00 02 9A C4
			29 01 00 00 00 00 02 9B 02
			29 01 00 00 00 00 02 9C F9
			29 01 00 00 00 00 02 9D 03
			29 01 00 00 00 00 02 9E 1B
			29 01 00 00 00 00 02 9F 03
			29 01 00 00 00 00 02 A0 4A
			29 01 00 00 00 00 02 A2 03
			29 01 00 00 00 00 02 A3 57
			29 01 00 00 00 00 02 A4 03
			29 01 00 00 00 00 02 A5 67
			29 01 00 00 00 00 02 A6 03
			29 01 00 00 00 00 02 A7 79
			29 01 00 00 00 00 02 A9 03
			29 01 00 00 00 00 02 AA 8D
			29 01 00 00 00 00 02 AB 03
			29 01 00 00 00 00 02 AC A4
			29 01 00 00 00 00 02 AD 03
			29 01 00 00 00 00 02 AE BA
			29 01 00 00 00 00 02 AF 03
			29 01 00 00 00 00 02 B0 E1
			29 01 00 00 00 00 02 B1 03
			29 01 00 00 00 00 02 B2 E2
			29 01 00 00 00 00 02 B3 00
			29 01 00 00 00 00 02 B4 9E
			29 01 00 00 00 00 02 B5 00
			29 01 00 00 00 00 02 B6 B0
			29 01 00 00 00 00 02 B7 00
			29 01 00 00 00 00 02 B8 C7
			29 01 00 00 00 00 02 B9 00
			29 01 00 00 00 00 02 BA D3
			29 01 00 00 00 00 02 BB 00
			29 01 00 00 00 00 02 BC E5
			29 01 00 00 00 00 02 BD 00
			29 01 00 00 00 00 02 BE EA
			29 01 00 00 00 00 02 BF 00
			29 01 00 00 00 00 02 C0 F6
			29 01 00 00 00 00 02 C1 01
			29 01 00 00 00 00 02 C2 03
			29 01 00 00 00 00 02 C3 01
			29 01 00 00 00 00 02 C4 0E
			29 01 00 00 00 00 02 C5 01
			29 01 00 00 00 00 02 C6 32
			29 01 00 00 00 00 02 C7 01
			29 01 00 00 00 00 02 C8 52
			29 01 00 00 00 00 02 C9 01
			29 01 00 00 00 00 02 CA 83
			29 01 00 00 00 00 02 CB 01
			29 01 00 00 00 00 02 CC AF
			29 01 00 00 00 00 02 CD 01
			29 01 00 00 00 00 02 CE F1
			29 01 00 00 00 00 02 CF 02
			29 01 00 00 00 00 02 D0 2B
			29 01 00 00 00 00 02 D1 02
			29 01 00 00 00 00 02 D2 2D
			29 01 00 00 00 00 02 D3 02
			29 01 00 00 00 00 02 D4 62
			29 01 00 00 00 00 02 D5 02
			29 01 00 00 00 00 02 D6 9E
			29 01 00 00 00 00 02 D7 02
			29 01 00 00 00 00 02 D8 C4
			29 01 00 00 00 00 02 D9 02
			29 01 00 00 00 00 02 DA F9
			29 01 00 00 00 00 02 DB 03
			29 01 00 00 00 00 02 DC 1B
			29 01 00 00 00 00 02 DD 03
			29 01 00 00 00 00 02 DE 4A
			29 01 00 00 00 00 02 DF 03
			29 01 00 00 00 00 02 E0 57
			29 01 00 00 00 00 02 E1 03
			29 01 00 00 00 00 02 E2 67
			29 01 00 00 00 00 02 E3 03
			29 01 00 00 00 00 02 E4 79
			29 01 00 00 00 00 02 E5 03
			29 01 00 00 00 00 02 E6 8D
			29 01 00 00 00 00 02 E7 03
			29 01 00 00 00 00 02 E8 A4
			29 01 00 00 00 00 02 E9 03
			29 01 00 00 00 00 02 EA BA
			29 01 00 00 00 00 02 EB 03
			29 01 00 00 00 00 02 EC E1
			29 01 00 00 00 00 02 ED 03
			29 01 00 00 00 00 02 EE E2
			29 01 00 00 00 00 02 EF 01
			29 01 00 00 00 00 02 F0 07
			29 01 00 00 00 00 02 F1 01
			29 01 00 00 00 00 02 F2 18
			29 01 00 00 00 00 02 F3 01
			29 01 00 00 00 00 02 F4 24
			29 01 00 00 00 00 02 F5 01
			29 01 00 00 00 00 02 F6 2A
			29 01 00 00 00 00 02 F7 01
			29 01 00 00 00 00 02 F8 35
			29 01 00 00 00 00 02 F9 01
			29 01 00 00 00 00 02 FA 38
			29 01 00 00 00 00 02 FF 02
			29 01 00 00 00 00 02 FB 01
			29 01 00 00 00 00 02 00 01
			29 01 00 00 00 00 02 01 3F
			29 01 00 00 00 00 02 02 01
			29 01 00 00 00 00 02 03 48
			29 01 00 00 00 00 02 04 01
			29 01 00 00 00 00 02 05 4F
			29 01 00 00 00 00 02 06 01
			29 01 00 00 00 00 02 07 68
			29 01 00 00 00 00 02 08 01
			29 01 00 00 00 00 02 09 80
			29 01 00 00 00 00 02 0A 01
			29 01 00 00 00 00 02 0B A6
			29 01 00 00 00 00 02 0C 01
			29 01 00 00 00 00 02 0D CB
			29 01 00 00 00 00 02 0E 02
			29 01 00 00 00 00 02 0F 04
			29 01 00 00 00 00 02 10 02
			29 01 00 00 00 00 02 11 38
			29 01 00 00 00 00 02 12 02
			29 01 00 00 00 00 02 13 3A
			29 01 00 00 00 00 02 14 02
			29 01 00 00 00 00 02 15 6C
			29 01 00 00 00 00 02 16 02
			29 01 00 00 00 00 02 17 A7
			29 01 00 00 00 00 02 18 02
			29 01 00 00 00 00 02 19 CE
			29 01 00 00 00 00 02 1A 03
			29 01 00 00 00 00 02 1B 01
			29 01 00 00 00 00 02 1C 03
			29 01 00 00 00 00 02 1D 24
			29 01 00 00 00 00 02 1E 03
			29 01 00 00 00 00 02 1F 50
			29 01 00 00 00 00 02 20 03
			29 01 00 00 00 00 02 21 5D
			29 01 00 00 00 00 02 22 03
			29 01 00 00 00 00 02 23 6B
			29 01 00 00 00 00 02 24 03
			29 01 00 00 00 00 02 25 7C
			29 01 00 00 00 00 02 26 03
			29 01 00 00 00 00 02 27 8F
			29 01 00 00 00 00 02 28 03
			29 01 00 00 00 00 02 29 A7
			29 01 00 00 00 00 02 2A 03
			29 01 00 00 00 00 02 2B C6
			29 01 00 00 00 00 02 2D 03
			29 01 00 00 00 00 02 2F FB
			29 01 00 00 00 00 02 30 03
			29 01 00 00 00 00 02 31 FC
			29 01 00 00 00 00 02 32 01
			29 01 00 00 00 00 02 33 07
			29 01 00 00 00 00 02 34 01
			29 01 00 00 00 00 02 35 18
			29 01 00 00 00 00 02 36 01
			29 01 00 00 00 00 02 37 24
			29 01 00 00 00 00 02 38 01
			29 01 00 00 00 00 02 39 2A
			29 01 00 00 00 00 02 3A 01
			29 01 00 00 00 00 02 3B 35
			29 01 00 00 00 00 02 3D 01
			29 01 00 00 00 00 02 3F 38
			29 01 00 00 00 00 02 40 01
			29 01 00 00 00 00 02 41 3F
			29 01 00 00 00 00 02 42 01
			29 01 00 00 00 00 02 43 48
			29 01 00 00 00 00 02 44 01
			29 01 00 00 00 00 02 45 4F
			29 01 00 00 00 00 02 46 01
			29 01 00 00 00 00 02 47 68
			29 01 00 00 00 00 02 48 01
			29 01 00 00 00 00 02 49 80
			29 01 00 00 00 00 02 4A 01
			29 01 00 00 00 00 02 4B A6
			29 01 00 00 00 00 02 4C 01
			29 01 00 00 00 00 02 4D CB
			29 01 00 00 00 00 02 4E 02
			29 01 00 00 00 00 02 4F 04
			29 01 00 00 00 00 02 50 02
			29 01 00 00 00 00 02 51 38
			29 01 00 00 00 00 02 52 02
			29 01 00 00 00 00 02 53 3A
			29 01 00 00 00 00 02 54 02
			29 01 00 00 00 00 02 55 6C
			29 01 00 00 00 00 02 56 02
			29 01 00 00 00 00 02 58 A7
			29 01 00 00 00 00 02 59 02
			29 01 00 00 00 00 02 5A CE
			29 01 00 00 00 00 02 5B 03
			29 01 00 00 00 00 02 5C 01
			29 01 00 00 00 00 02 5D 03
			29 01 00 00 00 00 02 5E 24
			29 01 00 00 00 00 02 5F 03
			29 01 00 00 00 00 02 60 50
			29 01 00 00 00 00 02 61 03
			29 01 00 00 00 00 02 62 5D
			29 01 00 00 00 00 02 63 03
			29 01 00 00 00 00 02 64 6B
			29 01 00 00 00 00 02 65 03
			29 01 00 00 00 00 02 66 7C
			29 01 00 00 00 00 02 67 03
			29 01 00 00 00 00 02 68 8F
			29 01 00 00 00 00 02 69 03
			29 01 00 00 00 00 02 6A A7
			29 01 00 00 00 00 02 6B 03
			29 01 00 00 00 00 02 6C C6
			29 01 00 00 00 00 02 6D 03
			29 01 00 00 00 00 02 6E FB
			29 01 00 00 00 00 02 6F 03
			29 01 00 00 00 00 02 70 FC
			29 01 00 00 00 00 02 71 01
			29 01 00 00 00 00 02 72 1E
			29 01 00 00 00 00 02 73 01
			29 01 00 00 00 00 02 74 1F
			29 01 00 00 00 00 02 75 01
			29 01 00 00 00 00 02 76 2A
			29 01 00 00 00 00 02 77 01
			29 01 00 00 00 00 02 78 30
			29 01 00 00 00 00 02 79 01
			29 01 00 00 00 00 02 7A 3A
			29 01 00 00 00 00 02 7B 01
			29 01 00 00 00 00 02 7C 3D
			29 01 00 00 00 00 02 7D 01
			29 01 00 00 00 00 02 7E 44
			29 01 00 00 00 00 02 7F 01
			29 01 00 00 00 00 02 80 4C
			29 01 00 00 00 00 02 81 01
			29 01 00 00 00 00 02 82 53
			29 01 00 00 00 00 02 83 01
			29 01 00 00 00 00 02 84 6B
			29 01 00 00 00 00 02 85 01
			29 01 00 00 00 00 02 86 82
			29 01 00 00 00 00 02 87 01
			29 01 00 00 00 00 02 88 A8
			29 01 00 00 00 00 02 89 01
			29 01 00 00 00 00 02 8A CC
			29 01 00 00 00 00 02 8B 02
			29 01 00 00 00 00 02 8C 05
			29 01 00 00 00 00 02 8D 02
			29 01 00 00 00 00 02 8E 39
			29 01 00 00 00 00 02 8F 02
			29 01 00 00 00 00 02 90 3B
			29 01 00 00 00 00 02 91 02
			29 01 00 00 00 00 02 92 6D
			29 01 00 00 00 00 02 93 02
			29 01 00 00 00 00 02 94 A8
			29 01 00 00 00 00 02 95 02
			29 01 00 00 00 00 02 96 CF
			29 01 00 00 00 00 02 97 03
			29 01 00 00 00 00 02 98 05
			29 01 00 00 00 00 02 99 03
			29 01 00 00 00 00 02 9A 2C
			29 01 00 00 00 00 02 9B 03
			29 01 00 00 00 00 02 9C 68
			29 01 00 00 00 00 02 9D 03
			29 01 00 00 00 00 02 9E 7F
			29 01 00 00 00 00 02 9F 03
			29 01 00 00 00 00 02 A0 AA
			29 01 00 00 00 00 02 A2 03
			29 01 00 00 00 00 02 A3 B9
			29 01 00 00 00 00 02 A4 03
			29 01 00 00 00 00 02 A5 CA
			29 01 00 00 00 00 02 A6 03
			29 01 00 00 00 00 02 A7 D4
			29 01 00 00 00 00 02 A9 03
			29 01 00 00 00 00 02 AA D6
			29 01 00 00 00 00 02 AB 03
			29 01 00 00 00 00 02 AC DD
			29 01 00 00 00 00 02 AD 03
			29 01 00 00 00 00 02 AE DE
			29 01 00 00 00 00 02 AF 01
			29 01 00 00 00 00 02 B0 1E
			29 01 00 00 00 00 02 B1 01
			29 01 00 00 00 00 02 B2 1F
			29 01 00 00 00 00 02 B3 01
			29 01 00 00 00 00 02 B4 2A
			29 01 00 00 00 00 02 B5 01
			29 01 00 00 00 00 02 B6 30
			29 01 00 00 00 00 02 B7 01
			29 01 00 00 00 00 02 B8 3A
			29 01 00 00 00 00 02 B9 01
			29 01 00 00 00 00 02 BA 3D
			29 01 00 00 00 00 02 BB 01
			29 01 00 00 00 00 02 BC 44
			29 01 00 00 00 00 02 BD 01
			29 01 00 00 00 00 02 BE 4C
			29 01 00 00 00 00 02 BF 01
			29 01 00 00 00 00 02 C0 53
			29 01 00 00 00 00 02 C1 01
			29 01 00 00 00 00 02 C2 6B
			29 01 00 00 00 00 02 C3 01
			29 01 00 00 00 00 02 C4 82
			29 01 00 00 00 00 02 C5 01
			29 01 00 00 00 00 02 C6 A8
			29 01 00 00 00 00 02 C7 01
			29 01 00 00 00 00 02 C8 CC
			29 01 00 00 00 00 02 C9 02
			29 01 00 00 00 00 02 CA 05
			29 01 00 00 00 00 02 CB 02
			29 01 00 00 00 00 02 CC 39
			29 01 00 00 00 00 02 CD 02
			29 01 00 00 00 00 02 CE 3B
			29 01 00 00 00 00 02 CF 02
			29 01 00 00 00 00 02 D0 6D
			29 01 00 00 00 00 02 D1 02
			29 01 00 00 00 00 02 D2 A8
			29 01 00 00 00 00 02 D3 02
			29 01 00 00 00 00 02 D4 CF
			29 01 00 00 00 00 02 D5 03
			29 01 00 00 00 00 02 D6 05
			29 01 00 00 00 00 02 D7 03
			29 01 00 00 00 00 02 D8 2C
			29 01 00 00 00 00 02 D9 03
			29 01 00 00 00 00 02 DA 68
			29 01 00 00 00 00 02 DB 03
			29 01 00 00 00 00 02 DC 7F
			29 01 00 00 00 00 02 DD 03
			29 01 00 00 00 00 02 DE AA
			29 01 00 00 00 00 02 DF 03
			29 01 00 00 00 00 02 E0 B9
			29 01 00 00 00 00 02 E1 03
			29 01 00 00 00 00 02 E2 CA
			29 01 00 00 00 00 02 E3 03
			29 01 00 00 00 00 02 E4 D4
			29 01 00 00 00 00 02 E5 03
			29 01 00 00 00 00 02 E6 D6
			29 01 00 00 00 00 02 E7 03
			29 01 00 00 00 00 02 E8 DD
			29 01 00 00 00 00 02 E9 03
			29 01 00 00 00 00 02 EA DE
			29 01 00 00 00 00 02 FF 03
			29 01 00 00 00 00 02 FB 01
			29 01 00 00 00 00 02 68 00
			29 01 00 00 00 00 02 53 77
			29 01 00 00 00 00 02 54 00
			29 01 00 00 00 00 02 56 00
			29 01 00 00 00 00 02 FF 00
			29 01 00 00 00 00 02 FB 01
			29 01 00 00 00 00 02 55 93
            29 01 00 00 00 00 02 51 FF
            29 01 00 00 00 00 02 53 2C
			29 01 00 00 00 00 02 35 00
			15 01 00 00 96 00 02 11 00
			15 01 00 00 40 00 02 29 00];
		qcom,mdss-dsi-off-command = [05 01 00 00 32 00 02 28 00
					05 01 00 00 78 00 02 10 00];
		qcom,mdss-dsi-on-command-state = "dsi_lp_mode";
		qcom,mdss-dsi-off-command-state = "dsi_hs_mode";
		qcom,mdss-dsi-cabc-off-command = [15 01 00 00 10 00 02 55 90
										05 01 00 00 10 00 02 29 00];
		qcom,mdss-dsi-cabc-ui-command = [15 01 00 00 10 00 02 55 B1
										05 01 00 00 10 00 02 29 00];
		qcom,mdss-dsi-cabc-still-image-command = [15 01 00 00 10 00 02 55 B2
												  05 01 00 00 10 00 02 29 00];
		qcom,mdss-dsi-cabc-video-command = [15 01 00 00 10 00 02 55 93
										    05 01 00 00 10 00 02 29 00];
		qcom,mdss-dsi-panel-status-command = [06 01 00 01 05 00 02 0A 08];
		qcom,mdss-dsi-panel-status-command-state = "dsi_lp_mode";
		qcom,mdss-dsi-panel-status-check-mode = "reg_read";
		qcom,mdss-dsi-panel-status-value = <0x9C>;
		qcom,mdss-dsi-tx-eot-append;
		qcom,mdss-dsi-h-sync-pulse = <1>;
		qcom,mdss-dsi-traffic-mode = "burst_mode";
		qcom,mdss-dsi-lane-map = <0>;
		qcom,mdss-dsi-bllp-eof-power-mode;
		qcom,mdss-dsi-bllp-power-mode;
		qcom,mdss-dsi-hfp-power-mode;
		qcom,mdss-dsi-hbp-power-mode;
		qcom,mdss-dsi-hsa-power-mode;
		qcom,mdss-dsi-lane-0-state;
		qcom,mdss-dsi-lane-1-state;
		qcom,mdss-dsi-lane-2-state;
		qcom,mdss-dsi-lane-3-state;
	//	qcom,mdss-dsi-panel-timings = [7d 25 1d 00 37 33 22 27 1e 03 04 00];
		qcom,mdss-dsi-panel-timings = [8B 1E 14 00 44 48 18 22 19 03 04 00];
		qcom,mdss-dsi-t-clk-post = <0x04>; /* 0x20->0x04 */
		qcom,mdss-dsi-t-clk-pre = <0x1c>;  /* 0x2c->0x1c */
		qcom,mdss-dsi-bl-min-level = <1>;
		qcom,mdss-dsi-bl-max-level = <255>;
		qcom,mdss-dsi-dma-trigger = <4>;
		qcom,mdss-dsi-mdp-trigger = <0>;
		qcom,mdss-dsi-bl-pmic-control-type = "bl_ctrl_wled";
		qcom,mdss-dsi-reset-sequence = <1 10>, <0 1>, <1 15>;
		qcom,mdss-pan-physical-width-dimension = <62>;
		qcom,mdss-pan-physical-height-dimension = <110>;

	};
};