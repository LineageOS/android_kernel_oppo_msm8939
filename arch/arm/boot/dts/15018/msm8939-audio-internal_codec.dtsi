/* Copyright (c) 2014, The Linux Foundation. All rights reserved.
 *
 * This program is free software; you can redistribute it and/or modify
 * it under the terms of the GNU General Public License version 2 and
 * only version 2 as published by the Free Software Foundation.
 *
 * This program is distributed in the hope that it will be useful,
 * but WITHOUT ANY WARRANTY; without even the implied warranty of
 * MERCHANTABILITY or FITNESS FOR A PARTICULAR PURPOSE.  See the
 * GNU General Public License for more details.
 */

&soc {
	/*OPPO 2014-08-30 zhzhyon Add for sound card*/
	sound {
		compatible = "qcom,msm8x16-audio-codec";
		qcom,model = "msm8939-snd-card-mtp";
		/*OPPO 2014-08-21 zhzhyon Modify from 0 to 3*/
		qcom,msm-snd-card-id = <3>;
		qcom,msm-codec-type = "internal";
		/*OPPO 2014-07-21 zhzhyon Modify for QUAT I2S PATCH*/
		/*qcom,msm-ext-pa = "primary";*/
		qcom,msm-ext-pa = "secondary", "quaternary";
		/*OPPO 2014-07-21 zhzhyon Modify end*/
		qcom,msm-mbhc-hphl-swh = <1>;
		qcom,msm-mbhc-gnd-swh = <0>;
		qcom,msm-micbias1-ext-cap;
//#ifndef VENDOR_EDIT //Jianfeng.Qiu@Multimedia.Audio, 2015/05/18, Modify for headset use external micbias
		//qcom,msm-hs-micbias-type = "internal";
//#else
		qcom,msm-hs-micbias-type = "external";
		qcom,msm-micbias2-ext-cap; //Add for headset use external capacitor mode
//#endif /* VENDOR_EDIT */
		qcom,audio-routing =
			"RX_BIAS", "MCLK",
			"SPK_RX_BIAS", "MCLK",
			"INT_LDO_H", "MCLK",
			"MIC BIAS External", "Handset Mic",
//#ifndef VENDOR_EDIT //Jianfeng.Qiu@Multimedia.Audio, 2015/05/18, Modify for headset use external micbias
			//"MIC BIAS Internal2", "Headset Mic",
//#else
			"MIC BIAS External2", "Headset Mic",
//#endif /* VENDOR_EDIT */
			"MIC BIAS External", "Secondary Mic",
			"AMIC1", "MIC BIAS External",
//#ifndef VENDOR_EDIT //Jianfeng.Qiu@Multimedia.Audio, 2015/05/18, Modify for headset use external micbias
			//"AMIC2", "MIC BIAS Internal2",
//#else
			"AMIC2", "MIC BIAS External2",
//#endif /* VENDOR_EDIT */
			"AMIC3", "MIC BIAS External",
			/*OPPO 2014-07-30 zhzhyon Add for DMIC*/
			"DMIC1", "MIC BIAS Internal1",
			"MIC BIAS Internal1", "Digital Mic1",
			"DMIC2", "MIC BIAS Internal1",
			"MIC BIAS Internal1", "Digital Mic2";
			/*OPPO 2014-07-30 zhzhyon Add end*/
		pinctrl-names = "cdc_lines_act",
				"cdc_lines_sus",
				/*OPPO 2014-07-21 zhzhyon Modify for QUAT I2S patch*/
				/*"cross_conn_det_act",*/
				/*"cross_conn_det_sus";*/
				"cdc_lines_quat_sec_ext_act",
				"cdc_lines_quat_sec_ext_sus";
				/*OPPO 2014-07-21 zhzhyon Modify end*/
		pinctrl-0 = <&cdc_pdm_lines_act>;
		pinctrl-1 = <&cdc_pdm_lines_sus>;
		/*OPPO 2014-07-21 zhzhyon Modify for QUAT I2S patch*/
		/*pinctrl-2 = <&cross_conn_det_act>;*/
		/*pinctrl-3 = <&cross_conn_det_sus>;*/
//#ifndef VENDOR_EDIT //Jianfeng.Qiu@Multimedia.Audio, 2015/07/15, Modify for remove mclk
		/*
		pinctrl-2 = <&cdc_pdm_lines_act &cdc_ext_pa_act
						&cdc_ext_pa_ws_act &ext_cdc_tlmm_lines_act
						&mclk_lines_act>;
		pinctrl-3 = <&cdc_pdm_lines_sus &cdc_ext_pa_sus
						&cdc_ext_pa_ws_sus &ext_cdc_tlmm_lines_sus
						&mclk_lines_sus>;
		*/
//#else
		pinctrl-2 = <&cdc_pdm_lines_act &cdc_ext_pa_act
						&cdc_ext_pa_ws_act &ext_cdc_tlmm_lines_act>;
		pinctrl-3 = <&cdc_pdm_lines_sus &cdc_ext_pa_sus
						&cdc_ext_pa_ws_sus &ext_cdc_tlmm_lines_sus>;
//#endif /* VENDOR_EDIT */
		/*OPPO 2014-07-21 zhzhyon Modify end*/
//#ifndef VENDOR_EDIT //Jianfeng.Qiu@Multimedia.Audio, 2015/06/11, Delete for unuse
		//qcom,cdc-us-euro-gpios = <&msm_gpio 120 0>;
//#endif /* VENDOR_EDIT */
		/*OPPO 2014-07-21 zhzhyon Add for tfa9890 resource*/
		nxp,reset-gpio = <&msm_gpio 16 0x00>;
		audio-vdd-enable-gpios = <&msm_gpio 102 0x00>;
		/*spk-rec-sw-gpios = <&msm_gpio 97 0x00>;*/
		/*OPPO 2014-07-21 zhzhyon Add end*/
		/*OPPO 2014-08-20 zhzhyon Add for tfa9890*/
		tfa9890_vdd-supply = <&pm8916_l6>;
		/*OPPO 2014-08-20 zhzhyon Add end*/
		asoc-platform = <&pcm0>, <&pcm1>, <&voip>, <&voice>,
				<&loopback>, <&compress>, <&hostless>,
				<&afe>, <&lsm>, <&routing>, <&lpa>;
		asoc-platform-names = "msm-pcm-dsp.0", "msm-pcm-dsp.1",
				"msm-voip-dsp", "msm-pcm-voice", "msm-pcm-loopback",
				"msm-compress-dsp", "msm-pcm-hostless", "msm-pcm-afe",
				"msm-lsm-client", "msm-pcm-routing", "msm-pcm-lpa";
		asoc-cpu = <&dai_hdmi>, <&dai_mi2s0>, <&dai_mi2s1>,
				<&dai_mi2s2>, <&dai_mi2s3>, <&sb_0_rx>, <&sb_0_tx>,
				<&sb_1_rx>, <&sb_1_tx>, <&sb_3_rx>, <&sb_3_tx>,
				<&sb_4_rx>, <&sb_4_tx>, <&sb_5_tx>, <&bt_sco_rx>,
				<&bt_sco_tx>, <&int_fm_rx>, <&int_fm_tx>, <&afe_pcm_rx>,
				<&afe_pcm_tx>, <&afe_proxy_rx>, <&afe_proxy_tx>,
				<&incall_record_rx>, <&incall_record_tx>, <&incall_music_rx>,
				<&incall_music_2_rx>;
		asoc-cpu-names = "msm-dai-q6-hdmi.8", "msm-dai-q6-mi2s.0",
				"msm-dai-q6-mi2s.1", "msm-dai-q6-mi2s.2",
				"msm-dai-q6-mi2s.3", "msm-dai-q6-dev.16384",
				"msm-dai-q6-dev.16385", "msm-dai-q6-dev.16386",
				"msm-dai-q6-dev.16387", "msm-dai-q6-dev.16390",
				"msm-dai-q6-dev.16391", "msm-dai-q6-dev.16392",
				"msm-dai-q6-dev.16393", "msm-dai-q6-dev.16395",
				"msm-dai-q6-dev.12288", "msm-dai-q6-dev.12289",
				"msm-dai-q6-dev.12292", "msm-dai-q6-dev.12293",
				"msm-dai-q6-dev.224", "msm-dai-q6-dev.225",
				"msm-dai-q6-dev.241", "msm-dai-q6-dev.240",
				"msm-dai-q6-dev.32771", "msm-dai-q6-dev.32772",
				"msm-dai-q6-dev.32773", "msm-dai-q6-dev.32770";
		asoc-codec = <&stub_codec>, <&pm8916_tombak_dig>;
		asoc-codec-names = "msm-stub-codec.1", "tombak_codec";
	};
	/*OPPO 2014-08-30 zhzhyon Add end*/
};

