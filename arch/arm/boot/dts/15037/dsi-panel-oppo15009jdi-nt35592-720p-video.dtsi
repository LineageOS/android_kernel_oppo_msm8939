/* Copyright (c) 2013, The Linux Foundation. All rights reserved.
 *
 * This program is free software; you can redistribute it and/or modify
 * it under the terms of the GNU General Public License version 2 and
 * only version 2 as published by the Free Software Foundation.
 *
 * This program is distributed in the hope that it will be useful,
 * but WITHOUT ANY WARRANTY; without even the implied warranty of
 * MERCHANTABILITY or FITNESS FOR A PARTICULAR PURPOSE.  See the
 * GNU General Public License for more details.
 */

/*---------------------------------------------------------------------------
 * This file is autogenerated file using gcdb parser. Please do not edit it.
 * Update input XML file to add a new entry or update variable in this file
 * VERSION = "1.0"
 *---------------------------------------------------------------------------*/
&mdss_mdp {
	dsi_oppo15009jdi_nt35592_720p_vid: qcom,mdss_dsi_oppo15009jdi_nt35592_720p_video {
		qcom,mdss-dsi-panel-name = "oppo15009jdi nt35592 720p video video mode dsi panel";
		qcom,mdss-dsi-panel-manufacture = "JDI";
		qcom,mdss-dsi-panel-version = "NT35592";		
		qcom,mdss-dsi-panel-controller = <&mdss_dsi0>;
		qcom,mdss-dsi-panel-type = "dsi_video_mode";
		qcom,mdss-dsi-panel-destination = "display_1";
		qcom,mdss-dsi-panel-framerate = <61>;
		qcom,mdss-dsi-virtual-channel-id = <0>;
		qcom,mdss-dsi-stream = <0>;
		qcom,mdss-dsi-panel-width = <720>;
		qcom,mdss-dsi-panel-height = <1280>;
		qcom,mdss-dsi-h-front-porch = <140>;
		qcom,mdss-dsi-h-back-porch = <164>;
		qcom,mdss-dsi-h-pulse-width = <8>;
		qcom,mdss-dsi-h-sync-skew = <0>;
		qcom,mdss-dsi-v-back-porch = <4>;
		qcom,mdss-dsi-v-front-porch = <6>;
		qcom,mdss-dsi-v-pulse-width = <1>;
		qcom,mdss-dsi-h-left-border = <0>;
		qcom,mdss-dsi-h-right-border = <0>;
		qcom,mdss-dsi-v-top-border = <0>;
		qcom,mdss-dsi-v-bottom-border = <0>;
		qcom,mdss-dsi-bpp = <24>;
		qcom,mdss-dsi-color-order = <0>;
		qcom,mdss-dsi-underflow-color = <0xff>;
		qcom,mdss-dsi-border-color = <0>;
		qcom,mdss-dsi-on-command = [29 01 00 00 00 00 02 FF 01
29 01 00 00 00 00 02 FB 01
29 01 00 00 00 00 02 00 1A
29 01 00 00 00 00 02 02 43
29 01 00 00 00 00 02 04 43
29 01 00 00 00 00 02 08 56
29 01 00 00 00 00 02 09 00
29 01 00 00 00 00 02 0B B3
29 01 00 00 00 00 02 0C B3
29 01 00 00 00 00 02 0D 2F
29 01 00 00 00 00 02 0E 1B
29 01 00 00 00 00 02 0F A2
29 01 00 00 00 00 02 11 7A
29 01 00 00 00 00 02 12 03
29 01 00 00 00 00 02 37 02
29 01 00 00 00 00 02 23 00
29 01 00 00 00 00 02 24 00
29 01 00 00 00 00 02 25 00
29 01 00 00 00 00 02 26 00
29 01 00 00 00 00 02 27 00
29 01 00 00 00 00 02 28 00
29 01 00 00 00 00 02 36 00
29 01 00 00 00 00 02 6F 00
29 01 00 00 00 00 02 FF 05
29 01 00 00 00 00 02 02 82
29 01 00 00 00 00 02 03 82
29 01 00 00 00 00 02 04 82
29 01 00 00 00 00 02 01 00
29 01 00 00 00 00 02 05 30
29 01 00 00 00 00 02 06 33
29 01 00 00 00 00 02 07 70
29 01 00 00 00 00 02 08 00
29 01 00 00 00 00 02 11 00
29 01 00 00 00 00 02 09 00
29 01 00 00 00 00 02 0A 01
29 01 00 00 00 00 02 0B 70
29 01 00 00 00 00 02 0D 04
29 01 00 00 00 00 02 0E 1B
29 01 00 00 00 00 02 0F 02
29 01 00 00 00 00 02 10 32
29 01 00 00 00 00 02 12 00
29 01 00 00 00 00 02 14 00
29 01 00 00 00 00 02 16 04
29 01 00 00 00 00 02 19 FF
29 01 00 00 00 00 02 1A FF
29 01 00 00 00 00 02 1B FF
29 01 00 00 00 00 02 1C 80
29 01 00 00 00 00 02 1D 00
29 01 00 00 00 00 02 1E 00
29 01 00 00 00 00 02 1F 77
29 01 00 00 00 00 02 21 20
29 01 00 00 00 00 02 22 55
29 01 00 00 00 00 02 23 0D
29 01 00 00 00 00 02 24 03
29 01 00 00 00 00 02 25 53
29 01 00 00 00 00 02 26 55
29 01 00 00 00 00 02 27 35
29 01 00 00 00 00 02 28 00
29 01 00 00 00 00 02 29 01
29 01 00 00 00 00 02 2A 11
29 01 00 00 00 00 02 2D 02
29 01 00 00 00 00 02 2F 00
29 01 00 00 00 00 02 30 11
29 01 00 00 00 00 02 31 20
29 01 00 00 00 00 02 32 09
29 01 00 00 00 00 02 35 0D
29 01 00 00 00 00 02 36 00
29 01 00 00 00 00 02 37 09
29 01 00 00 00 00 02 48 40
29 01 00 00 00 00 02 49 23
29 01 00 00 00 00 02 4A C1
29 01 00 00 00 00 02 6F 25
29 01 00 00 00 00 02 7B 00
29 01 00 00 00 00 02 7C 00
29 01 00 00 00 00 02 7D 03
29 01 00 00 00 00 02 83 00
29 01 00 00 00 00 02 8D 00
29 01 00 00 00 00 02 A4 8D
29 01 00 00 00 00 02 A6 00
29 01 00 00 00 00 02 BB 0A
29 01 00 00 00 00 02 BC 06
29 01 00 00 00 00 02 D7 61
29 01 00 00 00 00 02 D8 13
29 01 00 00 00 00 02 F5 00
29 01 00 00 00 00 02 F6 01
29 01 00 00 00 00 02 89 C1
29 01 00 00 00 00 02 91 91
29 01 00 00 00 00 02 A2 10
29 01 00 00 00 00 02 FB 01
29 01 00 00 00 00 02 FF 01
29 01 00 00 00 00 02 FB 01
29 01 00 00 00 00 02 75 00
29 01 00 00 00 00 02 76 24
29 01 00 00 00 00 02 77 00
29 01 00 00 00 00 02 78 25
29 01 00 00 00 00 02 79 00
29 01 00 00 00 00 02 7A 43
29 01 00 00 00 00 02 7B 00
29 01 00 00 00 00 02 7C 5A
29 01 00 00 00 00 02 7D 00
29 01 00 00 00 00 02 7E 8F
29 01 00 00 00 00 02 7F 00
29 01 00 00 00 00 02 80 A6
29 01 00 00 00 00 02 81 00
29 01 00 00 00 00 02 82 B9
29 01 00 00 00 00 02 83 00
29 01 00 00 00 00 02 84 C9
29 01 00 00 00 00 02 85 00
29 01 00 00 00 00 02 86 D9
29 01 00 00 00 00 02 87 01
29 01 00 00 00 00 02 88 0C
29 01 00 00 00 00 02 89 01
29 01 00 00 00 00 02 8A 30
29 01 00 00 00 00 02 8B 01
29 01 00 00 00 00 02 8C 69
29 01 00 00 00 00 02 8D 01
29 01 00 00 00 00 02 8E 91
29 01 00 00 00 00 02 8F 01
29 01 00 00 00 00 02 90 D5
29 01 00 00 00 00 02 91 02
29 01 00 00 00 00 02 92 0D
29 01 00 00 00 00 02 93 02
29 01 00 00 00 00 02 94 10
29 01 00 00 00 00 02 95 02
29 01 00 00 00 00 02 96 3F
29 01 00 00 00 00 02 97 02
29 01 00 00 00 00 02 98 77
29 01 00 00 00 00 02 99 02
29 01 00 00 00 00 02 9A 9A
29 01 00 00 00 00 02 9B 02
29 01 00 00 00 00 02 9C CF
29 01 00 00 00 00 02 9D 02
29 01 00 00 00 00 02 9E F1
29 01 00 00 00 00 02 9F 03
29 01 00 00 00 00 02 A0 1F
29 01 00 00 00 00 02 A2 03
29 01 00 00 00 00 02 A3 2E
29 01 00 00 00 00 02 A4 03
29 01 00 00 00 00 02 A5 3E
29 01 00 00 00 00 02 A6 03
29 01 00 00 00 00 02 A7 4E
29 01 00 00 00 00 02 A9 03
29 01 00 00 00 00 02 AA 5D
29 01 00 00 00 00 02 AB 03
29 01 00 00 00 00 02 AC 8B
29 01 00 00 00 00 02 AD 03
29 01 00 00 00 00 02 AE 8E
29 01 00 00 00 00 02 AF 03
29 01 00 00 00 00 02 B0 B7
29 01 00 00 00 00 02 B1 03
29 01 00 00 00 00 02 B2 E3
29 01 00 00 00 00 02 B3 00
29 01 00 00 00 00 02 B4 24
29 01 00 00 00 00 02 B5 00
29 01 00 00 00 00 02 B6 25
29 01 00 00 00 00 02 B7 00
29 01 00 00 00 00 02 B8 43
29 01 00 00 00 00 02 B9 00
29 01 00 00 00 00 02 BA 5A
29 01 00 00 00 00 02 BB 00
29 01 00 00 00 00 02 BC 8F
29 01 00 00 00 00 02 BD 00
29 01 00 00 00 00 02 BE A6
29 01 00 00 00 00 02 BF 00
29 01 00 00 00 00 02 C0 B9
29 01 00 00 00 00 02 C1 00
29 01 00 00 00 00 02 C2 C9
29 01 00 00 00 00 02 C3 00
29 01 00 00 00 00 02 C4 D9
29 01 00 00 00 00 02 C5 01
29 01 00 00 00 00 02 C6 0C
29 01 00 00 00 00 02 C7 01
29 01 00 00 00 00 02 C8 30
29 01 00 00 00 00 02 C9 01
29 01 00 00 00 00 02 CA 69
29 01 00 00 00 00 02 CB 01
29 01 00 00 00 00 02 CC 91
29 01 00 00 00 00 02 CD 01
29 01 00 00 00 00 02 CE D5
29 01 00 00 00 00 02 CF 02
29 01 00 00 00 00 02 D0 0D
29 01 00 00 00 00 02 D1 02
29 01 00 00 00 00 02 D2 10
29 01 00 00 00 00 02 D3 02
29 01 00 00 00 00 02 D4 3F
29 01 00 00 00 00 02 D5 02
29 01 00 00 00 00 02 D6 77
29 01 00 00 00 00 02 D7 02
29 01 00 00 00 00 02 D8 9A
29 01 00 00 00 00 02 D9 02
29 01 00 00 00 00 02 DA CF
29 01 00 00 00 00 02 DB 02
29 01 00 00 00 00 02 DC F1
29 01 00 00 00 00 02 DD 03
29 01 00 00 00 00 02 DE 1F
29 01 00 00 00 00 02 DF 03
29 01 00 00 00 00 02 E0 2E
29 01 00 00 00 00 02 E1 03
29 01 00 00 00 00 02 E2 3E
29 01 00 00 00 00 02 E3 03
29 01 00 00 00 00 02 E4 4E
29 01 00 00 00 00 02 E5 03
29 01 00 00 00 00 02 E6 5D
29 01 00 00 00 00 02 E7 03
29 01 00 00 00 00 02 E8 8B
29 01 00 00 00 00 02 E9 03
29 01 00 00 00 00 02 EA 8E
29 01 00 00 00 00 02 EB 03
29 01 00 00 00 00 02 EC B7
29 01 00 00 00 00 02 ED 03
29 01 00 00 00 00 02 EE E3
29 01 00 00 00 00 02 EF 00
29 01 00 00 00 00 02 F0 F5
29 01 00 00 00 00 02 F1 00
29 01 00 00 00 00 02 F2 FB
29 01 00 00 00 00 02 F3 01
29 01 00 00 00 00 02 F4 08
29 01 00 00 00 00 02 F5 01
29 01 00 00 00 00 02 F6 13
29 01 00 00 00 00 02 F7 01
29 01 00 00 00 00 02 F8 1B
29 01 00 00 00 00 02 F9 01
29 01 00 00 00 00 02 FA 24
29 01 00 00 00 00 02 FF 02
29 01 00 00 00 00 02 FB 01
29 01 00 00 00 00 02 00 01
29 01 00 00 00 00 02 01 2C
29 01 00 00 00 00 02 02 01
29 01 00 00 00 00 02 03 34
29 01 00 00 00 00 02 04 01
29 01 00 00 00 00 02 05 3B
29 01 00 00 00 00 02 06 01
29 01 00 00 00 00 02 07 55
29 01 00 00 00 00 02 08 01
29 01 00 00 00 00 02 09 6C
29 01 00 00 00 00 02 0A 01
29 01 00 00 00 00 02 0B 93
29 01 00 00 00 00 02 0C 01
29 01 00 00 00 00 02 0D B5
29 01 00 00 00 00 02 0E 01
29 01 00 00 00 00 02 0F EC
29 01 00 00 00 00 02 10 02
29 01 00 00 00 00 02 11 1B
29 01 00 00 00 00 02 12 02
29 01 00 00 00 00 02 13 1C
29 01 00 00 00 00 02 14 02
29 01 00 00 00 00 02 15 4B
29 01 00 00 00 00 02 16 02
29 01 00 00 00 00 02 17 82
29 01 00 00 00 00 02 18 02
29 01 00 00 00 00 02 19 A7
29 01 00 00 00 00 02 1A 02
29 01 00 00 00 00 02 1B D9
29 01 00 00 00 00 02 1C 02
29 01 00 00 00 00 02 1D FC
29 01 00 00 00 00 02 1E 03
29 01 00 00 00 00 02 1F 2A
29 01 00 00 00 00 02 20 03
29 01 00 00 00 00 02 21 38
29 01 00 00 00 00 02 22 03
29 01 00 00 00 00 02 23 47
29 01 00 00 00 00 02 24 03
29 01 00 00 00 00 02 25 59
29 01 00 00 00 00 02 26 03
29 01 00 00 00 00 02 27 65
29 01 00 00 00 00 02 28 03
29 01 00 00 00 00 02 29 91
29 01 00 00 00 00 02 2A 03
29 01 00 00 00 00 02 2B AF
29 01 00 00 00 00 02 2D 03
29 01 00 00 00 00 02 2F EF
29 01 00 00 00 00 02 30 03
29 01 00 00 00 00 02 31 F5
29 01 00 00 00 00 02 32 00
29 01 00 00 00 00 02 33 F5
29 01 00 00 00 00 02 34 00
29 01 00 00 00 00 02 35 FB
29 01 00 00 00 00 02 36 01
29 01 00 00 00 00 02 37 08
29 01 00 00 00 00 02 38 01
29 01 00 00 00 00 02 39 13
29 01 00 00 00 00 02 3A 01
29 01 00 00 00 00 02 3B 1B
29 01 00 00 00 00 02 3D 01
29 01 00 00 00 00 02 3F 24
29 01 00 00 00 00 02 40 01
29 01 00 00 00 00 02 41 2C
29 01 00 00 00 00 02 42 01
29 01 00 00 00 00 02 43 34
29 01 00 00 00 00 02 44 01
29 01 00 00 00 00 02 45 3B
29 01 00 00 00 00 02 46 01
29 01 00 00 00 00 02 47 55
29 01 00 00 00 00 02 48 01
29 01 00 00 00 00 02 49 6C
29 01 00 00 00 00 02 4A 01
29 01 00 00 00 00 02 4B 93
29 01 00 00 00 00 02 4C 01
29 01 00 00 00 00 02 4D B5
29 01 00 00 00 00 02 4E 01
29 01 00 00 00 00 02 4F EC
29 01 00 00 00 00 02 50 02
29 01 00 00 00 00 02 51 1B
29 01 00 00 00 00 02 52 02
29 01 00 00 00 00 02 53 1C
29 01 00 00 00 00 02 54 02
29 01 00 00 00 00 02 55 4B
29 01 00 00 00 00 02 56 02
29 01 00 00 00 00 02 58 82
29 01 00 00 00 00 02 59 02
29 01 00 00 00 00 02 5A A7
29 01 00 00 00 00 02 5B 02
29 01 00 00 00 00 02 5C D9
29 01 00 00 00 00 02 5D 02
29 01 00 00 00 00 02 5E FC
29 01 00 00 00 00 02 5F 03
29 01 00 00 00 00 02 60 2A
29 01 00 00 00 00 02 61 03
29 01 00 00 00 00 02 62 38
29 01 00 00 00 00 02 63 03
29 01 00 00 00 00 02 64 47
29 01 00 00 00 00 02 65 03
29 01 00 00 00 00 02 66 59
29 01 00 00 00 00 02 67 03
29 01 00 00 00 00 02 68 65
29 01 00 00 00 00 02 69 03
29 01 00 00 00 00 02 6A 91
29 01 00 00 00 00 02 6B 03
29 01 00 00 00 00 02 6C AF
29 01 00 00 00 00 02 6D 03
29 01 00 00 00 00 02 6E EF
29 01 00 00 00 00 02 6F 03
29 01 00 00 00 00 02 70 F5
29 01 00 00 00 00 02 71 00
29 01 00 00 00 00 02 72 01
29 01 00 00 00 00 02 73 00
29 01 00 00 00 00 02 74 02
29 01 00 00 00 00 02 75 00
29 01 00 00 00 00 02 76 41
29 01 00 00 00 00 02 77 00
29 01 00 00 00 00 02 78 6C
29 01 00 00 00 00 02 79 00
29 01 00 00 00 00 02 7A 88
29 01 00 00 00 00 02 7B 00
29 01 00 00 00 00 02 7C 9E
29 01 00 00 00 00 02 7D 00
29 01 00 00 00 00 02 7E B1
29 01 00 00 00 00 02 7F 00
29 01 00 00 00 00 02 80 C1
29 01 00 00 00 00 02 81 00
29 01 00 00 00 00 02 82 CF
29 01 00 00 00 00 02 83 01
29 01 00 00 00 00 02 84 02
29 01 00 00 00 00 02 85 01
29 01 00 00 00 00 02 86 26
29 01 00 00 00 00 02 87 01
29 01 00 00 00 00 02 88 60
29 01 00 00 00 00 02 89 01
29 01 00 00 00 00 02 8A 8C
29 01 00 00 00 00 02 8B 01
29 01 00 00 00 00 02 8C D2
29 01 00 00 00 00 02 8D 02
29 01 00 00 00 00 02 8E 09
29 01 00 00 00 00 02 8F 02
29 01 00 00 00 00 02 90 0B
29 01 00 00 00 00 02 91 02
29 01 00 00 00 00 02 92 3D
29 01 00 00 00 00 02 93 02
29 01 00 00 00 00 02 94 76
29 01 00 00 00 00 02 95 02
29 01 00 00 00 00 02 96 9B
29 01 00 00 00 00 02 97 02
29 01 00 00 00 00 02 98 D0
29 01 00 00 00 00 02 99 02
29 01 00 00 00 00 02 9A F6
29 01 00 00 00 00 02 9B 03
29 01 00 00 00 00 02 9C 2D
29 01 00 00 00 00 02 9D 03
29 01 00 00 00 00 02 9E 40
29 01 00 00 00 00 02 9F 03
29 01 00 00 00 00 02 A0 5A
29 01 00 00 00 00 02 A2 03
29 01 00 00 00 00 02 A3 7F
29 01 00 00 00 00 02 A4 03
29 01 00 00 00 00 02 A5 FA
29 01 00 00 00 00 02 A6 03
29 01 00 00 00 00 02 A7 FB
29 01 00 00 00 00 02 A9 03
29 01 00 00 00 00 02 AA FE
29 01 00 00 00 00 02 AB 03
29 01 00 00 00 00 02 AC FE
29 01 00 00 00 00 02 AD 03
29 01 00 00 00 00 02 AE FE
29 01 00 00 00 00 02 AF 00
29 01 00 00 00 00 02 B0 01
29 01 00 00 00 00 02 B1 00
29 01 00 00 00 00 02 B2 02
29 01 00 00 00 00 02 B3 00
29 01 00 00 00 00 02 B4 41
29 01 00 00 00 00 02 B5 00
29 01 00 00 00 00 02 B6 6C
29 01 00 00 00 00 02 B7 00
29 01 00 00 00 00 02 B8 88
29 01 00 00 00 00 02 B9 00
29 01 00 00 00 00 02 BA 9E
29 01 00 00 00 00 02 BB 00
29 01 00 00 00 00 02 BC B1
29 01 00 00 00 00 02 BD 00
29 01 00 00 00 00 02 BE C1
29 01 00 00 00 00 02 BF 00
29 01 00 00 00 00 02 C0 CF
29 01 00 00 00 00 02 C1 01
29 01 00 00 00 00 02 C2 02
29 01 00 00 00 00 02 C3 01
29 01 00 00 00 00 02 C4 26
29 01 00 00 00 00 02 C5 01
29 01 00 00 00 00 02 C6 60
29 01 00 00 00 00 02 C7 01
29 01 00 00 00 00 02 C8 8C
29 01 00 00 00 00 02 C9 01
29 01 00 00 00 00 02 CA D2
29 01 00 00 00 00 02 CB 02
29 01 00 00 00 00 02 CC 09
29 01 00 00 00 00 02 CD 02
29 01 00 00 00 00 02 CE 0B
29 01 00 00 00 00 02 CF 02
29 01 00 00 00 00 02 D0 3D
29 01 00 00 00 00 02 D1 02
29 01 00 00 00 00 02 D2 76
29 01 00 00 00 00 02 D3 02
29 01 00 00 00 00 02 D4 9B
29 01 00 00 00 00 02 D5 02
29 01 00 00 00 00 02 D6 D0
29 01 00 00 00 00 02 D7 02
29 01 00 00 00 00 02 D8 F6
29 01 00 00 00 00 02 D9 03
29 01 00 00 00 00 02 DA 2D
29 01 00 00 00 00 02 DB 03
29 01 00 00 00 00 02 DC 40
29 01 00 00 00 00 02 DD 03
29 01 00 00 00 00 02 DE 5A
29 01 00 00 00 00 02 DF 03
29 01 00 00 00 00 02 E0 7F
29 01 00 00 00 00 02 E1 03
29 01 00 00 00 00 02 E2 FA
29 01 00 00 00 00 02 E3 03
29 01 00 00 00 00 02 E4 FB
29 01 00 00 00 00 02 E5 03
29 01 00 00 00 00 02 E6 FE
29 01 00 00 00 00 02 E7 03
29 01 00 00 00 00 02 E8 FE
29 01 00 00 00 00 02 E9 03
29 01 00 00 00 00 02 EA FE
29 01 00 00 00 00 02 FF 03
29 01 00 00 00 00 02 56 00
29 01 00 00 00 00 02 68 00
29 01 00 00 00 00 02 1A 07
29 01 00 00 00 00 02 FB 01
29 01 00 00 00 00 02 FF 00
29 01 00 00 00 00 02 55 93
29 01 00 00 00 00 02 35 00
29 01 00 00 00 00 02 FF 01
29 01 00 00 00 00 02 FB 01
29 01 00 00 00 00 02 36 7B
29 01 00 00 00 00 02 6D 33
29 01 00 00 00 00 02 6F 03
29 01 00 00 00 00 02 FF 01
29 01 00 00 00 00 02 FB 01
29 01 00 00 00 00 02 4B 83
29 01 00 00 00 00 02 FF FF
29 01 00 00 00 00 02 FB 01
29 01 00 00 00 00 02 3F 09
29 01 00 00 00 00 02 CA 80
29 01 00 00 00 00 02 FF EE
29 01 00 00 00 00 02 FB 01
29 01 00 00 00 00 02 2A A9
29 01 00 00 00 00 02 FF 00
29 01 00 00 96 00 02 11 00
29 01 00 00 40 00 02 29 00];
		qcom,mdss-dsi-on-command-cabc = [29 01 00 00 00 00 02 FF 01
29 01 00 00 00 00 02 FB 01
29 01 00 00 00 00 02 00 1A
29 01 00 00 00 00 02 02 43
29 01 00 00 00 00 02 04 43
29 01 00 00 00 00 02 08 56
29 01 00 00 00 00 02 09 00
29 01 00 00 00 00 02 0B B3
29 01 00 00 00 00 02 0C B3
29 01 00 00 00 00 02 0D 2F
29 01 00 00 00 00 02 0E 1B
29 01 00 00 00 00 02 0F A2
29 01 00 00 00 00 02 11 7A
29 01 00 00 00 00 02 12 03
29 01 00 00 00 00 02 37 02
29 01 00 00 00 00 02 23 00
29 01 00 00 00 00 02 24 00
29 01 00 00 00 00 02 25 00
29 01 00 00 00 00 02 26 00
29 01 00 00 00 00 02 27 00
29 01 00 00 00 00 02 28 00
29 01 00 00 00 00 02 36 00
29 01 00 00 00 00 02 6F 00
29 01 00 00 00 00 02 FF 05
29 01 00 00 00 00 02 02 82
29 01 00 00 00 00 02 03 82
29 01 00 00 00 00 02 04 82
29 01 00 00 00 00 02 01 00
29 01 00 00 00 00 02 05 30
29 01 00 00 00 00 02 06 33
29 01 00 00 00 00 02 07 70
29 01 00 00 00 00 02 08 00
29 01 00 00 00 00 02 11 00
29 01 00 00 00 00 02 09 00
29 01 00 00 00 00 02 0A 01
29 01 00 00 00 00 02 0B 70
29 01 00 00 00 00 02 0D 04
29 01 00 00 00 00 02 0E 1B
29 01 00 00 00 00 02 0F 02
29 01 00 00 00 00 02 10 32
29 01 00 00 00 00 02 12 00
29 01 00 00 00 00 02 14 00
29 01 00 00 00 00 02 16 04
29 01 00 00 00 00 02 19 FF
29 01 00 00 00 00 02 1A FF
29 01 00 00 00 00 02 1B FF
29 01 00 00 00 00 02 1C 80
29 01 00 00 00 00 02 1D 00
29 01 00 00 00 00 02 1E 00
29 01 00 00 00 00 02 1F 77
29 01 00 00 00 00 02 21 20
29 01 00 00 00 00 02 22 55
29 01 00 00 00 00 02 23 0D
29 01 00 00 00 00 02 24 03
29 01 00 00 00 00 02 25 53
29 01 00 00 00 00 02 26 55
29 01 00 00 00 00 02 27 35
29 01 00 00 00 00 02 28 00
29 01 00 00 00 00 02 29 01
29 01 00 00 00 00 02 2A 11
29 01 00 00 00 00 02 2D 02
29 01 00 00 00 00 02 2F 00
29 01 00 00 00 00 02 30 11
29 01 00 00 00 00 02 31 20
29 01 00 00 00 00 02 32 09
29 01 00 00 00 00 02 35 0D
29 01 00 00 00 00 02 36 00
29 01 00 00 00 00 02 37 09
29 01 00 00 00 00 02 48 40
29 01 00 00 00 00 02 49 23
29 01 00 00 00 00 02 4A C1
29 01 00 00 00 00 02 6F 25
29 01 00 00 00 00 02 7B 00
29 01 00 00 00 00 02 7C 00
29 01 00 00 00 00 02 7D 03
29 01 00 00 00 00 02 83 00
29 01 00 00 00 00 02 8D 00
29 01 00 00 00 00 02 A4 8D
29 01 00 00 00 00 02 A6 00
29 01 00 00 00 00 02 BB 0A
29 01 00 00 00 00 02 BC 06
29 01 00 00 00 00 02 D7 61
29 01 00 00 00 00 02 D8 13
29 01 00 00 00 00 02 F5 00
29 01 00 00 00 00 02 F6 01
29 01 00 00 00 00 02 89 C1
29 01 00 00 00 00 02 91 91
29 01 00 00 00 00 02 A2 10
29 01 00 00 00 00 02 FB 01
29 01 00 00 00 00 02 FF 01
29 01 00 00 00 00 02 FB 01
29 01 00 00 00 00 02 75 00
29 01 00 00 00 00 02 76 24
29 01 00 00 00 00 02 77 00
29 01 00 00 00 00 02 78 25
29 01 00 00 00 00 02 79 00
29 01 00 00 00 00 02 7A 43
29 01 00 00 00 00 02 7B 00
29 01 00 00 00 00 02 7C 5A
29 01 00 00 00 00 02 7D 00
29 01 00 00 00 00 02 7E 8F
29 01 00 00 00 00 02 7F 00
29 01 00 00 00 00 02 80 A6
29 01 00 00 00 00 02 81 00
29 01 00 00 00 00 02 82 B9
29 01 00 00 00 00 02 83 00
29 01 00 00 00 00 02 84 C9
29 01 00 00 00 00 02 85 00
29 01 00 00 00 00 02 86 D9
29 01 00 00 00 00 02 87 01
29 01 00 00 00 00 02 88 0C
29 01 00 00 00 00 02 89 01
29 01 00 00 00 00 02 8A 30
29 01 00 00 00 00 02 8B 01
29 01 00 00 00 00 02 8C 69
29 01 00 00 00 00 02 8D 01
29 01 00 00 00 00 02 8E 91
29 01 00 00 00 00 02 8F 01
29 01 00 00 00 00 02 90 D5
29 01 00 00 00 00 02 91 02
29 01 00 00 00 00 02 92 0D
29 01 00 00 00 00 02 93 02
29 01 00 00 00 00 02 94 10
29 01 00 00 00 00 02 95 02
29 01 00 00 00 00 02 96 3F
29 01 00 00 00 00 02 97 02
29 01 00 00 00 00 02 98 77
29 01 00 00 00 00 02 99 02
29 01 00 00 00 00 02 9A 9A
29 01 00 00 00 00 02 9B 02
29 01 00 00 00 00 02 9C CF
29 01 00 00 00 00 02 9D 02
29 01 00 00 00 00 02 9E F1
29 01 00 00 00 00 02 9F 03
29 01 00 00 00 00 02 A0 1F
29 01 00 00 00 00 02 A2 03
29 01 00 00 00 00 02 A3 2E
29 01 00 00 00 00 02 A4 03
29 01 00 00 00 00 02 A5 3E
29 01 00 00 00 00 02 A6 03
29 01 00 00 00 00 02 A7 4E
29 01 00 00 00 00 02 A9 03
29 01 00 00 00 00 02 AA 5D
29 01 00 00 00 00 02 AB 03
29 01 00 00 00 00 02 AC 8B
29 01 00 00 00 00 02 AD 03
29 01 00 00 00 00 02 AE 8E
29 01 00 00 00 00 02 AF 03
29 01 00 00 00 00 02 B0 B7
29 01 00 00 00 00 02 B1 03
29 01 00 00 00 00 02 B2 E3
29 01 00 00 00 00 02 B3 00
29 01 00 00 00 00 02 B4 24
29 01 00 00 00 00 02 B5 00
29 01 00 00 00 00 02 B6 25
29 01 00 00 00 00 02 B7 00
29 01 00 00 00 00 02 B8 43
29 01 00 00 00 00 02 B9 00
29 01 00 00 00 00 02 BA 5A
29 01 00 00 00 00 02 BB 00
29 01 00 00 00 00 02 BC 8F
29 01 00 00 00 00 02 BD 00
29 01 00 00 00 00 02 BE A6
29 01 00 00 00 00 02 BF 00
29 01 00 00 00 00 02 C0 B9
29 01 00 00 00 00 02 C1 00
29 01 00 00 00 00 02 C2 C9
29 01 00 00 00 00 02 C3 00
29 01 00 00 00 00 02 C4 D9
29 01 00 00 00 00 02 C5 01
29 01 00 00 00 00 02 C6 0C
29 01 00 00 00 00 02 C7 01
29 01 00 00 00 00 02 C8 30
29 01 00 00 00 00 02 C9 01
29 01 00 00 00 00 02 CA 69
29 01 00 00 00 00 02 CB 01
29 01 00 00 00 00 02 CC 91
29 01 00 00 00 00 02 CD 01
29 01 00 00 00 00 02 CE D5
29 01 00 00 00 00 02 CF 02
29 01 00 00 00 00 02 D0 0D
29 01 00 00 00 00 02 D1 02
29 01 00 00 00 00 02 D2 10
29 01 00 00 00 00 02 D3 02
29 01 00 00 00 00 02 D4 3F
29 01 00 00 00 00 02 D5 02
29 01 00 00 00 00 02 D6 77
29 01 00 00 00 00 02 D7 02
29 01 00 00 00 00 02 D8 9A
29 01 00 00 00 00 02 D9 02
29 01 00 00 00 00 02 DA CF
29 01 00 00 00 00 02 DB 02
29 01 00 00 00 00 02 DC F1
29 01 00 00 00 00 02 DD 03
29 01 00 00 00 00 02 DE 1F
29 01 00 00 00 00 02 DF 03
29 01 00 00 00 00 02 E0 2E
29 01 00 00 00 00 02 E1 03
29 01 00 00 00 00 02 E2 3E
29 01 00 00 00 00 02 E3 03
29 01 00 00 00 00 02 E4 4E
29 01 00 00 00 00 02 E5 03
29 01 00 00 00 00 02 E6 5D
29 01 00 00 00 00 02 E7 03
29 01 00 00 00 00 02 E8 8B
29 01 00 00 00 00 02 E9 03
29 01 00 00 00 00 02 EA 8E
29 01 00 00 00 00 02 EB 03
29 01 00 00 00 00 02 EC B7
29 01 00 00 00 00 02 ED 03
29 01 00 00 00 00 02 EE E3
29 01 00 00 00 00 02 EF 00
29 01 00 00 00 00 02 F0 F5
29 01 00 00 00 00 02 F1 00
29 01 00 00 00 00 02 F2 FB
29 01 00 00 00 00 02 F3 01
29 01 00 00 00 00 02 F4 08
29 01 00 00 00 00 02 F5 01
29 01 00 00 00 00 02 F6 13
29 01 00 00 00 00 02 F7 01
29 01 00 00 00 00 02 F8 1B
29 01 00 00 00 00 02 F9 01
29 01 00 00 00 00 02 FA 24
29 01 00 00 00 00 02 FF 02
29 01 00 00 00 00 02 FB 01
29 01 00 00 00 00 02 00 01
29 01 00 00 00 00 02 01 2C
29 01 00 00 00 00 02 02 01
29 01 00 00 00 00 02 03 34
29 01 00 00 00 00 02 04 01
29 01 00 00 00 00 02 05 3B
29 01 00 00 00 00 02 06 01
29 01 00 00 00 00 02 07 55
29 01 00 00 00 00 02 08 01
29 01 00 00 00 00 02 09 6C
29 01 00 00 00 00 02 0A 01
29 01 00 00 00 00 02 0B 93
29 01 00 00 00 00 02 0C 01
29 01 00 00 00 00 02 0D B5
29 01 00 00 00 00 02 0E 01
29 01 00 00 00 00 02 0F EC
29 01 00 00 00 00 02 10 02
29 01 00 00 00 00 02 11 1B
29 01 00 00 00 00 02 12 02
29 01 00 00 00 00 02 13 1C
29 01 00 00 00 00 02 14 02
29 01 00 00 00 00 02 15 4B
29 01 00 00 00 00 02 16 02
29 01 00 00 00 00 02 17 82
29 01 00 00 00 00 02 18 02
29 01 00 00 00 00 02 19 A7
29 01 00 00 00 00 02 1A 02
29 01 00 00 00 00 02 1B D9
29 01 00 00 00 00 02 1C 02
29 01 00 00 00 00 02 1D FC
29 01 00 00 00 00 02 1E 03
29 01 00 00 00 00 02 1F 2A
29 01 00 00 00 00 02 20 03
29 01 00 00 00 00 02 21 38
29 01 00 00 00 00 02 22 03
29 01 00 00 00 00 02 23 47
29 01 00 00 00 00 02 24 03
29 01 00 00 00 00 02 25 59
29 01 00 00 00 00 02 26 03
29 01 00 00 00 00 02 27 65
29 01 00 00 00 00 02 28 03
29 01 00 00 00 00 02 29 91
29 01 00 00 00 00 02 2A 03
29 01 00 00 00 00 02 2B AF
29 01 00 00 00 00 02 2D 03
29 01 00 00 00 00 02 2F EF
29 01 00 00 00 00 02 30 03
29 01 00 00 00 00 02 31 F5
29 01 00 00 00 00 02 32 00
29 01 00 00 00 00 02 33 F5
29 01 00 00 00 00 02 34 00
29 01 00 00 00 00 02 35 FB
29 01 00 00 00 00 02 36 01
29 01 00 00 00 00 02 37 08
29 01 00 00 00 00 02 38 01
29 01 00 00 00 00 02 39 13
29 01 00 00 00 00 02 3A 01
29 01 00 00 00 00 02 3B 1B
29 01 00 00 00 00 02 3D 01
29 01 00 00 00 00 02 3F 24
29 01 00 00 00 00 02 40 01
29 01 00 00 00 00 02 41 2C
29 01 00 00 00 00 02 42 01
29 01 00 00 00 00 02 43 34
29 01 00 00 00 00 02 44 01
29 01 00 00 00 00 02 45 3B
29 01 00 00 00 00 02 46 01
29 01 00 00 00 00 02 47 55
29 01 00 00 00 00 02 48 01
29 01 00 00 00 00 02 49 6C
29 01 00 00 00 00 02 4A 01
29 01 00 00 00 00 02 4B 93
29 01 00 00 00 00 02 4C 01
29 01 00 00 00 00 02 4D B5
29 01 00 00 00 00 02 4E 01
29 01 00 00 00 00 02 4F EC
29 01 00 00 00 00 02 50 02
29 01 00 00 00 00 02 51 1B
29 01 00 00 00 00 02 52 02
29 01 00 00 00 00 02 53 1C
29 01 00 00 00 00 02 54 02
29 01 00 00 00 00 02 55 4B
29 01 00 00 00 00 02 56 02
29 01 00 00 00 00 02 58 82
29 01 00 00 00 00 02 59 02
29 01 00 00 00 00 02 5A A7
29 01 00 00 00 00 02 5B 02
29 01 00 00 00 00 02 5C D9
29 01 00 00 00 00 02 5D 02
29 01 00 00 00 00 02 5E FC
29 01 00 00 00 00 02 5F 03
29 01 00 00 00 00 02 60 2A
29 01 00 00 00 00 02 61 03
29 01 00 00 00 00 02 62 38
29 01 00 00 00 00 02 63 03
29 01 00 00 00 00 02 64 47
29 01 00 00 00 00 02 65 03
29 01 00 00 00 00 02 66 59
29 01 00 00 00 00 02 67 03
29 01 00 00 00 00 02 68 65
29 01 00 00 00 00 02 69 03
29 01 00 00 00 00 02 6A 91
29 01 00 00 00 00 02 6B 03
29 01 00 00 00 00 02 6C AF
29 01 00 00 00 00 02 6D 03
29 01 00 00 00 00 02 6E EF
29 01 00 00 00 00 02 6F 03
29 01 00 00 00 00 02 70 F5
29 01 00 00 00 00 02 71 00
29 01 00 00 00 00 02 72 01
29 01 00 00 00 00 02 73 00
29 01 00 00 00 00 02 74 02
29 01 00 00 00 00 02 75 00
29 01 00 00 00 00 02 76 41
29 01 00 00 00 00 02 77 00
29 01 00 00 00 00 02 78 6C
29 01 00 00 00 00 02 79 00
29 01 00 00 00 00 02 7A 88
29 01 00 00 00 00 02 7B 00
29 01 00 00 00 00 02 7C 9E
29 01 00 00 00 00 02 7D 00
29 01 00 00 00 00 02 7E B1
29 01 00 00 00 00 02 7F 00
29 01 00 00 00 00 02 80 C1
29 01 00 00 00 00 02 81 00
29 01 00 00 00 00 02 82 CF
29 01 00 00 00 00 02 83 01
29 01 00 00 00 00 02 84 02
29 01 00 00 00 00 02 85 01
29 01 00 00 00 00 02 86 26
29 01 00 00 00 00 02 87 01
29 01 00 00 00 00 02 88 60
29 01 00 00 00 00 02 89 01
29 01 00 00 00 00 02 8A 8C
29 01 00 00 00 00 02 8B 01
29 01 00 00 00 00 02 8C D2
29 01 00 00 00 00 02 8D 02
29 01 00 00 00 00 02 8E 09
29 01 00 00 00 00 02 8F 02
29 01 00 00 00 00 02 90 0B
29 01 00 00 00 00 02 91 02
29 01 00 00 00 00 02 92 3D
29 01 00 00 00 00 02 93 02
29 01 00 00 00 00 02 94 76
29 01 00 00 00 00 02 95 02
29 01 00 00 00 00 02 96 9B
29 01 00 00 00 00 02 97 02
29 01 00 00 00 00 02 98 D0
29 01 00 00 00 00 02 99 02
29 01 00 00 00 00 02 9A F6
29 01 00 00 00 00 02 9B 03
29 01 00 00 00 00 02 9C 2D
29 01 00 00 00 00 02 9D 03
29 01 00 00 00 00 02 9E 40
29 01 00 00 00 00 02 9F 03
29 01 00 00 00 00 02 A0 5A
29 01 00 00 00 00 02 A2 03
29 01 00 00 00 00 02 A3 7F
29 01 00 00 00 00 02 A4 03
29 01 00 00 00 00 02 A5 FA
29 01 00 00 00 00 02 A6 03
29 01 00 00 00 00 02 A7 FB
29 01 00 00 00 00 02 A9 03
29 01 00 00 00 00 02 AA FE
29 01 00 00 00 00 02 AB 03
29 01 00 00 00 00 02 AC FE
29 01 00 00 00 00 02 AD 03
29 01 00 00 00 00 02 AE FE
29 01 00 00 00 00 02 AF 00
29 01 00 00 00 00 02 B0 01
29 01 00 00 00 00 02 B1 00
29 01 00 00 00 00 02 B2 02
29 01 00 00 00 00 02 B3 00
29 01 00 00 00 00 02 B4 41
29 01 00 00 00 00 02 B5 00
29 01 00 00 00 00 02 B6 6C
29 01 00 00 00 00 02 B7 00
29 01 00 00 00 00 02 B8 88
29 01 00 00 00 00 02 B9 00
29 01 00 00 00 00 02 BA 9E
29 01 00 00 00 00 02 BB 00
29 01 00 00 00 00 02 BC B1
29 01 00 00 00 00 02 BD 00
29 01 00 00 00 00 02 BE C1
29 01 00 00 00 00 02 BF 00
29 01 00 00 00 00 02 C0 CF
29 01 00 00 00 00 02 C1 01
29 01 00 00 00 00 02 C2 02
29 01 00 00 00 00 02 C3 01
29 01 00 00 00 00 02 C4 26
29 01 00 00 00 00 02 C5 01
29 01 00 00 00 00 02 C6 60
29 01 00 00 00 00 02 C7 01
29 01 00 00 00 00 02 C8 8C
29 01 00 00 00 00 02 C9 01
29 01 00 00 00 00 02 CA D2
29 01 00 00 00 00 02 CB 02
29 01 00 00 00 00 02 CC 09
29 01 00 00 00 00 02 CD 02
29 01 00 00 00 00 02 CE 0B
29 01 00 00 00 00 02 CF 02
29 01 00 00 00 00 02 D0 3D
29 01 00 00 00 00 02 D1 02
29 01 00 00 00 00 02 D2 76
29 01 00 00 00 00 02 D3 02
29 01 00 00 00 00 02 D4 9B
29 01 00 00 00 00 02 D5 02
29 01 00 00 00 00 02 D6 D0
29 01 00 00 00 00 02 D7 02
29 01 00 00 00 00 02 D8 F6
29 01 00 00 00 00 02 D9 03
29 01 00 00 00 00 02 DA 2D
29 01 00 00 00 00 02 DB 03
29 01 00 00 00 00 02 DC 40
29 01 00 00 00 00 02 DD 03
29 01 00 00 00 00 02 DE 5A
29 01 00 00 00 00 02 DF 03
29 01 00 00 00 00 02 E0 7F
29 01 00 00 00 00 02 E1 03
29 01 00 00 00 00 02 E2 FA
29 01 00 00 00 00 02 E3 03
29 01 00 00 00 00 02 E4 FB
29 01 00 00 00 00 02 E5 03
29 01 00 00 00 00 02 E6 FE
29 01 00 00 00 00 02 E7 03
29 01 00 00 00 00 02 E8 FE
29 01 00 00 00 00 02 E9 03
29 01 00 00 00 00 02 EA FE
29 01 00 00 00 00 02 FF 03
29 01 00 00 00 00 02 56 00
29 01 00 00 00 00 02 68 00
29 01 00 00 00 00 02 1A 07
29 01 00 00 00 00 02 FB 01
29 01 00 00 00 00 02 FF 00
39 01 00 00 01 00 02 51 ff
29 01 00 00 01 00 02 55 93
                15 01 00 00 01 00 02 53 2c
                29 01 00 00 00 00 02 35 00 
29 01 00 00 00 00 02 FF 01
29 01 00 00 00 00 02 FB 01
29 01 00 00 00 00 02 36 7B
29 01 00 00 00 00 02 6D 33
29 01 00 00 00 00 02 6F 03
29 01 00 00 00 00 02 FF 00
                29 01 00 00 96 00 02 11 00 
                29 01 00 00 40 00 02 29 00 ];
qcom,mdss-dsi-on-command-cabc-yellow = [29 01 00 00 00 00 02 FF 01
29 01 00 00 00 00 02 FB 01
29 01 00 00 00 00 02 00 1A
29 01 00 00 00 00 02 02 43
29 01 00 00 00 00 02 04 43
29 01 00 00 00 00 02 08 56
29 01 00 00 00 00 02 09 00
29 01 00 00 00 00 02 0B B3
29 01 00 00 00 00 02 0C B3
29 01 00 00 00 00 02 0D 2F
29 01 00 00 00 00 02 0E 1B
29 01 00 00 00 00 02 0F A2
29 01 00 00 00 00 02 11 7A
29 01 00 00 00 00 02 12 03
29 01 00 00 00 00 02 37 02
29 01 00 00 00 00 02 23 00
29 01 00 00 00 00 02 24 00
29 01 00 00 00 00 02 25 00
29 01 00 00 00 00 02 26 00
29 01 00 00 00 00 02 27 00
29 01 00 00 00 00 02 28 00
29 01 00 00 00 00 02 36 00
29 01 00 00 00 00 02 6F 00
29 01 00 00 00 00 02 FF 05
29 01 00 00 00 00 02 02 82
29 01 00 00 00 00 02 03 82
29 01 00 00 00 00 02 04 82
29 01 00 00 00 00 02 01 00
29 01 00 00 00 00 02 05 30
29 01 00 00 00 00 02 06 33
29 01 00 00 00 00 02 07 70
29 01 00 00 00 00 02 08 00
29 01 00 00 00 00 02 11 00
29 01 00 00 00 00 02 09 00
29 01 00 00 00 00 02 0A 01
29 01 00 00 00 00 02 0B 70
29 01 00 00 00 00 02 0D 04
29 01 00 00 00 00 02 0E 1B
29 01 00 00 00 00 02 0F 02
29 01 00 00 00 00 02 10 32
29 01 00 00 00 00 02 12 00
29 01 00 00 00 00 02 14 00
29 01 00 00 00 00 02 16 04
29 01 00 00 00 00 02 19 FF
29 01 00 00 00 00 02 1A FF
29 01 00 00 00 00 02 1B FF
29 01 00 00 00 00 02 1C 80
29 01 00 00 00 00 02 1D 00
29 01 00 00 00 00 02 1E 00
29 01 00 00 00 00 02 1F 77
29 01 00 00 00 00 02 21 20
29 01 00 00 00 00 02 22 55
29 01 00 00 00 00 02 23 0D
29 01 00 00 00 00 02 24 03
29 01 00 00 00 00 02 25 53
29 01 00 00 00 00 02 26 55
29 01 00 00 00 00 02 27 35
29 01 00 00 00 00 02 28 00
29 01 00 00 00 00 02 29 01
29 01 00 00 00 00 02 2A 11
29 01 00 00 00 00 02 2D 02
29 01 00 00 00 00 02 2F 00
29 01 00 00 00 00 02 30 11
29 01 00 00 00 00 02 31 20
29 01 00 00 00 00 02 32 09
29 01 00 00 00 00 02 35 0D
29 01 00 00 00 00 02 36 00
29 01 00 00 00 00 02 37 09
29 01 00 00 00 00 02 48 40
29 01 00 00 00 00 02 49 23
29 01 00 00 00 00 02 4A C1
29 01 00 00 00 00 02 6F 25
29 01 00 00 00 00 02 7B 00
29 01 00 00 00 00 02 7C 00
29 01 00 00 00 00 02 7D 03
29 01 00 00 00 00 02 83 00
29 01 00 00 00 00 02 8D 00
29 01 00 00 00 00 02 A4 8D
29 01 00 00 00 00 02 A6 00
29 01 00 00 00 00 02 BB 0A
29 01 00 00 00 00 02 BC 06
29 01 00 00 00 00 02 D7 61
29 01 00 00 00 00 02 D8 13
29 01 00 00 00 00 02 F5 00
29 01 00 00 00 00 02 F6 01
29 01 00 00 00 00 02 89 C1
29 01 00 00 00 00 02 91 91
29 01 00 00 00 00 02 A2 10
29 01 00 00 00 00 02 FB 01
29 01 00 00 00 00 02 FF 01
29 01 00 00 00 00 02 FB 01
29 01 00 00 00 00 02 75 01
29 01 00 00 00 00 02 76 07
29 01 00 00 00 00 02 77 01
29 01 00 00 00 00 02 78 08
29 01 00 00 00 00 02 79 01
29 01 00 00 00 00 02 7A 10
29 01 00 00 00 00 02 7B 01
29 01 00 00 00 00 02 7C 19
29 01 00 00 00 00 02 7D 01
29 01 00 00 00 00 02 7E 25
29 01 00 00 00 00 02 7F 01
29 01 00 00 00 00 02 80 2C
29 01 00 00 00 00 02 81 01
29 01 00 00 00 00 02 82 37
29 01 00 00 00 00 02 83 01
29 01 00 00 00 00 02 84 39
29 01 00 00 00 00 02 85 01
29 01 00 00 00 00 02 86 40
29 01 00 00 00 00 02 87 01
29 01 00 00 00 00 02 88 5B
29 01 00 00 00 00 02 89 01
29 01 00 00 00 00 02 8A 70
29 01 00 00 00 00 02 8B 01
29 01 00 00 00 00 02 8C 96
29 01 00 00 00 00 02 8D 01
29 01 00 00 00 00 02 8E B7
29 01 00 00 00 00 02 8F 01
29 01 00 00 00 00 02 90 ED
29 01 00 00 00 00 02 91 02
29 01 00 00 00 00 02 92 1C
29 01 00 00 00 00 02 93 02
29 01 00 00 00 00 02 94 1E
29 01 00 00 00 00 02 95 02
29 01 00 00 00 00 02 96 4C
29 01 00 00 00 00 02 97 02
29 01 00 00 00 00 02 98 82
29 01 00 00 00 00 02 99 02
29 01 00 00 00 00 02 9A A6
29 01 00 00 00 00 02 9B 02
29 01 00 00 00 00 02 9C D9
29 01 00 00 00 00 02 9D 02
29 01 00 00 00 00 02 9E FB
29 01 00 00 00 00 02 9F 03
29 01 00 00 00 00 02 A0 29
29 01 00 00 00 00 02 A2 03
29 01 00 00 00 00 02 A3 36
29 01 00 00 00 00 02 A4 03
29 01 00 00 00 00 02 A5 45
29 01 00 00 00 00 02 A6 03
29 01 00 00 00 00 02 A7 58
29 01 00 00 00 00 02 A9 03
29 01 00 00 00 00 02 AA 7D
29 01 00 00 00 00 02 AB 03
29 01 00 00 00 00 02 AC A2
29 01 00 00 00 00 02 AD 03
29 01 00 00 00 00 02 AE C7
29 01 00 00 00 00 02 AF 03
29 01 00 00 00 00 02 B0 EC
29 01 00 00 00 00 02 B1 03
29 01 00 00 00 00 02 B2 FF
29 01 00 00 00 00 02 B3 01
29 01 00 00 00 00 02 B4 07
29 01 00 00 00 00 02 B5 01
29 01 00 00 00 00 02 B6 08
29 01 00 00 00 00 02 B7 01
29 01 00 00 00 00 02 B8 10
29 01 00 00 00 00 02 B9 01
29 01 00 00 00 00 02 BA 19
29 01 00 00 00 00 02 BB 01
29 01 00 00 00 00 02 BC 25
29 01 00 00 00 00 02 BD 01
29 01 00 00 00 00 02 BE 2C
29 01 00 00 00 00 02 BF 01
29 01 00 00 00 00 02 C0 37
29 01 00 00 00 00 02 C1 01
29 01 00 00 00 00 02 C2 39
29 01 00 00 00 00 02 C3 01
29 01 00 00 00 00 02 C4 40
29 01 00 00 00 00 02 C5 01
29 01 00 00 00 00 02 C6 5B
29 01 00 00 00 00 02 C7 01
29 01 00 00 00 00 02 C8 70
29 01 00 00 00 00 02 C9 01
29 01 00 00 00 00 02 CA 96
29 01 00 00 00 00 02 CB 01
29 01 00 00 00 00 02 CC B7
29 01 00 00 00 00 02 CD 01
29 01 00 00 00 00 02 CE ED
29 01 00 00 00 00 02 CF 02
29 01 00 00 00 00 02 D0 1C
29 01 00 00 00 00 02 D1 02
29 01 00 00 00 00 02 D2 1E
29 01 00 00 00 00 02 D3 02
29 01 00 00 00 00 02 D4 4C
29 01 00 00 00 00 02 D5 02
29 01 00 00 00 00 02 D6 82
29 01 00 00 00 00 02 D7 02
29 01 00 00 00 00 02 D8 A6
29 01 00 00 00 00 02 D9 02
29 01 00 00 00 00 02 DA D9
29 01 00 00 00 00 02 DB 02
29 01 00 00 00 00 02 DC FB
29 01 00 00 00 00 02 DD 03
29 01 00 00 00 00 02 DE 29
29 01 00 00 00 00 02 DF 03
29 01 00 00 00 00 02 E0 36
29 01 00 00 00 00 02 E1 03
29 01 00 00 00 00 02 E2 45
29 01 00 00 00 00 02 E3 03
29 01 00 00 00 00 02 E4 58
29 01 00 00 00 00 02 E5 03
29 01 00 00 00 00 02 E6 7D
29 01 00 00 00 00 02 E7 03
29 01 00 00 00 00 02 E8 A2
29 01 00 00 00 00 02 E9 03
29 01 00 00 00 00 02 EA C7
29 01 00 00 00 00 02 EB 03
29 01 00 00 00 00 02 EC EC
29 01 00 00 00 00 02 ED 03
29 01 00 00 00 00 02 EE FF
29 01 00 00 00 00 02 EF 01
29 01 00 00 00 00 02 F0 46
29 01 00 00 00 00 02 F1 01
29 01 00 00 00 00 02 F2 47
29 01 00 00 00 00 02 F3 01
29 01 00 00 00 00 02 F4 4C
29 01 00 00 00 00 02 F5 01
29 01 00 00 00 00 02 F6 52
29 01 00 00 00 00 02 F7 01
29 01 00 00 00 00 02 F8 5A
29 01 00 00 00 00 02 F9 01
29 01 00 00 00 00 02 FA 5F
29 01 00 00 00 00 02 FF 02
29 01 00 00 00 00 02 FB 01
29 01 00 00 00 00 02 00 01
29 01 00 00 00 00 02 01 67
29 01 00 00 00 00 02 02 01
29 01 00 00 00 00 02 03 68
29 01 00 00 00 00 02 04 01
29 01 00 00 00 00 02 05 6D
29 01 00 00 00 00 02 06 01
29 01 00 00 00 00 02 07 82
29 01 00 00 00 00 02 08 01
29 01 00 00 00 00 02 09 92
29 01 00 00 00 00 02 0A 01
29 01 00 00 00 00 02 0B B1
29 01 00 00 00 00 02 0C 01
29 01 00 00 00 00 02 0D CD
29 01 00 00 00 00 02 0E 01
29 01 00 00 00 00 02 0F FD
29 01 00 00 00 00 02 10 02
29 01 00 00 00 00 02 11 28
29 01 00 00 00 00 02 12 02
29 01 00 00 00 00 02 13 2A
29 01 00 00 00 00 02 14 02
29 01 00 00 00 00 02 15 56
29 01 00 00 00 00 02 16 02
29 01 00 00 00 00 02 17 8B
29 01 00 00 00 00 02 18 02
29 01 00 00 00 00 02 19 B0
29 01 00 00 00 00 02 1A 02
29 01 00 00 00 00 02 1B E2
29 01 00 00 00 00 02 1C 03
29 01 00 00 00 00 02 1D 04
29 01 00 00 00 00 02 1E 03
29 01 00 00 00 00 02 1F 31
29 01 00 00 00 00 02 20 03
29 01 00 00 00 00 02 21 3F
29 01 00 00 00 00 02 22 03
29 01 00 00 00 00 02 23 4E
29 01 00 00 00 00 02 24 03
29 01 00 00 00 00 02 25 5F
29 01 00 00 00 00 02 26 03
29 01 00 00 00 00 02 27 82
29 01 00 00 00 00 02 28 03
29 01 00 00 00 00 02 29 A5
29 01 00 00 00 00 02 2A 03
29 01 00 00 00 00 02 2B C9
29 01 00 00 00 00 02 2D 03
29 01 00 00 00 00 02 2F ED
29 01 00 00 00 00 02 30 03
29 01 00 00 00 00 02 31 FF
29 01 00 00 00 00 02 32 01
29 01 00 00 00 00 02 33 46
29 01 00 00 00 00 02 34 01
29 01 00 00 00 00 02 35 47
29 01 00 00 00 00 02 36 01
29 01 00 00 00 00 02 37 4C
29 01 00 00 00 00 02 38 01
29 01 00 00 00 00 02 39 52
29 01 00 00 00 00 02 3A 01
29 01 00 00 00 00 02 3B 5A
29 01 00 00 00 00 02 3D 01
29 01 00 00 00 00 02 3F 5F
29 01 00 00 00 00 02 40 01
29 01 00 00 00 00 02 41 67
29 01 00 00 00 00 02 42 01
29 01 00 00 00 00 02 43 68
29 01 00 00 00 00 02 44 01
29 01 00 00 00 00 02 45 6D
29 01 00 00 00 00 02 46 01
29 01 00 00 00 00 02 47 82
29 01 00 00 00 00 02 48 01
29 01 00 00 00 00 02 49 92
29 01 00 00 00 00 02 4A 01
29 01 00 00 00 00 02 4B B1
29 01 00 00 00 00 02 4C 01
29 01 00 00 00 00 02 4D CD
29 01 00 00 00 00 02 4E 01
29 01 00 00 00 00 02 4F FD
29 01 00 00 00 00 02 50 02
29 01 00 00 00 00 02 51 28
29 01 00 00 00 00 02 52 02
29 01 00 00 00 00 02 53 2A
29 01 00 00 00 00 02 54 02
29 01 00 00 00 00 02 55 56
29 01 00 00 00 00 02 56 02
29 01 00 00 00 00 02 58 8B
29 01 00 00 00 00 02 59 02
29 01 00 00 00 00 02 5A B0
29 01 00 00 00 00 02 5B 02
29 01 00 00 00 00 02 5C E2
29 01 00 00 00 00 02 5D 03
29 01 00 00 00 00 02 5E 04
29 01 00 00 00 00 02 5F 03
29 01 00 00 00 00 02 60 31
29 01 00 00 00 00 02 61 03
29 01 00 00 00 00 02 62 3F
29 01 00 00 00 00 02 63 03
29 01 00 00 00 00 02 64 4E
29 01 00 00 00 00 02 65 03
29 01 00 00 00 00 02 66 5F
29 01 00 00 00 00 02 67 03
29 01 00 00 00 00 02 68 82
29 01 00 00 00 00 02 69 03
29 01 00 00 00 00 02 6A A5
29 01 00 00 00 00 02 6B 03
29 01 00 00 00 00 02 6C C9
29 01 00 00 00 00 02 6D 03
29 01 00 00 00 00 02 6E ED
29 01 00 00 00 00 02 6F 03
29 01 00 00 00 00 02 70 FF
29 01 00 00 00 00 02 71 00
29 01 00 00 00 00 02 72 C6
29 01 00 00 00 00 02 73 00
29 01 00 00 00 00 02 74 C8
29 01 00 00 00 00 02 75 00
29 01 00 00 00 00 02 76 D4
29 01 00 00 00 00 02 77 00
29 01 00 00 00 00 02 78 E1
29 01 00 00 00 00 02 79 00
29 01 00 00 00 00 02 7A F2
29 01 00 00 00 00 02 7B 00
29 01 00 00 00 00 02 7C FB
29 01 00 00 00 00 02 7D 01
29 01 00 00 00 00 02 7E 0A
29 01 00 00 00 00 02 7F 01
29 01 00 00 00 00 02 80 0C
29 01 00 00 00 00 02 81 01
29 01 00 00 00 00 02 82 15
29 01 00 00 00 00 02 83 01
29 01 00 00 00 00 02 84 38
29 01 00 00 00 00 02 85 01
29 01 00 00 00 00 02 86 51
29 01 00 00 00 00 02 87 01
29 01 00 00 00 00 02 88 7E
29 01 00 00 00 00 02 89 01
29 01 00 00 00 00 02 8A A4
29 01 00 00 00 00 02 8B 01
29 01 00 00 00 00 02 8C E1
29 01 00 00 00 00 02 8D 02
29 01 00 00 00 00 02 8E 13
29 01 00 00 00 00 02 8F 02
29 01 00 00 00 00 02 90 16
29 01 00 00 00 00 02 91 02
29 01 00 00 00 00 02 92 46
29 01 00 00 00 00 02 93 02
29 01 00 00 00 00 02 94 7D
29 01 00 00 00 00 02 95 02
29 01 00 00 00 00 02 96 A2
29 01 00 00 00 00 02 97 02
29 01 00 00 00 00 02 98 D7
29 01 00 00 00 00 02 99 02
29 01 00 00 00 00 02 9A FC
29 01 00 00 00 00 02 9B 03
29 01 00 00 00 00 02 9C 32
29 01 00 00 00 00 02 9D 03
29 01 00 00 00 00 02 9E 45
29 01 00 00 00 00 02 9F 03
29 01 00 00 00 00 02 A0 5F
29 01 00 00 00 00 02 A2 03
29 01 00 00 00 00 02 A3 86
29 01 00 00 00 00 02 A4 03
29 01 00 00 00 00 02 A5 A0
29 01 00 00 00 00 02 A6 03
29 01 00 00 00 00 02 A7 BB
29 01 00 00 00 00 02 A9 03
29 01 00 00 00 00 02 AA D6
29 01 00 00 00 00 02 AB 03
29 01 00 00 00 00 02 AC F1
29 01 00 00 00 00 02 AD 03
29 01 00 00 00 00 02 AE FF
29 01 00 00 00 00 02 AF 00
29 01 00 00 00 00 02 B0 C6
29 01 00 00 00 00 02 B1 00
29 01 00 00 00 00 02 B2 C8
29 01 00 00 00 00 02 B3 00
29 01 00 00 00 00 02 B4 D4
29 01 00 00 00 00 02 B5 00
29 01 00 00 00 00 02 B6 E1
29 01 00 00 00 00 02 B7 00
29 01 00 00 00 00 02 B8 F2
29 01 00 00 00 00 02 B9 00
29 01 00 00 00 00 02 BA FB
29 01 00 00 00 00 02 BB 01
29 01 00 00 00 00 02 BC 0A
29 01 00 00 00 00 02 BD 01
29 01 00 00 00 00 02 BE 0C
29 01 00 00 00 00 02 BF 01
29 01 00 00 00 00 02 C0 15
29 01 00 00 00 00 02 C1 01
29 01 00 00 00 00 02 C2 38
29 01 00 00 00 00 02 C3 01
29 01 00 00 00 00 02 C4 51
29 01 00 00 00 00 02 C5 01
29 01 00 00 00 00 02 C6 7E
29 01 00 00 00 00 02 C7 01
29 01 00 00 00 00 02 C8 A4
29 01 00 00 00 00 02 C9 01
29 01 00 00 00 00 02 CA E1
29 01 00 00 00 00 02 CB 02
29 01 00 00 00 00 02 CC 13
29 01 00 00 00 00 02 CD 02
29 01 00 00 00 00 02 CE 16
29 01 00 00 00 00 02 CF 02
29 01 00 00 00 00 02 D0 46
29 01 00 00 00 00 02 D1 02
29 01 00 00 00 00 02 D2 7D
29 01 00 00 00 00 02 D3 02
29 01 00 00 00 00 02 D4 A2
29 01 00 00 00 00 02 D5 02
29 01 00 00 00 00 02 D6 D7
29 01 00 00 00 00 02 D7 02
29 01 00 00 00 00 02 D8 FC
29 01 00 00 00 00 02 D9 03
29 01 00 00 00 00 02 DA 32
29 01 00 00 00 00 02 DB 03
29 01 00 00 00 00 02 DC 45
29 01 00 00 00 00 02 DD 03
29 01 00 00 00 00 02 DE 5F
29 01 00 00 00 00 02 DF 03
29 01 00 00 00 00 02 E0 86
29 01 00 00 00 00 02 E1 03
29 01 00 00 00 00 02 E2 A0
29 01 00 00 00 00 02 E3 03
29 01 00 00 00 00 02 E4 BB
29 01 00 00 00 00 02 E5 03
29 01 00 00 00 00 02 E6 D6
29 01 00 00 00 00 02 E7 03
29 01 00 00 00 00 02 E8 F1
29 01 00 00 00 00 02 E9 03
29 01 00 00 00 00 02 EA FF
29 01 00 00 00 00 02 FF 03
29 01 00 00 00 00 02 56 00
29 01 00 00 00 00 02 68 00
29 01 00 00 00 00 02 1A 07
29 01 00 00 00 00 02 FB 01
29 01 00 00 00 00 02 FF 00
39 01 00 00 01 00 02 51 ff
29 01 00 00 01 00 02 55 93
15 01 00 00 01 00 02 53 2c
29 01 00 00 00 00 02 35 00 
29 01 00 00 00 00 02 FF 01
29 01 00 00 00 00 02 FB 01
29 01 00 00 00 00 02 36 7B
29 01 00 00 00 00 02 6D 33
29 01 00 00 00 00 02 6F 03
29 01 00 00 00 00 02 FF 00
29 01 00 00 96 00 02 11 00
29 01 00 00 40 00 02 29 00];
		qcom,mdss-dsi-on-command-cabc-normal = [29 01 00 00 00 00 02 FF 01
29 01 00 00 00 00 02 FB 01
29 01 00 00 00 00 02 00 1A
29 01 00 00 00 00 02 02 43
29 01 00 00 00 00 02 04 43
29 01 00 00 00 00 02 08 56
29 01 00 00 00 00 02 09 00
29 01 00 00 00 00 02 0B B3
29 01 00 00 00 00 02 0C B3
29 01 00 00 00 00 02 0D 2F
29 01 00 00 00 00 02 0E 1B
29 01 00 00 00 00 02 0F A2
29 01 00 00 00 00 02 11 7A
29 01 00 00 00 00 02 12 03
29 01 00 00 00 00 02 37 02
29 01 00 00 00 00 02 23 00
29 01 00 00 00 00 02 24 00
29 01 00 00 00 00 02 25 00
29 01 00 00 00 00 02 26 00
29 01 00 00 00 00 02 27 00
29 01 00 00 00 00 02 28 00
29 01 00 00 00 00 02 36 00
29 01 00 00 00 00 02 6F 00
29 01 00 00 00 00 02 FF 05
29 01 00 00 00 00 02 02 82
29 01 00 00 00 00 02 03 82
29 01 00 00 00 00 02 04 82
29 01 00 00 00 00 02 01 00
29 01 00 00 00 00 02 05 30
29 01 00 00 00 00 02 06 33
29 01 00 00 00 00 02 07 70
29 01 00 00 00 00 02 08 00
29 01 00 00 00 00 02 11 00
29 01 00 00 00 00 02 09 00
29 01 00 00 00 00 02 0A 01
29 01 00 00 00 00 02 0B 70
29 01 00 00 00 00 02 0D 04
29 01 00 00 00 00 02 0E 1B
29 01 00 00 00 00 02 0F 02
29 01 00 00 00 00 02 10 32
29 01 00 00 00 00 02 12 00
29 01 00 00 00 00 02 14 00
29 01 00 00 00 00 02 16 04
29 01 00 00 00 00 02 19 FF
29 01 00 00 00 00 02 1A FF
29 01 00 00 00 00 02 1B FF
29 01 00 00 00 00 02 1C 80
29 01 00 00 00 00 02 1D 00
29 01 00 00 00 00 02 1E 00
29 01 00 00 00 00 02 1F 77
29 01 00 00 00 00 02 21 20
29 01 00 00 00 00 02 22 55
29 01 00 00 00 00 02 23 0D
29 01 00 00 00 00 02 24 03
29 01 00 00 00 00 02 25 53
29 01 00 00 00 00 02 26 55
29 01 00 00 00 00 02 27 35
29 01 00 00 00 00 02 28 00
29 01 00 00 00 00 02 29 01
29 01 00 00 00 00 02 2A 11
29 01 00 00 00 00 02 2D 02
29 01 00 00 00 00 02 2F 00
29 01 00 00 00 00 02 30 11
29 01 00 00 00 00 02 31 20
29 01 00 00 00 00 02 32 09
29 01 00 00 00 00 02 35 0D
29 01 00 00 00 00 02 36 00
29 01 00 00 00 00 02 37 09
29 01 00 00 00 00 02 48 40
29 01 00 00 00 00 02 49 23
29 01 00 00 00 00 02 4A C1
29 01 00 00 00 00 02 6F 25
29 01 00 00 00 00 02 7B 00
29 01 00 00 00 00 02 7C 00
29 01 00 00 00 00 02 7D 03
29 01 00 00 00 00 02 83 00
29 01 00 00 00 00 02 8D 00
29 01 00 00 00 00 02 A4 8D
29 01 00 00 00 00 02 A6 00
29 01 00 00 00 00 02 BB 0A
29 01 00 00 00 00 02 BC 06
29 01 00 00 00 00 02 D7 61
29 01 00 00 00 00 02 D8 13
29 01 00 00 00 00 02 F5 00
29 01 00 00 00 00 02 F6 01
29 01 00 00 00 00 02 89 C1
29 01 00 00 00 00 02 91 91
29 01 00 00 00 00 02 A2 10
29 01 00 00 00 00 02 FB 01
29 01 00 00 00 00 02 FF 01
29 01 00 00 00 00 02 FB 01
29 01 00 00 00 00 02 75 00
29 01 00 00 00 00 02 76 24
29 01 00 00 00 00 02 77 00
29 01 00 00 00 00 02 78 25
29 01 00 00 00 00 02 79 00
29 01 00 00 00 00 02 7A 43
29 01 00 00 00 00 02 7B 00
29 01 00 00 00 00 02 7C 5A
29 01 00 00 00 00 02 7D 00
29 01 00 00 00 00 02 7E 8F
29 01 00 00 00 00 02 7F 00
29 01 00 00 00 00 02 80 A6
29 01 00 00 00 00 02 81 00
29 01 00 00 00 00 02 82 B9
29 01 00 00 00 00 02 83 00
29 01 00 00 00 00 02 84 C9
29 01 00 00 00 00 02 85 00
29 01 00 00 00 00 02 86 D9
29 01 00 00 00 00 02 87 01
29 01 00 00 00 00 02 88 0C
29 01 00 00 00 00 02 89 01
29 01 00 00 00 00 02 8A 30
29 01 00 00 00 00 02 8B 01
29 01 00 00 00 00 02 8C 69
29 01 00 00 00 00 02 8D 01
29 01 00 00 00 00 02 8E 91
29 01 00 00 00 00 02 8F 01
29 01 00 00 00 00 02 90 D5
29 01 00 00 00 00 02 91 02
29 01 00 00 00 00 02 92 0D
29 01 00 00 00 00 02 93 02
29 01 00 00 00 00 02 94 10
29 01 00 00 00 00 02 95 02
29 01 00 00 00 00 02 96 3F
29 01 00 00 00 00 02 97 02
29 01 00 00 00 00 02 98 77
29 01 00 00 00 00 02 99 02
29 01 00 00 00 00 02 9A 9A
29 01 00 00 00 00 02 9B 02
29 01 00 00 00 00 02 9C CF
29 01 00 00 00 00 02 9D 02
29 01 00 00 00 00 02 9E F1
29 01 00 00 00 00 02 9F 03
29 01 00 00 00 00 02 A0 1F
29 01 00 00 00 00 02 A2 03
29 01 00 00 00 00 02 A3 2E
29 01 00 00 00 00 02 A4 03
29 01 00 00 00 00 02 A5 3E
29 01 00 00 00 00 02 A6 03
29 01 00 00 00 00 02 A7 4E
29 01 00 00 00 00 02 A9 03
29 01 00 00 00 00 02 AA 5D
29 01 00 00 00 00 02 AB 03
29 01 00 00 00 00 02 AC 8B
29 01 00 00 00 00 02 AD 03
29 01 00 00 00 00 02 AE 8E
29 01 00 00 00 00 02 AF 03
29 01 00 00 00 00 02 B0 B7
29 01 00 00 00 00 02 B1 03
29 01 00 00 00 00 02 B2 E3
29 01 00 00 00 00 02 B3 00
29 01 00 00 00 00 02 B4 24
29 01 00 00 00 00 02 B5 00
29 01 00 00 00 00 02 B6 25
29 01 00 00 00 00 02 B7 00
29 01 00 00 00 00 02 B8 43
29 01 00 00 00 00 02 B9 00
29 01 00 00 00 00 02 BA 5A
29 01 00 00 00 00 02 BB 00
29 01 00 00 00 00 02 BC 8F
29 01 00 00 00 00 02 BD 00
29 01 00 00 00 00 02 BE A6
29 01 00 00 00 00 02 BF 00
29 01 00 00 00 00 02 C0 B9
29 01 00 00 00 00 02 C1 00
29 01 00 00 00 00 02 C2 C9
29 01 00 00 00 00 02 C3 00
29 01 00 00 00 00 02 C4 D9
29 01 00 00 00 00 02 C5 01
29 01 00 00 00 00 02 C6 0C
29 01 00 00 00 00 02 C7 01
29 01 00 00 00 00 02 C8 30
29 01 00 00 00 00 02 C9 01
29 01 00 00 00 00 02 CA 69
29 01 00 00 00 00 02 CB 01
29 01 00 00 00 00 02 CC 91
29 01 00 00 00 00 02 CD 01
29 01 00 00 00 00 02 CE D5
29 01 00 00 00 00 02 CF 02
29 01 00 00 00 00 02 D0 0D
29 01 00 00 00 00 02 D1 02
29 01 00 00 00 00 02 D2 10
29 01 00 00 00 00 02 D3 02
29 01 00 00 00 00 02 D4 3F
29 01 00 00 00 00 02 D5 02
29 01 00 00 00 00 02 D6 77
29 01 00 00 00 00 02 D7 02
29 01 00 00 00 00 02 D8 9A
29 01 00 00 00 00 02 D9 02
29 01 00 00 00 00 02 DA CF
29 01 00 00 00 00 02 DB 02
29 01 00 00 00 00 02 DC F1
29 01 00 00 00 00 02 DD 03
29 01 00 00 00 00 02 DE 1F
29 01 00 00 00 00 02 DF 03
29 01 00 00 00 00 02 E0 2E
29 01 00 00 00 00 02 E1 03
29 01 00 00 00 00 02 E2 3E
29 01 00 00 00 00 02 E3 03
29 01 00 00 00 00 02 E4 4E
29 01 00 00 00 00 02 E5 03
29 01 00 00 00 00 02 E6 5D
29 01 00 00 00 00 02 E7 03
29 01 00 00 00 00 02 E8 8B
29 01 00 00 00 00 02 E9 03
29 01 00 00 00 00 02 EA 8E
29 01 00 00 00 00 02 EB 03
29 01 00 00 00 00 02 EC B7
29 01 00 00 00 00 02 ED 03
29 01 00 00 00 00 02 EE E3
29 01 00 00 00 00 02 EF 00
29 01 00 00 00 00 02 F0 F5
29 01 00 00 00 00 02 F1 00
29 01 00 00 00 00 02 F2 FB
29 01 00 00 00 00 02 F3 01
29 01 00 00 00 00 02 F4 08
29 01 00 00 00 00 02 F5 01
29 01 00 00 00 00 02 F6 13
29 01 00 00 00 00 02 F7 01
29 01 00 00 00 00 02 F8 1B
29 01 00 00 00 00 02 F9 01
29 01 00 00 00 00 02 FA 24
29 01 00 00 00 00 02 FF 02
29 01 00 00 00 00 02 FB 01
29 01 00 00 00 00 02 00 01
29 01 00 00 00 00 02 01 2C
29 01 00 00 00 00 02 02 01
29 01 00 00 00 00 02 03 34
29 01 00 00 00 00 02 04 01
29 01 00 00 00 00 02 05 3B
29 01 00 00 00 00 02 06 01
29 01 00 00 00 00 02 07 55
29 01 00 00 00 00 02 08 01
29 01 00 00 00 00 02 09 6C
29 01 00 00 00 00 02 0A 01
29 01 00 00 00 00 02 0B 93
29 01 00 00 00 00 02 0C 01
29 01 00 00 00 00 02 0D B5
29 01 00 00 00 00 02 0E 01
29 01 00 00 00 00 02 0F EC
29 01 00 00 00 00 02 10 02
29 01 00 00 00 00 02 11 1B
29 01 00 00 00 00 02 12 02
29 01 00 00 00 00 02 13 1C
29 01 00 00 00 00 02 14 02
29 01 00 00 00 00 02 15 4B
29 01 00 00 00 00 02 16 02
29 01 00 00 00 00 02 17 82
29 01 00 00 00 00 02 18 02
29 01 00 00 00 00 02 19 A7
29 01 00 00 00 00 02 1A 02
29 01 00 00 00 00 02 1B D9
29 01 00 00 00 00 02 1C 02
29 01 00 00 00 00 02 1D FC
29 01 00 00 00 00 02 1E 03
29 01 00 00 00 00 02 1F 2A
29 01 00 00 00 00 02 20 03
29 01 00 00 00 00 02 21 38
29 01 00 00 00 00 02 22 03
29 01 00 00 00 00 02 23 47
29 01 00 00 00 00 02 24 03
29 01 00 00 00 00 02 25 59
29 01 00 00 00 00 02 26 03
29 01 00 00 00 00 02 27 65
29 01 00 00 00 00 02 28 03
29 01 00 00 00 00 02 29 91
29 01 00 00 00 00 02 2A 03
29 01 00 00 00 00 02 2B AF
29 01 00 00 00 00 02 2D 03
29 01 00 00 00 00 02 2F EF
29 01 00 00 00 00 02 30 03
29 01 00 00 00 00 02 31 F5
29 01 00 00 00 00 02 32 00
29 01 00 00 00 00 02 33 F5
29 01 00 00 00 00 02 34 00
29 01 00 00 00 00 02 35 FB
29 01 00 00 00 00 02 36 01
29 01 00 00 00 00 02 37 08
29 01 00 00 00 00 02 38 01
29 01 00 00 00 00 02 39 13
29 01 00 00 00 00 02 3A 01
29 01 00 00 00 00 02 3B 1B
29 01 00 00 00 00 02 3D 01
29 01 00 00 00 00 02 3F 24
29 01 00 00 00 00 02 40 01
29 01 00 00 00 00 02 41 2C
29 01 00 00 00 00 02 42 01
29 01 00 00 00 00 02 43 34
29 01 00 00 00 00 02 44 01
29 01 00 00 00 00 02 45 3B
29 01 00 00 00 00 02 46 01
29 01 00 00 00 00 02 47 55
29 01 00 00 00 00 02 48 01
29 01 00 00 00 00 02 49 6C
29 01 00 00 00 00 02 4A 01
29 01 00 00 00 00 02 4B 93
29 01 00 00 00 00 02 4C 01
29 01 00 00 00 00 02 4D B5
29 01 00 00 00 00 02 4E 01
29 01 00 00 00 00 02 4F EC
29 01 00 00 00 00 02 50 02
29 01 00 00 00 00 02 51 1B
29 01 00 00 00 00 02 52 02
29 01 00 00 00 00 02 53 1C
29 01 00 00 00 00 02 54 02
29 01 00 00 00 00 02 55 4B
29 01 00 00 00 00 02 56 02
29 01 00 00 00 00 02 58 82
29 01 00 00 00 00 02 59 02
29 01 00 00 00 00 02 5A A7
29 01 00 00 00 00 02 5B 02
29 01 00 00 00 00 02 5C D9
29 01 00 00 00 00 02 5D 02
29 01 00 00 00 00 02 5E FC
29 01 00 00 00 00 02 5F 03
29 01 00 00 00 00 02 60 2A
29 01 00 00 00 00 02 61 03
29 01 00 00 00 00 02 62 38
29 01 00 00 00 00 02 63 03
29 01 00 00 00 00 02 64 47
29 01 00 00 00 00 02 65 03
29 01 00 00 00 00 02 66 59
29 01 00 00 00 00 02 67 03
29 01 00 00 00 00 02 68 65
29 01 00 00 00 00 02 69 03
29 01 00 00 00 00 02 6A 91
29 01 00 00 00 00 02 6B 03
29 01 00 00 00 00 02 6C AF
29 01 00 00 00 00 02 6D 03
29 01 00 00 00 00 02 6E EF
29 01 00 00 00 00 02 6F 03
29 01 00 00 00 00 02 70 F5
29 01 00 00 00 00 02 71 00
29 01 00 00 00 00 02 72 01
29 01 00 00 00 00 02 73 00
29 01 00 00 00 00 02 74 02
29 01 00 00 00 00 02 75 00
29 01 00 00 00 00 02 76 41
29 01 00 00 00 00 02 77 00
29 01 00 00 00 00 02 78 6C
29 01 00 00 00 00 02 79 00
29 01 00 00 00 00 02 7A 88
29 01 00 00 00 00 02 7B 00
29 01 00 00 00 00 02 7C 9E
29 01 00 00 00 00 02 7D 00
29 01 00 00 00 00 02 7E B1
29 01 00 00 00 00 02 7F 00
29 01 00 00 00 00 02 80 C1
29 01 00 00 00 00 02 81 00
29 01 00 00 00 00 02 82 CF
29 01 00 00 00 00 02 83 01
29 01 00 00 00 00 02 84 02
29 01 00 00 00 00 02 85 01
29 01 00 00 00 00 02 86 26
29 01 00 00 00 00 02 87 01
29 01 00 00 00 00 02 88 60
29 01 00 00 00 00 02 89 01
29 01 00 00 00 00 02 8A 8C
29 01 00 00 00 00 02 8B 01
29 01 00 00 00 00 02 8C D2
29 01 00 00 00 00 02 8D 02
29 01 00 00 00 00 02 8E 09
29 01 00 00 00 00 02 8F 02
29 01 00 00 00 00 02 90 0B
29 01 00 00 00 00 02 91 02
29 01 00 00 00 00 02 92 3D
29 01 00 00 00 00 02 93 02
29 01 00 00 00 00 02 94 76
29 01 00 00 00 00 02 95 02
29 01 00 00 00 00 02 96 9B
29 01 00 00 00 00 02 97 02
29 01 00 00 00 00 02 98 D0
29 01 00 00 00 00 02 99 02
29 01 00 00 00 00 02 9A F6
29 01 00 00 00 00 02 9B 03
29 01 00 00 00 00 02 9C 2D
29 01 00 00 00 00 02 9D 03
29 01 00 00 00 00 02 9E 40
29 01 00 00 00 00 02 9F 03
29 01 00 00 00 00 02 A0 5A
29 01 00 00 00 00 02 A2 03
29 01 00 00 00 00 02 A3 7F
29 01 00 00 00 00 02 A4 03
29 01 00 00 00 00 02 A5 FA
29 01 00 00 00 00 02 A6 03
29 01 00 00 00 00 02 A7 FB
29 01 00 00 00 00 02 A9 03
29 01 00 00 00 00 02 AA FE
29 01 00 00 00 00 02 AB 03
29 01 00 00 00 00 02 AC FE
29 01 00 00 00 00 02 AD 03
29 01 00 00 00 00 02 AE FE
29 01 00 00 00 00 02 AF 00
29 01 00 00 00 00 02 B0 01
29 01 00 00 00 00 02 B1 00
29 01 00 00 00 00 02 B2 02
29 01 00 00 00 00 02 B3 00
29 01 00 00 00 00 02 B4 41
29 01 00 00 00 00 02 B5 00
29 01 00 00 00 00 02 B6 6C
29 01 00 00 00 00 02 B7 00
29 01 00 00 00 00 02 B8 88
29 01 00 00 00 00 02 B9 00
29 01 00 00 00 00 02 BA 9E
29 01 00 00 00 00 02 BB 00
29 01 00 00 00 00 02 BC B1
29 01 00 00 00 00 02 BD 00
29 01 00 00 00 00 02 BE C1
29 01 00 00 00 00 02 BF 00
29 01 00 00 00 00 02 C0 CF
29 01 00 00 00 00 02 C1 01
29 01 00 00 00 00 02 C2 02
29 01 00 00 00 00 02 C3 01
29 01 00 00 00 00 02 C4 26
29 01 00 00 00 00 02 C5 01
29 01 00 00 00 00 02 C6 60
29 01 00 00 00 00 02 C7 01
29 01 00 00 00 00 02 C8 8C
29 01 00 00 00 00 02 C9 01
29 01 00 00 00 00 02 CA D2
29 01 00 00 00 00 02 CB 02
29 01 00 00 00 00 02 CC 09
29 01 00 00 00 00 02 CD 02
29 01 00 00 00 00 02 CE 0B
29 01 00 00 00 00 02 CF 02
29 01 00 00 00 00 02 D0 3D
29 01 00 00 00 00 02 D1 02
29 01 00 00 00 00 02 D2 76
29 01 00 00 00 00 02 D3 02
29 01 00 00 00 00 02 D4 9B
29 01 00 00 00 00 02 D5 02
29 01 00 00 00 00 02 D6 D0
29 01 00 00 00 00 02 D7 02
29 01 00 00 00 00 02 D8 F6
29 01 00 00 00 00 02 D9 03
29 01 00 00 00 00 02 DA 2D
29 01 00 00 00 00 02 DB 03
29 01 00 00 00 00 02 DC 40
29 01 00 00 00 00 02 DD 03
29 01 00 00 00 00 02 DE 5A
29 01 00 00 00 00 02 DF 03
29 01 00 00 00 00 02 E0 7F
29 01 00 00 00 00 02 E1 03
29 01 00 00 00 00 02 E2 FA
29 01 00 00 00 00 02 E3 03
29 01 00 00 00 00 02 E4 FB
29 01 00 00 00 00 02 E5 03
29 01 00 00 00 00 02 E6 FE
29 01 00 00 00 00 02 E7 03
29 01 00 00 00 00 02 E8 FE
29 01 00 00 00 00 02 E9 03
29 01 00 00 00 00 02 EA FE
29 01 00 00 00 00 02 FF 03
29 01 00 00 00 00 02 56 00
29 01 00 00 00 00 02 68 00
29 01 00 00 00 00 02 1A 07
29 01 00 00 00 00 02 FB 01
29 01 00 00 00 00 02 FF 00
39 01 00 00 01 00 02 51 ff
29 01 00 00 01 00 02 55 93
15 01 00 00 01 00 02 53 2c
29 01 00 00 00 00 02 35 00 
29 01 00 00 00 00 02 FF 01
29 01 00 00 00 00 02 FB 01
29 01 00 00 00 00 02 36 7B
29 01 00 00 00 00 02 6D 33
29 01 00 00 00 00 02 6F 03
29 01 00 00 00 00 02 FF 00
29 01 00 00 96 00 02 11 00 
29 01 00 00 40 00 02 29 00 ];
		qcom,mdss-dsi-off-command = [05 01 00 00 78 00 02 10 00];
		qcom,mdss-dsi-on-command-state = "dsi_lp_mode";
		qcom,mdss-dsi-off-command-state = "dsi_hs_mode";
		/*caven.han add begin for CABC*/
		qcom,mdss-dsi-cabc-off-command = [15 01 00 00 10 00 02 55 90
										05 01 00 00 10 00 02 29 00];
		qcom,mdss-dsi-cabc-ui-command = [15 01 00 00 10 00 02 55 B1
										05 01 00 00 10 00 02 29 00];
		qcom,mdss-dsi-cabc-still-image-command = [15 01 00 00 10 00 02 55 B2
												  05 01 00 00 10 00 02 29 00];
		qcom,mdss-dsi-cabc-video-command = [15 01 00 00 10 00 02 55 93
										    05 01 00 00 10 00 02 29 00];
		/*caven.han add end*/
		qcom,mdss-dsi-panel-status-command = [06 01 00 01 05 00 02 0A 08];
		qcom,mdss-dsi-panel-status-command-state = "dsi_lp_mode";
		qcom,mdss-dsi-panel-status-check-mode = "reg_read";
		qcom,mdss-dsi-panel-status-value = <0x9C>;
		qcom,mdss-dsi-h-sync-pulse = <1>;
		qcom,mdss-dsi-traffic-mode = "burst_mode";
		qcom,mdss-dsi-lane-map = <0>;
		qcom,mdss-dsi-bllp-eof-power-mode;
		qcom,mdss-dsi-bllp-power-mode;
		qcom,mdss-dsi-lane-0-state;
		qcom,mdss-dsi-lane-1-state;
		qcom,mdss-dsi-lane-2-state;
		qcom,mdss-dsi-lane-3-state;
	//	qcom,mdss-dsi-panel-timings = [7d 25 1d 00 37 33 22 27 1e 03 04 00];
		qcom,mdss-dsi-panel-timings = [83 1E 1C 00 44 7C 1C 22 19 03 04 00];
		qcom,mdss-dsi-t-clk-post = <0x20>;
		qcom,mdss-dsi-t-clk-pre = <0x2c>;
		qcom,mdss-dsi-bl-min-level = <1>;
		qcom,mdss-dsi-bl-max-level = <255>;
		qcom,mdss-dsi-dma-trigger = <4>;
		qcom,mdss-dsi-mdp-trigger = <0>;
		qcom,mdss-dsi-bl-pmic-control-type = "bl_ctrl_wled";
		qcom,mdss-dsi-reset-sequence = <1 10>, <0 1>, <1 15>;
		qcom,mdss-pan-physical-width-dimension = <59>;
		qcom,mdss-pan-physical-height-dimension = <104>;

	};
};
