/* Copyright (c) 2013, The Linux Foundation. All rights reserved.
 *
 * This program is free software; you can redistribute it and/or modify
 * it under the terms of the GNU General Public License version 2 and
 * only version 2 as published by the Free Software Foundation.
 *
 * This program is distributed in the hope that it will be useful,
 * but WITHOUT ANY WARRANTY; without even the implied warranty of
 * MERCHANTABILITY or FITNESS FOR A PARTICULAR PURPOSE.  See the
 * GNU General Public License for more details.
 */

/*---------------------------------------------------------------------------
 * This file is autogenerated file using gcdb parser. Please do not edit it.
 * Update input XML file to add a new entry or update variable in this file
 * VERSION = "1.0"
 *---------------------------------------------------------------------------*/
&mdss_mdp {
	dsi_oppo15009tm_nt35521_720p_vid: qcom,mdss_dsi_oppo15009tm_nt35521_720p_video {
		qcom,mdss-dsi-panel-name = "oppo15009tm nt35521 720p video mode dsi panel";
		qcom,mdss-dsi-panel-manufacture = "Tianma";
		qcom,mdss-dsi-panel-version = "NT35521";
		qcom,mdss-dsi-panel-controller = <&mdss_dsi0>;
		qcom,mdss-dsi-panel-type = "dsi_video_mode";
		qcom,mdss-dsi-panel-destination = "display_1";
		qcom,mdss-dsi-panel-framerate = <61>;
		qcom,mdss-dsi-virtual-channel-id = <0>;
		qcom,mdss-dsi-stream = <0>;
		qcom,mdss-dsi-panel-width = <720>;
		qcom,mdss-dsi-panel-height = <1280>;
		qcom,mdss-dsi-h-front-porch = <152>;	/*140->152 MIPI-246MHz*/
		qcom,mdss-dsi-h-back-porch = <164>;
		qcom,mdss-dsi-h-pulse-width = <8>;
		qcom,mdss-dsi-h-sync-skew = <0>;
		qcom,mdss-dsi-v-back-porch = <3>;
		qcom,mdss-dsi-v-front-porch = <6>;
		qcom,mdss-dsi-v-pulse-width = <1>;
		qcom,mdss-dsi-h-left-border = <0>;
		qcom,mdss-dsi-h-right-border = <0>;
		qcom,mdss-dsi-v-top-border = <0>;
		qcom,mdss-dsi-v-bottom-border = <0>;
		qcom,mdss-dsi-bpp = <24>;
		qcom,mdss-dsi-color-order = <0>;
		qcom,mdss-dsi-underflow-color = <0xff>;
		qcom,mdss-dsi-border-color = <0>;
		qcom,mdss-dsi-on-command = [29 01 00 00 00 00 06 F0 55 AA 52 08 00
			29 01 00 00 00 00 02 C8 83
			29 01 00 00 00 00 06 F0 55 AA 52 08 02
			29 01 00 00 00 00 02 EE 03
			29 01 00 00 00 00 11 B0 00 11 00 45 00 57 00 66 00 74 00 8C 00 A4 00 CD
			29 01 00 00 00 00 11 B1 00 ED 01 22 01 50 01 94 01 CC 01 CD 02 04 02 3D
			29 01 00 00 00 00 11 B2 02 62 02 94 02 BB 02 EC 03 0E 03 3C 03 58 03 7D
			29 01 00 00 00 00 05 B3 03 C1 03 FF
			29 01 00 00 00 00 11 B4 00 55 00 56 00 69 00 79 00 87 00 A0 00 B5 00 D9
			29 01 00 00 00 00 11 B5 00 F9 01 2B 01 54 01 98 01 CF 01 D1 02 05 02 41
			29 01 00 00 00 00 11 B6 02 64 02 96 02 BB 02 EC 03 0C 03 39 03 55 03 78
			29 01 00 00 00 00 05 B7 03 A5 03 FF
			29 01 00 00 00 00 11 B8 00 01 00 02 00 03 00 17 00 30 00 57 00 77 00 A9
			29 01 00 00 78 00 11 B9 00 CF 01 0E 01 3D 01 8A 01 C5 01 C7 01 FE 02 3B
			29 01 00 00 32 00 11 BA 02 60 02 92 02 B9 02 EB 03 0D 03 3C 03 59 03 80
			29 01 00 00 00 00 05 BB 03 C0 03 FF
			29 01 00 00 00 00 06 F0 55 AA 52 08 00
			29 01 00 00 00 00 11 CC 40 36 87 00 00 00 00 00 00 00 00 00 40 08 A5 05
			29 01 00 00 00 00 11 D1 00 01 02 04 06 08 10 16 18 18 16 14 12 0E 08 00
			29 01 00 00 00 00 0D D7 02 02 01 01 20 20 20 20 20 20 20 20
			29 01 00 00 00 00 0E D8 00 00 00 00 00 00 00 00 00 00 00 01 01
			29 01 00 00 00 00 03 D9 01 FF
			29 01 00 00 00 00 06 F0 55 AA 52 00 00
			29 01 00 00 00 00 02 51 7F
			29 01 00 00 00 00 02 53 24
			29 01 00 00 00 00 02 55 80
			29 01 00 00 00 00 02 35 00
			15 01 00 00 78 00 02 11 00
			15 01 00 00 32 00 02 29 00];
		qcom,mdss-dsi-off-command = [05 01 00 00 32 00 02 28 00
					05 01 00 00 78 00 02 10 00];
		qcom,mdss-dsi-on-command-state = "dsi_lp_mode";
		qcom,mdss-dsi-off-command-state = "dsi_hs_mode";
		qcom,mdss-dsi-panel-status-command = [06 01 00 01 05 00 02 0A 08];
		qcom,mdss-dsi-panel-status-command-state = "dsi_lp_mode";
		qcom,mdss-dsi-panel-status-check-mode = "reg_read";
		qcom,mdss-dsi-panel-status-value = <0x9C>;
		qcom,mdss-dsi-h-sync-pulse = <1>;
		qcom,mdss-dsi-traffic-mode = "burst_mode";
		qcom,mdss-dsi-lane-map = <0>;
		qcom,mdss-dsi-bllp-eof-power-mode;
		qcom,mdss-dsi-bllp-power-mode;
		qcom,mdss-dsi-lane-0-state;
		qcom,mdss-dsi-lane-1-state;
		qcom,mdss-dsi-lane-2-state;
		qcom,mdss-dsi-lane-3-state;
	//	qcom,mdss-dsi-panel-timings = [7d 25 1d 00 37 33 22 27 1e 03 04 00];
		qcom,mdss-dsi-panel-timings = [8B 1E 14 00 44 48 18 22 19 03 04 00];
		qcom,mdss-dsi-t-clk-post = <0x04>; /* 0x20->0x04 */
		qcom,mdss-dsi-t-clk-pre = <0x1c>;  /* 0x2c->0x1c */
		qcom,mdss-dsi-bl-min-level = <1>;
		qcom,mdss-dsi-bl-max-level = <255>;
		qcom,mdss-dsi-dma-trigger = <4>;
		qcom,mdss-dsi-mdp-trigger = <0>;
		qcom,mdss-dsi-bl-pmic-control-type = "bl_ctrl_wled";
		qcom,mdss-dsi-reset-sequence = <1 10>, <0 1>, <1 15>;
		qcom,mdss-pan-physical-width-dimension = <59>;
		qcom,mdss-pan-physical-height-dimension = <104>;
		qcom,mdss-dsi-lp11-init = <1>;
	};
};
