/* Copyright (c) 2013-2014, The Linux Foundation. All rights reserved.
 *
 * This program is free software; you can redistribute it and/or modify
 * it under the terms of the GNU General Public License version 2 and
 * only version 2 as published by the Free Software Foundation.
 *
 * This program is distributed in the hope that it will be useful,
 * but WITHOUT ANY WARRANTY; without even the implied warranty of
 * MERCHANTABILITY or FITNESS FOR A PARTICULAR PURPOSE.  See the
 * GNU General Public License for more details.
 */

&mdss_mdp {
	dsi_oppo15037tm_otm9605a_540p_vid: qcom,mdss_dsi_oppo15037tm_otm9605a_540p_video {
		qcom,cont-splash-enabled;
		qcom,mdss-dsi-panel-name = "oppo15037tm otm9605a 540p video video mode dsi panel";
		qcom,mdss-dsi-panel-manufacture = "Tianma";
		qcom,mdss-dsi-panel-version = "OTM9605A";		
		qcom,mdss-dsi-panel-controller = <&mdss_dsi0>;
		qcom,mdss-dsi-panel-type = "dsi_video_mode";
		qcom,mdss-dsi-panel-destination = "display_1";
		qcom,mdss-dsi-panel-framerate = <60>;
		qcom,mdss-dsi-virtual-channel-id = <0>;
		qcom,mdss-dsi-stream = <0>;
		qcom,mdss-dsi-panel-width = <540>;
		qcom,mdss-dsi-panel-height = <960>;
		qcom,mdss-dsi-h-front-porch = <50>;
		qcom,mdss-dsi-h-back-porch = <48>;
		qcom,mdss-dsi-h-pulse-width = <8>;
		qcom,mdss-dsi-h-sync-skew = <0>;
		qcom,mdss-dsi-v-back-porch = <14>;
		qcom,mdss-dsi-v-front-porch = <16>;
		qcom,mdss-dsi-v-pulse-width = <1>;
		qcom,mdss-dsi-h-left-border = <0>;
		qcom,mdss-dsi-h-right-border = <0>;
		qcom,mdss-dsi-v-top-border = <0>;
		qcom,mdss-dsi-v-bottom-border = <0>;
		qcom,mdss-dsi-bpp = <24>;
		qcom,mdss-dsi-color-order = <0>;
		qcom,mdss-dsi-underflow-color = <0xff>;
		qcom,mdss-dsi-border-color = <0>;
		qcom,mdss-dsi-on-command = [39 01 00 00 00 00 02 00 00
39 01 00 00 00 00 04 FF 96 05 01
39 01 00 00 00 00 02 00 80
39 01 00 00 00 00 03 FF 96 05
39 01 00 00 00 00 02 00 00
39 01 00 00 00 00 02 A0 00
39 01 00 00 00 00 02 00 B4
39 01 00 00 00 00 02 C0 50
39 01 00 00 00 00 02 00 80
39 01 00 00 00 00 03 C1 36 66
39 01 00 00 00 00 02 00 89
39 01 00 00 00 00 02 C0 01
39 01 00 00 00 00 02 00 80
39 01 00 00 00 00 02 C4 9C
39 01 00 00 00 00 02 00 A0
39 01 00 00 00 00 02 C1 02
39 01 00 00 00 00 02 00 C0
39 01 00 00 00 00 02 C5 00
39 01 00 00 00 00 02 00 C5
39 01 00 00 00 00 02 B0 03
39 01 00 00 00 00 02 00 90
39 01 00 00 00 00 08 C5 96 16 01 79 55 55 34
39 01 00 00 00 00 02 00 A0
39 01 00 00 00 00 08 C5 96 16 00 79 33 33 34
39 01 00 00 00 00 02 00 00
39 01 00 00 00 00 03 D8 67 67
39 01 00 00 00 00 02 00 B0
39 01 00 00 00 00 03 C5 04 28
39 01 00 00 00 00 02 00 80
39 01 00 00 00 00 0B CB 05 00 00 00 00 05 00 00 00 00
39 01 00 00 00 00 02 00 90
39 01 00 00 00 00 10 CB 55 55 00 00 00 00 00 00 00 00 00 00 00 00 00
39 01 00 00 00 00 02 00 A0
39 01 00 00 00 00 10 CB 00 00 00 00 00 55 55 00 00 00 00 00 00 00 00
39 01 00 00 00 00 02 00 B0
39 01 00 00 00 00 0B CB 00 00 00 00 00 00 00 00 00 00
39 01 00 00 00 00 02 00 C0
39 01 00 00 00 00 10 CB 55 55 00 00 00 04 00 04 00 04 00 04 04 04 00
39 01 00 00 00 00 02 00 D0
39 01 00 00 00 00 10 CB 04 00 00 00 00 55 55 00 00 00 04 00 04 00 04
39 01 00 00 00 00 02 00 E0
39 01 00 00 00 00 0B CB 00 04 04 04 00 04 00 00 00 00
39 01 00 00 00 00 02 00 F0
39 01 00 00 00 00 0B CB 0F 00 CC 00 00 0F 00 CC C3 00
39 01 00 00 00 00 02 00 80
39 01 00 00 00 00 0B CC 25 26 00 00 00 0C 00 0A 00 10
39 01 00 00 00 00 02 00 90
39 01 00 00 00 00 10 CC 00 0E 02 04 00 06 00 00 00 00 25 26 00 00 00
39 01 00 00 00 00 02 00 A0
39 01 00 00 00 00 10 CC 0B 00 09 00 0F 00 0D 01 03 00 05 00 00 00 00
39 01 00 00 00 00 02 00 B0
39 01 00 00 00 00 0B CC 26 25 00 00 00 0D 00 0F 00 09
39 01 00 00 00 00 02 00 C0
39 01 00 00 00 00 10 CC 00 0B 03 01 00 05 00 00 00 00 26 25 00 00 00
39 01 00 00 00 00 02 00 D0
39 01 00 00 00 00 10 CC 0E 00 10 00 0A 00 0C 04 02 00 06 00 00 00 00
39 01 00 00 00 00 02 00 80
39 01 00 00 00 00 0D CE 8B 03 38 8A 03 38 89 03 38 88 03 38
39 01 00 00 00 00 02 00 90
39 01 00 00 00 00 0F CE 38 10 38 38 0F 38 00 00 00 00 00 00 00 00
39 01 00 00 00 00 02 00 A0
39 01 00 00 00 00 0F CE 38 07 03 C0 00 38 00 38 06 03 C1 00 38 00
39 01 00 00 00 00 02 00 B0
39 01 00 00 00 00 0F CE 38 05 03 C2 00 38 00 38 04 03 C3 00 38 00
39 01 00 00 00 00 02 00 C0
39 01 00 00 00 00 0F CE 38 03 03 C4 00 38 00 38 02 03 C5 00 38 00
39 01 00 00 00 00 02 00 D0
39 01 00 00 00 00 0F CE 38 01 03 C6 00 38 00 38 00 03 C7 00 38 00
39 01 00 00 00 00 02 00 80
39 01 00 00 00 00 0F CF F0 00 00 10 00 00 00 F0 00 00 10 00 00 00
39 01 00 00 00 00 02 00 90
39 01 00 00 00 00 0F CF F0 00 00 10 00 00 00 F0 00 00 10 00 00 00
39 01 00 00 00 00 02 00 A0
39 01 00 00 00 00 0F CF F0 00 00 10 00 00 00 F0 00 00 10 00 00 00
39 01 00 00 00 00 02 00 B0
39 01 00 00 00 00 0F CF F0 00 00 10 00 00 00 F0 00 00 10 00 00 00
39 01 00 00 00 00 02 00 C0
39 01 00 00 00 00 0B CF 01 01 20 20 00 00 02 01 00 00
39 01 00 00 00 00 02 00 00
39 01 00 00 00 00 11 E1 0F 19 1F 0E 07 0F 0A 09 04 08 0D 08 0E 0A 06 04
39 01 00 00 00 00 02 00 00
39 01 00 00 00 00 11 E2 0F 19 1F 0E 07 0F 0A 09 04 08 0D 08 0E 0A 06 04
39 01 00 00 00 00 02 00 80
39 01 00 00 00 00 02 D6 38
39 01 00 00 00 00 02 00 00
39 01 00 00 00 00 22 EC 40 44 44 44 44 44 44 44 34 44 44 44 44 44 44 44 44 44 44 44 44 44 44 44 34 44 44 44 44 44 44 44 04
39 01 00 00 00 00 02 00 00
39 01 00 00 00 00 22 ED 40 34 44 34 44 44 43 44 34 44 34 44 44 43 44 43 44 34 44 34 44 44 43 44 34 44 34 44 44 43 44 43 04
39 01 00 00 00 00 02 00 00
39 01 00 00 00 00 22 EE 40 44 44 44 44 44 44 44 44 44 44 44 44 44 44 44 44 44 44 44 44 44 44 44 44 44 44 44 44 44 44 44 04
39 01 00 00 00 00 02 00 80
39 01 00 00 0A 00 02 C4 9C
39 01 00 00 00 00 02 00 87
39 01 00 00 0A 00 02 C4 40
39 01 00 00 00 00 02 00 B1
39 01 00 00 00 00 02 C5 28
39 01 00 00 00 00 02 00 C0
39 01 00 00 00 00 02 C5 00
39 01 00 00 00 00 02 00 B2
39 01 00 00 00 00 05 F5 15 00 15 00
39 01 00 00 00 00 02 00 93
39 01 00 00 00 00 04 C5 03 55 55
39 01 00 00 00 00 02 00 89
39 01 00 00 00 00 02 C5 01
39 01 00 00 00 00 02 00 C5
39 01 00 00 00 00 02 B0 03
39 01 00 00 00 00 02 00 D2
39 01 00 00 00 00 02 B0 04
39 01 00 00 00 00 02 00 80
39 01 00 00 00 00 1D CA 80 61 6A 71 7A 81 8A 91 9A A2 AA B2 BB C2 C2 C2 C3 FF C3 FF C3 FF 05 03 05 03 05 03
39 01 00 00 00 00 02 00 00
39 01 00 00 00 00 02 C7 10
39 01 00 00 00 00 13 C8 80 99 99 99 A9 AA 99 99 99 99 99 99 89 78 67 56 45 33
39 01 00 00 00 00 02 00 00
39 01 00 00 00 00 02 C7 11
39 01 00 00 00 00 13 C8 80 99 99 99 A9 AA 99 99 99 99 99 99 89 78 67 56 45 33
39 01 00 00 00 00 02 00 00
39 01 00 00 00 00 02 C7 12
39 01 00 00 00 00 13 C8 80 99 99 99 99 9A 99 99 99 99 99 99 88 88 77 66 45 33
39 01 00 00 00 00 02 00 00
39 01 00 00 00 00 02 C7 13
39 01 00 00 00 00 13 C8 80 99 99 99 99 89 99 99 99 99 99 99 88 88 78 67 45 33
39 01 00 00 00 00 02 00 00
39 01 00 00 00 00 02 C7 14
39 01 00 00 00 00 13 C8 80 99 99 99 99 88 99 99 99 99 99 89 88 88 88 77 45 33
39 01 00 00 00 00 02 00 00
39 01 00 00 00 00 02 C7 15
39 01 00 00 00 00 13 C8 80 99 99 99 99 88 98 99 89 99 99 89 88 88 88 78 46 33
39 01 00 00 00 00 02 00 00
39 01 00 00 00 00 02 C7 16
39 01 00 00 00 00 13 C8 80 99 99 99 89 88 98 99 89 98 99 89 88 88 88 78 56 34
39 01 00 00 00 00 02 00 00
39 01 00 00 00 00 02 C7 17
39 01 00 00 00 00 13 C8 80 99 99 99 89 88 88 98 99 88 99 89 88 88 88 88 57 34
39 01 00 00 00 00 02 00 00
39 01 00 00 00 00 02 C7 18
39 01 00 00 00 00 13 C8 80 99 99 99 89 88 88 88 98 99 99 88 88 88 88 77 67 45
39 01 00 00 00 00 02 00 00
39 01 00 00 00 00 02 C7 19
39 01 00 00 00 00 13 C8 80 99 99 99 89 88 88 88 88 98 99 88 88 88 88 88 67 45
39 01 00 00 00 00 02 00 00
39 01 00 00 00 00 02 C7 1A
39 01 00 00 00 00 13 C8 80 99 99 99 88 88 88 88 88 88 99 88 88 88 88 88 77 55
39 01 00 00 00 00 02 00 00
39 01 00 00 00 00 02 C7 1B
39 01 00 00 00 00 13 C8 80 99 99 89 88 88 88 88 88 98 88 88 88 88 88 88 77 57
39 01 00 00 00 00 02 00 00
39 01 00 00 00 00 02 C7 1C
39 01 00 00 00 00 13 C8 80 99 99 88 88 88 88 88 88 98 88 88 88 88 88 88 88 56
39 01 00 00 00 00 02 00 00
39 01 00 00 00 00 02 C7 1D
39 01 00 00 00 00 13 C8 80 88 88 88 88 88 88 88 88 88 88 88 88 88 88 88 88 88
39 01 00 00 00 00 02 00 00
39 01 00 00 00 00 02 C7 00
39 01 00 00 00 00 02 00 B1
39 01 00 00 00 00 02 C6 09
39 01 00 00 00 00 02 00 B4
39 01 00 00 00 00 02 C6 12
39 01 00 00 00 00 02 51 FF
39 01 00 00 00 00 02 53 2C
39 01 00 00 00 00 02 55 01
39 01 00 00 00 00 02 00 00
39 01 00 00 00 00 04 FF FF FF FF
39 01 00 00 01 00 02 35 00
05 01 00 00 78 00 02 11 00
05 01 00 00 32 00 02 29 00];
		qcom,mdss-dsi-off-command = [05 01 00 00 32 00 02 28 00
					05 01 00 00 78 00 02 10 00];
		qcom,mdss-dsi-on-command-state = "dsi_lp_mode";
		qcom,mdss-dsi-off-command-state = "dsi_hs_mode";
		qcom,mdss-dsi-panel-status-command = [06 01 00 01 05 00 02 0A 08];
		qcom,mdss-dsi-panel-status-command-state = "dsi_lp_mode";
		qcom,mdss-dsi-panel-status-check-mode = "reg_read";
		qcom,mdss-dsi-panel-status-value = <0x9C>;
		qcom,mdss-dsi-h-sync-pulse = <1>;
		qcom,mdss-dsi-traffic-mode = "burst_mode";
		qcom,mdss-dsi-lane-map = <0>;
		qcom,mdss-dsi-bllp-eof-power-mode;
		qcom,mdss-dsi-bllp-power-mode;
		qcom,mdss-dsi-lane-0-state;
		qcom,mdss-dsi-lane-1-state;
		qcom,mdss-dsi-lp11-init;
		qcom,mdss-dsi-init-delay-us=<50000>;
		qcom,mdss-dsi-panel-timings = [87 1C 12 00 42 44 18 20 17 03 04 00];
		qcom,mdss-dsi-t-clk-post = <0x04>;
		qcom,mdss-dsi-t-clk-pre = <0x1B>;
		qcom,mdss-dsi-bl-min-level = <1>;
		qcom,mdss-dsi-bl-max-level = <255>;
		qcom,mdss-dsi-dma-trigger = "trigger_sw";
		qcom,mdss-dsi-mdp-trigger = <0>;
		qcom,mdss-dsi-bl-pmic-control-type = "bl_ctrl_wled";
		qcom,mdss-dsi-reset-sequence = <1 20>, <0 20>, <1 60>;//
		qcom,mdss-pan-physical-width-dimension = <62>;
		qcom,mdss-pan-physical-height-dimension = <110>;
		qcom,mdss-dsi-cabc-off-command = [15 01 00 00 10 00 02 55 00
										05 01 00 00 10 00 02 29 00];
		qcom,mdss-dsi-cabc-ui-command = [15 01 00 00 10 00 02 55 01
										05 01 00 00 10 00 02 29 00];
		qcom,mdss-dsi-cabc-still-image-command = [15 01 00 00 10 00 02 55 02
												  05 01 00 00 10 00 02 29 00];
		qcom,mdss-dsi-cabc-video-command = [15 01 00 00 10 00 02 55 01
										    05 01 00 00 10 00 02 29 00];
	};
};
