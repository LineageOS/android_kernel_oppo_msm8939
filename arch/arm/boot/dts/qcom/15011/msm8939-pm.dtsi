/* Copyright (c) 2014-2015, The Linux Foundation. All rights reserved.
 *
 * This program is free software; you can redistribute it and/or modify
 * it under the terms of the GNU General Public License version 2 and
 * only version 2 as published by the Free Software Foundation.
 *
 * This program is distributed in the hope that it will be useful,
 * but WITHOUT ANY WARRANTY; without even the implied warranty of
 * MERCHANTABILITY or FITNESS FOR A PARTICULAR PURPOSE.  See the
 * GNU General Public License for more details.
 */

&soc {
	qcom,spm@b1d2000 {
		qcom,saw2-spm-cmd-pc = [00 60 50 11 07 70 01 50 02 62 72 0f];
	};

	qcom,lpm-workarounds {
		/delete-property/ qcom,lpm-wa-skip-l2-spm;
	};
};
