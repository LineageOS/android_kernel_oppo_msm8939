/* Copyright (c) 2013, The Linux Foundation. All rights reserved.
 *
 * This program is free software; you can redistribute it and/or modify
 * it under the terms of the GNU General Public License version 2 and
 * only version 2 as published by the Free Software Foundation.
 *
 * This program is distributed in the hope that it will be useful,
 * but WITHOUT ANY WARRANTY; without even the implied warranty of
 * MERCHANTABILITY or FITNESS FOR A PARTICULAR PURPOSE.  See the
 * GNU General Public License for more details.
 */

&mdss_mdp {
	dsi_oppo15109truly_hx8394f_720p_video: qcom,mdss_dsi_oppo15109truly_hx8394f_720p_video {
		qcom,mdss-dsi-panel-name = "oppo15109truly hx8394f 720p video mode dsi panel";
		qcom,mdss-dsi-panel-manufacture = "Truly_test";
		qcom,mdss-dsi-panel-version = "HX8394F";
		qcom,mdss-dsi-panel-controller = <&mdss_dsi0>;
		qcom,mdss-dsi-panel-type = "dsi_video_mode";
		qcom,mdss-dsi-panel-destination = "display_1";
		qcom,mdss-dsi-panel-framerate = <60>;
		qcom,mdss-dsi-virtual-channel-id = <0>;
		qcom,mdss-dsi-stream = <0>;
		qcom,mdss-dsi-panel-width = <720>;
		qcom,mdss-dsi-panel-height = <1280>;
		qcom,mdss-dsi-h-front-porch = <180>;
		qcom,mdss-dsi-h-back-porch = <164>;
		qcom,mdss-dsi-h-pulse-width = <2>;
		qcom,mdss-dsi-h-sync-skew = <0>;
		qcom,mdss-dsi-v-back-porch = <18>;
		qcom,mdss-dsi-v-front-porch = <8>;
		qcom,mdss-dsi-v-pulse-width = <4>;
		qcom,mdss-dsi-h-left-border = <0>;
		qcom,mdss-dsi-h-right-border = <0>;
		qcom,mdss-dsi-v-top-border = <0>;
		qcom,mdss-dsi-v-bottom-border = <0>;
		qcom,mdss-dsi-bpp = <24>;
		qcom,mdss-dsi-color-order = <0>;
		qcom,mdss-dsi-underflow-color = <0xff>;
		qcom,mdss-dsi-border-color = <0>;
		qcom,mdss-dsi-on-command = [
			39 01 00 00 00 00 04 B9 FF 83 94
			39 01 00 00 00 00 07 BA 62 03 68 6B B2 C0
			39 01 00 00 00 00 0B B1 50 09 6B 09 33 54 71 31 3D 27
			39 01 00 00 00 00 0D B2 00 80 64 10 0D 2F 00 00 00 00 C0 1B
			39 01 00 00 00 00 16 B4 03 79 03 51 03 51 01 05 7E 77 00 3F 03 79 03 51 03 51 05 01 7E
			39 01 00 00 00 00 03 B6 D0 D0
			39 01 00 00 00 00 22 D3 00 00 0F 0F 01 2F 08 00 32 10 0B 00 0B 32 15 07 05 07 32 10 00 00 00 37 33 0B 0B 37 10 07 07 10 40
			39 01 00 00 00 00 2D D5 18 18 18 18 18 18 18 18 18 18 18 18 18 18 18 18 18 18 18 18 18 18 02 03 18 18 00 01 06 07 04 05 20 21 22 23 18 18 18 18 18 18 18 18
			15 01 00 00 00 00 02 CC 0B
			39 01 00 00 00 00 3B E0 00 06 0F 16 19 1C 1F 1D 3F 4F 5F 60 6C 7E 86 8C 9B 9E 9C AC BD 5E 5D 60 62 63 69 70 6F 00 06 0F 16 19 1C 1F 1E 40 50 61 62 6D 7D 7E 87 92 96 92 A0 AF 57 55 5A 5F 62 67 6A 68
			39 01 00 00 00 00 02 BD 00
			39 01 00 00 00 00 2C C1 01 00 07 0E 15 1C 24 2B 32 3A 41 47 4F 56 5E 65 6C 73 7A 81 8A 91 9A A2 AA B2 B9 C2 C9 D1 D9 E3 EB F5 15 8A 0C EE AB DE 74 B2 40
			39 01 00 00 00 00 02 BD 01
			39 01 00 00 00 00 2B C1 00 07 0E 16 1D 25 2C 34 3B 42 49 51 58 60 68 6F 76 7D 85 8D 95 9D A6 AE B6 BE C5 CE D6 DF E7 F0 FA 2C 8C AD D0 64 B3 8C 4E 40
			39 01 00 00 00 00 02 BD 02
			39 01 00 00 00 00 2B C1 00 07 0F 17 1E 26 2E 36 3E 46 4D 55 5D 65 6D 74 7C 84 8C 94 9D A5 AE B6 BE C6 CD D6 DF E7 EF F8 FF 34 AF 4B D3 03 B5 0E 14 C0
			39 01 00 00 00 00 02 BD 00
			39 01 00 00 00 00 02 BC 00
			39 01 00 00 00 00 03 C0 1F 73
			15 01 00 00 00 00 02 D4 02
			39 01 00 00 00 00 08 BF 40 81 50 02 1A FC 02
			39 01 00 00 00 00 02 51 FF
			39 01 00 00 00 00 02 53 24
			39 01 00 00 00 00 02 55 11
			39 01 00 00 10 00 08 C9 13 00 0A 1E B1 1E 00
			39 01 00 00 00 00 02 35 00
			05 01 00 00 C8 00 02 11 00
			39 01 00 00 14 00 03 E4 01 42
			05 01 00 00 14 00 02 29 00];
		qcom,mdss-dsi-off-command = [
			05 01 00 00 02 00 02 28 00
			05 01 00 00 79 00 02 10 00];
		qcom,mdss-dsi-on-command-state = "dsi_lp_mode";
		qcom,mdss-dsi-off-command-state = "dsi_hs_mode";
		qcom,mdss-dsi-panel-status-command = [06 01 00 01 05 00 02 45 08];
		qcom,mdss-dsi-panel-status-command-state = "dsi_lp_mode";
		qcom,mdss-dsi-panel-status-check-mode = "reg_read";
		qcom,mdss-dsi-panel-status-value = <0x80>;
		qcom,mdss-dsi-tx-eot-append;
		qcom,mdss-dsi-h-sync-pulse = <1>;
		qcom,mdss-dsi-traffic-mode = "burst_mode";
		qcom,mdss-dsi-lane-map = <0>;
		qcom,mdss-dsi-bllp-eof-power-mode;
		qcom,mdss-dsi-bllp-power-mode;
		qcom,mdss-dsi-hfp-power-mode;
		qcom,mdss-dsi-hbp-power-mode;
		qcom,mdss-dsi-hsa-power-mode;
		qcom,mdss-dsi-lp11-init;
		qcom,mdss-dsi-init-delay-us = <50000>;
		qcom,mdss-dsi-lane-0-state;
		qcom,mdss-dsi-lane-1-state;
		qcom,mdss-dsi-lane-2-state;
		qcom,mdss-dsi-panel-timings = [B4 2A 1C 00 54 58 20 2E 20 03 04 00];
		qcom,mdss-dsi-t-clk-post = <0x04>;
		qcom,mdss-dsi-t-clk-pre = <0x1C>;
		qcom,mdss-dsi-bl-min-level = <1>;
		qcom,mdss-dsi-bl-max-level = <255>;
		qcom,mdss-dsi-dma-trigger = <4>;
		qcom,mdss-dsi-mdp-trigger = <0>;
		qcom,mdss-dsi-bl-pmic-control-type = "bl_ctrl_wled";
		qcom,mdss-dsi-reset-sequence = <1 10>, <0 1>, <1 15>;
		qcom,mdss-pan-physical-width-dimension = <62>;
		qcom,mdss-pan-physical-height-dimension = <110>;
		qcom,mdss-dsi-pan-enable-dynamic-fps;
		qcom,mdss-dsi-pan-fps-update = "dfps_immediate_porch_mode";
		qcom,mdss-dsi-min-refresh-rate = <55>;
		qcom,mdss-dsi-max-refresh-rate = <60>;

		cm,mdss-livedisplay-cabc-cmd = [
			15 01 00 00 10 00 02 55 10];
		cm,mdss-livedisplay-cabc-ui-value = <0x11>;
		cm,mdss-livedisplay-cabc-image-value = <0x12>;
		cm,mdss-livedisplay-cabc-video-value = <0x11>;
	};
};
