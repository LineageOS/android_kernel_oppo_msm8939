/* Copyright (c) 2013, The Linux Foundation. All rights reserved.
 *
 * This program is free software; you can redistribute it and/or modify
 * it under the terms of the GNU General Public License version 2 and
 * only version 2 as published by the Free Software Foundation.
 *
 * This program is distributed in the hope that it will be useful,
 * but WITHOUT ANY WARRANTY; without even the implied warranty of
 * MERCHANTABILITY or FITNESS FOR A PARTICULAR PURPOSE.  See the
 * GNU General Public License for more details.
 */

&mdss_mdp {
	dsi_oppo15109tm_nt35592_720p_video: qcom,mdss_dsi_oppo15109tm_nt35592_720p_video {
		qcom,mdss-dsi-panel-name = "oppo15109tm nt35592 720p video mode dsi panel";
		qcom,mdss-dsi-panel-manufacture = "Tianma";
		qcom,mdss-dsi-panel-version = "NT35592";
		qcom,mdss-dsi-panel-controller = <&mdss_dsi0>;
		qcom,mdss-dsi-panel-type = "dsi_video_mode";
		qcom,mdss-dsi-panel-destination = "display_1";
		qcom,mdss-dsi-panel-framerate = <60>;
		qcom,mdss-dsi-virtual-channel-id = <0>;
		qcom,mdss-dsi-stream = <0>;
		qcom,mdss-dsi-panel-width = <720>;
		qcom,mdss-dsi-panel-height = <1280>;
		qcom,mdss-dsi-h-front-porch = <160>;
		qcom,mdss-dsi-h-back-porch = <160>;
		qcom,mdss-dsi-h-pulse-width = <2>;
		qcom,mdss-dsi-h-sync-skew = <0>;
		qcom,mdss-dsi-v-back-porch = <4>;
		qcom,mdss-dsi-v-front-porch = <6>;
		qcom,mdss-dsi-v-pulse-width = <1>;
		qcom,mdss-dsi-h-left-border = <0>;
		qcom,mdss-dsi-h-right-border = <0>;
		qcom,mdss-dsi-v-top-border = <0>;
		qcom,mdss-dsi-v-bottom-border = <0>;
		qcom,mdss-dsi-bpp = <24>;
		qcom,mdss-dsi-color-order = <0>;
		qcom,mdss-dsi-underflow-color = <0xff>;
		qcom,mdss-dsi-border-color = <0>;
		qcom,mdss-dsi-on-command = [
			39 01 00 00 00 00 02 FF 01
			39 01 00 00 00 00 02 FB 01
			39 01 00 00 00 00 02 4B 00
			39 01 00 00 00 00 02 36 7B
			39 01 00 00 00 00 02 6D 33
			39 01 00 00 00 00 02 6F 03
			39 01 00 00 00 00 02 75 00
			39 01 00 00 00 00 02 76 2E
			39 01 00 00 00 00 02 77 00
			39 01 00 00 00 00 02 78 5A
			39 01 00 00 00 00 02 79 00
			39 01 00 00 00 00 02 7A 74
			39 01 00 00 00 00 02 7B 00
			39 01 00 00 00 00 02 7C 95
			39 01 00 00 00 00 02 7D 00
			39 01 00 00 00 00 02 7E B5
			39 01 00 00 00 00 02 7F 00
			39 01 00 00 00 00 02 80 C5
			39 01 00 00 00 00 02 81 00
			39 01 00 00 00 00 02 82 DB
			39 01 00 00 00 00 02 83 00
			39 01 00 00 00 00 02 84 E2
			39 01 00 00 00 00 02 85 00
			39 01 00 00 00 00 02 86 F4
			39 01 00 00 00 00 02 87 01
			39 01 00 00 00 00 02 88 22
			39 01 00 00 00 00 02 89 01
			39 01 00 00 00 00 02 8A 46
			39 01 00 00 00 00 02 8B 01
			39 01 00 00 00 00 02 8C 7E
			39 01 00 00 00 00 02 8D 01
			39 01 00 00 00 00 02 8E A8
			39 01 00 00 00 00 02 8F 01
			39 01 00 00 00 00 02 90 F1
			39 01 00 00 00 00 02 91 02
			39 01 00 00 00 00 02 92 2A
			39 01 00 00 00 00 02 93 02
			39 01 00 00 00 00 02 94 2C
			39 01 00 00 00 00 02 95 02
			39 01 00 00 00 00 02 96 62
			39 01 00 00 00 00 02 97 02
			39 01 00 00 00 00 02 98 9E
			39 01 00 00 00 00 02 99 02
			39 01 00 00 00 00 02 9A C7
			39 01 00 00 00 00 02 9B 02
			39 01 00 00 00 00 02 9C FB
			39 01 00 00 00 00 02 9D 03
			39 01 00 00 00 00 02 9E 20
			39 01 00 00 00 00 02 9F 03
			39 01 00 00 00 00 02 A0 51
			39 01 00 00 00 00 02 A2 03
			39 01 00 00 00 00 02 A3 60
			39 01 00 00 00 00 02 A4 03
			39 01 00 00 00 00 02 A5 70
			39 01 00 00 00 00 02 A6 03
			39 01 00 00 00 00 02 A7 84
			39 01 00 00 00 00 02 A9 03
			39 01 00 00 00 00 02 AA 9F
			39 01 00 00 00 00 02 AB 03
			39 01 00 00 00 00 02 AC BA
			39 01 00 00 00 00 02 AD 03
			39 01 00 00 00 00 02 AE D5
			39 01 00 00 00 00 02 AF 03
			39 01 00 00 00 00 02 B0 F1
			39 01 00 00 00 00 02 B1 03
			39 01 00 00 00 00 02 B2 FF
			39 01 00 00 00 00 02 B3 00
			39 01 00 00 00 00 02 B4 2E
			39 01 00 00 00 00 02 B5 00
			39 01 00 00 00 00 02 B6 5A
			39 01 00 00 00 00 02 B7 00
			39 01 00 00 00 00 02 B8 74
			39 01 00 00 00 00 02 B9 00
			39 01 00 00 00 00 02 BA 95
			39 01 00 00 00 00 02 BB 00
			39 01 00 00 00 00 02 BC B5
			39 01 00 00 00 00 02 BD 00
			39 01 00 00 00 00 02 BE C5
			39 01 00 00 00 00 02 BF 00
			39 01 00 00 00 00 02 C0 DB
			39 01 00 00 00 00 02 C1 00
			39 01 00 00 00 00 02 C2 E2
			39 01 00 00 00 00 02 C3 00
			39 01 00 00 00 00 02 C4 F4
			39 01 00 00 00 00 02 C5 01
			39 01 00 00 00 00 02 C6 22
			39 01 00 00 00 00 02 C7 01
			39 01 00 00 00 00 02 C8 46
			39 01 00 00 00 00 02 C9 01
			39 01 00 00 00 00 02 CA 7E
			39 01 00 00 00 00 02 CB 01
			39 01 00 00 00 00 02 CC A8
			39 01 00 00 00 00 02 CD 01
			39 01 00 00 00 00 02 CE F1
			39 01 00 00 00 00 02 CF 02
			39 01 00 00 00 00 02 D0 2A
			39 01 00 00 00 00 02 D1 02
			39 01 00 00 00 00 02 D2 2C
			39 01 00 00 00 00 02 D3 02
			39 01 00 00 00 00 02 D4 62
			39 01 00 00 00 00 02 D5 02
			39 01 00 00 00 00 02 D6 9E
			39 01 00 00 00 00 02 D7 02
			39 01 00 00 00 00 02 D8 C7
			39 01 00 00 00 00 02 D9 02
			39 01 00 00 00 00 02 DA FB
			39 01 00 00 00 00 02 DB 03
			39 01 00 00 00 00 02 DC 20
			39 01 00 00 00 00 02 DD 03
			39 01 00 00 00 00 02 DE 51
			39 01 00 00 00 00 02 DF 03
			39 01 00 00 00 00 02 E0 60
			39 01 00 00 00 00 02 E1 03
			39 01 00 00 00 00 02 E2 70
			39 01 00 00 00 00 02 E3 03
			39 01 00 00 00 00 02 E4 84
			39 01 00 00 00 00 02 E5 03
			39 01 00 00 00 00 02 E6 9F
			39 01 00 00 00 00 02 E7 03
			39 01 00 00 00 00 02 E8 BA
			39 01 00 00 00 00 02 E9 03
			39 01 00 00 00 00 02 EA D5
			39 01 00 00 00 00 02 EB 03
			39 01 00 00 00 00 02 EC F1
			39 01 00 00 00 00 02 ED 03
			39 01 00 00 00 00 02 EE FF
			39 01 00 00 00 00 02 EF 00
			39 01 00 00 00 00 02 F0 D6
			39 01 00 00 00 00 02 F1 00
			39 01 00 00 00 00 02 F2 E0
			39 01 00 00 00 00 02 F3 00
			39 01 00 00 00 00 02 F4 E8
			39 01 00 00 00 00 02 F5 00
			39 01 00 00 00 00 02 F6 F6
			39 01 00 00 00 00 02 F7 01
			39 01 00 00 00 00 02 F8 06
			39 01 00 00 00 00 02 F9 01
			39 01 00 00 00 00 02 FA 0F
			39 01 00 00 00 00 02 FF 02
			39 01 00 00 00 00 02 FB 01
			39 01 00 00 00 00 02 00 01
			39 01 00 00 00 00 02 01 1C
			39 01 00 00 00 00 02 02 01
			39 01 00 00 00 00 02 03 21
			39 01 00 00 00 00 02 04 01
			39 01 00 00 00 00 02 05 2C
			39 01 00 00 00 00 02 06 01
			39 01 00 00 00 00 02 07 4D
			39 01 00 00 00 00 02 08 01
			39 01 00 00 00 00 02 09 69
			39 01 00 00 00 00 02 0A 01
			39 01 00 00 00 00 02 0B 96
			39 01 00 00 00 00 02 0C 01
			39 01 00 00 00 00 02 0D BB
			39 01 00 00 00 00 02 0E 01
			39 01 00 00 00 00 02 0F FC
			39 01 00 00 00 00 02 10 02
			39 01 00 00 00 00 02 11 32
			39 01 00 00 00 00 02 12 02
			39 01 00 00 00 00 02 13 33
			39 01 00 00 00 00 02 14 02
			39 01 00 00 00 00 02 15 66
			39 01 00 00 00 00 02 16 02
			39 01 00 00 00 00 02 17 A1
			39 01 00 00 00 00 02 18 02
			39 01 00 00 00 00 02 19 C8
			39 01 00 00 00 00 02 1A 02
			39 01 00 00 00 00 02 1B FB
			39 01 00 00 00 00 02 1C 03
			39 01 00 00 00 00 02 1D 1E
			39 01 00 00 00 00 02 1E 03
			39 01 00 00 00 00 02 1F 4C
			39 01 00 00 00 00 02 20 03
			39 01 00 00 00 00 02 21 59
			39 01 00 00 00 00 02 22 03
			39 01 00 00 00 00 02 23 67
			39 01 00 00 00 00 02 24 03
			39 01 00 00 00 00 02 25 78
			39 01 00 00 00 00 02 26 03
			39 01 00 00 00 00 02 27 96
			39 01 00 00 00 00 02 28 03
			39 01 00 00 00 00 02 29 B4
			39 01 00 00 00 00 02 2A 03
			39 01 00 00 00 00 02 2B D2
			39 01 00 00 00 00 02 2D 03
			39 01 00 00 00 00 02 2F F0
			39 01 00 00 00 00 02 30 03
			39 01 00 00 00 00 02 31 FF
			39 01 00 00 00 00 02 32 00
			39 01 00 00 00 00 02 33 D6
			39 01 00 00 00 00 02 34 00
			39 01 00 00 00 00 02 35 E0
			39 01 00 00 00 00 02 36 00
			39 01 00 00 00 00 02 37 E8
			39 01 00 00 00 00 02 38 00
			39 01 00 00 00 00 02 39 F6
			39 01 00 00 00 00 02 3A 01
			39 01 00 00 00 00 02 3B 06
			39 01 00 00 00 00 02 3D 01
			39 01 00 00 00 00 02 3F 0F
			39 01 00 00 00 00 02 40 01
			39 01 00 00 00 00 02 41 1C
			39 01 00 00 00 00 02 42 01
			39 01 00 00 00 00 02 43 21
			39 01 00 00 00 00 02 44 01
			39 01 00 00 00 00 02 45 2C
			39 01 00 00 00 00 02 46 01
			39 01 00 00 00 00 02 47 4D
			39 01 00 00 00 00 02 48 01
			39 01 00 00 00 00 02 49 69
			39 01 00 00 00 00 02 4A 01
			39 01 00 00 00 00 02 4B 96
			39 01 00 00 00 00 02 4C 01
			39 01 00 00 00 00 02 4D BB
			39 01 00 00 00 00 02 4E 01
			39 01 00 00 00 00 02 4F FC
			39 01 00 00 00 00 02 50 02
			39 01 00 00 00 00 02 51 32
			39 01 00 00 00 00 02 52 02
			39 01 00 00 00 00 02 53 33
			39 01 00 00 00 00 02 54 02
			39 01 00 00 00 00 02 55 66
			39 01 00 00 00 00 02 56 02
			39 01 00 00 00 00 02 58 A1
			39 01 00 00 00 00 02 59 02
			39 01 00 00 00 00 02 5A C8
			39 01 00 00 00 00 02 5B 02
			39 01 00 00 00 00 02 5C FB
			39 01 00 00 00 00 02 5D 03
			39 01 00 00 00 00 02 5E 1E
			39 01 00 00 00 00 02 5F 03
			39 01 00 00 00 00 02 60 4C
			39 01 00 00 00 00 02 61 03
			39 01 00 00 00 00 02 62 59
			39 01 00 00 00 00 02 63 03
			39 01 00 00 00 00 02 64 67
			39 01 00 00 00 00 02 65 03
			39 01 00 00 00 00 02 66 78
			39 01 00 00 00 00 02 67 03
			39 01 00 00 00 00 02 68 96
			39 01 00 00 00 00 02 69 03
			39 01 00 00 00 00 02 6A B4
			39 01 00 00 00 00 02 6B 03
			39 01 00 00 00 00 02 6C D2
			39 01 00 00 00 00 02 6D 03
			39 01 00 00 00 00 02 6E F0
			39 01 00 00 00 00 02 6F 03
			39 01 00 00 00 00 02 70 FF
			39 01 00 00 00 00 02 71 00
			39 01 00 00 00 00 02 72 65
			39 01 00 00 00 00 02 73 00
			39 01 00 00 00 00 02 74 79
			39 01 00 00 00 00 02 75 00
			39 01 00 00 00 00 02 76 88
			39 01 00 00 00 00 02 77 00
			39 01 00 00 00 00 02 78 A0
			39 01 00 00 00 00 02 79 00
			39 01 00 00 00 00 02 7A B9
			39 01 00 00 00 00 02 7B 00
			39 01 00 00 00 00 02 7C C7
			39 01 00 00 00 00 02 7D 00
			39 01 00 00 00 00 02 7E DA
			39 01 00 00 00 00 02 7F 00
			39 01 00 00 00 00 02 80 E1
			39 01 00 00 00 00 02 81 00
			39 01 00 00 00 00 02 82 F1
			39 01 00 00 00 00 02 83 01
			39 01 00 00 00 00 02 84 1C
			39 01 00 00 00 00 02 85 01
			39 01 00 00 00 00 02 86 40
			39 01 00 00 00 00 02 87 01
			39 01 00 00 00 00 02 88 77
			39 01 00 00 00 00 02 89 01
			39 01 00 00 00 00 02 8A A2
			39 01 00 00 00 00 02 8B 01
			39 01 00 00 00 00 02 8C EC
			39 01 00 00 00 00 02 8D 02
			39 01 00 00 00 00 02 8E 27
			39 01 00 00 00 00 02 8F 02
			39 01 00 00 00 00 02 90 28
			39 01 00 00 00 00 02 91 02
			39 01 00 00 00 00 02 92 5E
			39 01 00 00 00 00 02 93 02
			39 01 00 00 00 00 02 94 9A
			39 01 00 00 00 00 02 95 02
			39 01 00 00 00 00 02 96 C2
			39 01 00 00 00 00 02 97 02
			39 01 00 00 00 00 02 98 F7
			39 01 00 00 00 00 02 99 03
			39 01 00 00 00 00 02 9A 1D
			39 01 00 00 00 00 02 9B 03
			39 01 00 00 00 00 02 9C 56
			39 01 00 00 00 00 02 9D 03
			39 01 00 00 00 00 02 9E 6A
			39 01 00 00 00 00 02 9F 03
			39 01 00 00 00 00 02 A0 84
			39 01 00 00 00 00 02 A2 03
			39 01 00 00 00 00 02 A3 BB
			39 01 00 00 00 00 02 A4 03
			39 01 00 00 00 00 02 A5 CA
			39 01 00 00 00 00 02 A6 03
			39 01 00 00 00 00 02 A7 D9
			39 01 00 00 00 00 02 A9 03
			39 01 00 00 00 00 02 AA E8
			39 01 00 00 00 00 02 AB 03
			39 01 00 00 00 00 02 AC F7
			39 01 00 00 00 00 02 AD 03
			39 01 00 00 00 00 02 AE FF
			39 01 00 00 00 00 02 AF 00
			39 01 00 00 00 00 02 B0 65
			39 01 00 00 00 00 02 B1 00
			39 01 00 00 00 00 02 B2 79
			39 01 00 00 00 00 02 B3 00
			39 01 00 00 00 00 02 B4 88
			39 01 00 00 00 00 02 B5 00
			39 01 00 00 00 00 02 B6 A0
			39 01 00 00 00 00 02 B7 00
			39 01 00 00 00 00 02 B8 B9
			39 01 00 00 00 00 02 B9 00
			39 01 00 00 00 00 02 BA C7
			39 01 00 00 00 00 02 BB 00
			39 01 00 00 00 00 02 BC DA
			39 01 00 00 00 00 02 BD 00
			39 01 00 00 00 00 02 BE E1
			39 01 00 00 00 00 02 BF 00
			39 01 00 00 00 00 02 C0 F1
			39 01 00 00 00 00 02 C1 01
			39 01 00 00 00 00 02 C2 1C
			39 01 00 00 00 00 02 C3 01
			39 01 00 00 00 00 02 C4 40
			39 01 00 00 00 00 02 C5 01
			39 01 00 00 00 00 02 C6 77
			39 01 00 00 00 00 02 C7 01
			39 01 00 00 00 00 02 C8 A2
			39 01 00 00 00 00 02 C9 01
			39 01 00 00 00 00 02 CA EC
			39 01 00 00 00 00 02 CB 02
			39 01 00 00 00 00 02 CC 27
			39 01 00 00 00 00 02 CD 02
			39 01 00 00 00 00 02 CE 28
			39 01 00 00 00 00 02 CF 02
			39 01 00 00 00 00 02 D0 5E
			39 01 00 00 00 00 02 D1 02
			39 01 00 00 00 00 02 D2 9A
			39 01 00 00 00 00 02 D3 02
			39 01 00 00 00 00 02 D4 C2
			39 01 00 00 00 00 02 D5 02
			39 01 00 00 00 00 02 D6 F7
			39 01 00 00 00 00 02 D7 03
			39 01 00 00 00 00 02 D8 1D
			39 01 00 00 00 00 02 D9 03
			39 01 00 00 00 00 02 DA 56
			39 01 00 00 00 00 02 DB 03
			39 01 00 00 00 00 02 DC 6A
			39 01 00 00 00 00 02 DD 03
			39 01 00 00 00 00 02 DE 84
			39 01 00 00 00 00 02 DF 03
			39 01 00 00 00 00 02 E0 BB
			39 01 00 00 00 00 02 E1 03
			39 01 00 00 00 00 02 E2 CA
			39 01 00 00 00 00 02 E3 03
			39 01 00 00 00 00 02 E4 D9
			39 01 00 00 00 00 02 E5 03
			39 01 00 00 00 00 02 E6 E8
			39 01 00 00 00 00 02 E7 03
			39 01 00 00 00 00 02 E8 F7
			39 01 00 00 00 00 02 E9 03
			39 01 00 00 00 00 02 EA FF
			39 01 00 00 00 00 02 FF 03
			39 01 00 00 00 00 02 FB 01
			39 01 00 00 00 00 02 0B 32
			39 01 00 00 00 00 02 0C 28
			39 01 00 00 00 00 02 0D 26
			39 01 00 00 00 00 02 15 20
			39 01 00 00 00 00 02 1A 77
			39 01 00 00 00 00 02 68 00
			39 01 00 00 00 00 02 53 00
			39 01 00 00 00 00 02 54 00
			39 01 00 00 00 00 02 56 00
			39 01 00 00 00 00 02 FF 00
			39 01 00 00 00 00 02 FB 01
			39 01 00 00 00 00 02 55 B1
			39 01 00 00 00 00 02 51 FF
			39 01 00 00 00 00 02 53 2C
			39 01 00 00 00 00 02 35 00
			39 01 00 00 00 00 02 FF FF
			39 01 00 00 00 00 02 FB 01
			39 01 00 00 00 00 02 3F 09
			39 01 00 00 00 00 02 CA 80
			39 01 00 00 00 00 02 FF EE
			39 01 00 00 00 00 02 FB 01
			39 01 00 00 00 00 02 2A A9
			39 01 00 00 00 00 02 FF 04
			39 01 00 00 00 00 02 FB 01
			39 01 00 00 00 00 02 08 03
			39 01 00 00 00 00 02 FF 00
			15 01 00 00 96 00 02 11 00
			15 01 00 00 40 00 02 29 00];
		qcom,mdss-dsi-off-command = [
			05 01 00 00 32 00 02 28 00
			05 01 00 00 78 00 02 10 00];
		qcom,mdss-dsi-on-command-state = "dsi_lp_mode";
		qcom,mdss-dsi-off-command-state = "dsi_hs_mode";
		qcom,mdss-dsi-panel-status-command = [06 01 00 01 05 00 02 45 08];
		qcom,mdss-dsi-esd-reset-command = [
			15 01 00 00 00 00 02 FF 05
			15 01 00 00 00 00 02 FB 01
			15 01 00 00 00 00 02 01 00
			15 01 00 00 00 00 02 02 8D
			15 01 00 00 00 00 02 03 8D
			15 01 00 00 00 00 02 04 8D
			15 01 00 00 00 00 02 05 30
			15 01 00 00 00 00 02 06 33
			15 01 00 00 00 00 02 07 77
			15 01 00 00 00 00 02 08 00
			15 01 00 00 00 00 02 09 00
			15 01 00 00 00 00 02 0A 00
			15 01 00 00 00 00 02 0B 80
			15 01 00 00 00 00 02 0C C8
			15 01 00 00 00 00 02 0D 0A
			15 01 00 00 00 00 02 0E 1B
			15 01 00 00 00 00 02 0F 06
			15 01 00 00 00 00 02 10 56
			15 01 00 00 00 00 02 11 00
			15 01 00 00 00 00 02 12 00
			15 01 00 00 00 00 02 13 1E
			15 01 00 00 00 00 02 14 00
			15 01 00 00 00 00 02 15 1A
			15 01 00 00 00 00 02 16 05
			15 01 00 00 00 00 02 17 00
			15 01 00 00 00 00 02 18 1E
			15 01 00 00 00 00 02 19 FF
			15 01 00 00 00 00 02 1A 00
			15 01 00 00 00 00 02 1B FC
			15 01 00 00 00 00 02 1C 80
			15 01 00 00 00 00 02 1D 00
			15 01 00 00 00 00 02 1E 00
			15 01 00 00 00 00 02 1F 77
			15 01 00 00 00 00 02 20 00
			15 01 00 00 00 00 02 21 00
			15 01 00 00 00 00 02 22 55
			15 01 00 00 00 00 02 23 0D
			15 01 00 00 00 00 02 31 A0
			15 01 00 00 00 00 02 32 00
			15 01 00 00 00 00 02 33 B8
			15 01 00 00 00 00 02 34 BB
			15 01 00 00 00 00 02 35 11
			15 01 00 00 00 00 02 36 02
			15 01 00 00 00 00 02 37 00
			15 01 00 00 00 00 02 38 01
			15 01 00 00 00 00 02 39 0B
			15 01 00 00 00 00 02 44 08
			15 01 00 00 00 00 02 45 80
			15 01 00 00 00 00 02 46 CC
			15 01 00 00 00 00 02 47 04
			15 01 00 00 00 00 02 48 00
			15 01 00 00 00 00 02 49 00
			15 01 00 00 00 00 02 4A 01
			15 01 00 00 00 00 02 6C 03
			15 01 00 00 00 00 02 6D 03
			15 01 00 00 00 00 02 6E 2F
			15 01 00 00 00 00 02 43 00
			15 01 00 00 00 00 02 4B 23
			15 01 00 00 00 00 02 4C 01
			15 01 00 00 00 00 02 50 23
			15 01 00 00 00 00 02 51 01
			15 01 00 00 00 00 02 58 23
			15 01 00 00 00 00 02 59 01
			15 01 00 00 00 00 02 5D 23
			15 01 00 00 00 00 02 5E 01
			15 01 00 00 00 00 02 89 00
			15 01 00 00 00 00 02 8D 01
			15 01 00 00 00 00 02 8E 64
			15 01 00 00 00 00 02 8F 20
			15 01 00 00 00 00 02 97 8E
			15 01 00 00 00 00 02 82 8C
			15 01 00 00 00 00 02 83 02
			15 01 00 00 00 00 02 BB 0A
			15 01 00 00 00 00 02 BC 0A
			15 01 00 00 00 00 02 24 25
			15 01 00 00 00 00 02 25 55
			15 01 00 00 00 00 02 26 05
			15 01 00 00 00 00 02 27 23
			15 01 00 00 00 00 02 28 01
			15 01 00 00 00 00 02 29 31
			15 01 00 00 00 00 02 2A 5D
			15 01 00 00 00 00 02 2B 01
			15 01 00 00 00 00 02 2F 00
			15 01 00 00 00 00 02 30 10
			15 01 00 00 00 00 02 A7 12
			15 01 00 00 00 00 02 2D 03
			15 01 00 00 00 00 02 FF 00];
		qcom,mdss-dsi-panel-status-command-state = "dsi_lp_mode";
		qcom,mdss-dsi-panel-status-check-mode = "reg_read";
		qcom,mdss-dsi-panel-status-value = <0x5>;
		qcom,mdss-dsi-tx-eot-append;
		qcom,mdss-dsi-h-sync-pulse = <1>;
		qcom,mdss-dsi-lp11-init;
		qcom,mdss-dsi-init-delay-us = <50000>;
		qcom,mdss-dsi-traffic-mode = "burst_mode";
		qcom,mdss-dsi-lane-map = <0>;
		qcom,mdss-dsi-bllp-eof-power-mode;
		qcom,mdss-dsi-bllp-power-mode;
		qcom,mdss-dsi-hfp-power-mode;
		qcom,mdss-dsi-hbp-power-mode;
		qcom,mdss-dsi-hsa-power-mode;
		qcom,mdss-dsi-lane-0-state;
		qcom,mdss-dsi-lane-1-state;
		qcom,mdss-dsi-lane-2-state;
		qcom,mdss-dsi-lane-3-state;
		qcom,mdss-dsi-panel-timings = [8B 1E 14 00 44 48 18 22 19 03 04 00];
		qcom,mdss-dsi-t-clk-post = <0x04>;
		qcom,mdss-dsi-t-clk-pre = <0x1C>;
		qcom,mdss-dsi-bl-min-level = <1>;
		qcom,mdss-dsi-bl-max-level = <255>;
		qcom,mdss-dsi-dma-trigger = <4>;
		qcom,mdss-dsi-mdp-trigger = <0>;
		qcom,mdss-dsi-bl-pmic-control-type = "bl_ctrl_wled";
		qcom,mdss-dsi-reset-sequence = <1 10>, <0 1>, <1 15>;
		qcom,mdss-pan-physical-width-dimension = <62>;
		qcom,mdss-pan-physical-height-dimension = <110>;
		qcom,mdss-dsi-pan-enable-dynamic-fps;
		qcom,mdss-dsi-pan-fps-update = "dfps_immediate_porch_mode";
		qcom,mdss-dsi-min-refresh-rate = <45>;
		qcom,mdss-dsi-max-refresh-rate = <60>;

		cm,mdss-livedisplay-cabc-cmd = [
			15 01 00 00 10 00 02 55 90];
		cm,mdss-livedisplay-cabc-ui-value = <0xB1>;
		cm,mdss-livedisplay-cabc-image-value = <0xB2>;
		cm,mdss-livedisplay-cabc-video-value = <0xB1>;
	};
};
