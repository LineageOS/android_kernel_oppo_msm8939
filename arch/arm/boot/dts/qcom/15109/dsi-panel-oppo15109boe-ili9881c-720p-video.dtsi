/* Copyright (c) 2013, The Linux Foundation. All rights reserved.
 *
 * This program is free software; you can redistribute it and/or modify
 * it under the terms of the GNU General Public License version 2 and
 * only version 2 as published by the Free Software Foundation.
 *
 * This program is distributed in the hope that it will be useful,
 * but WITHOUT ANY WARRANTY; without even the implied warranty of
 * MERCHANTABILITY or FITNESS FOR A PARTICULAR PURPOSE.  See the
 * GNU General Public License for more details.
 */

&mdss_mdp {
	dsi_oppo15109boe_ili9881c_720p_video: qcom,mdss_dsi_oppo15109boe_ili9881c_720p_video {
		qcom,mdss-dsi-panel-name = "oppo15109boe ili9881c 720p video mode dsi panel";
		qcom,mdss-dsi-panel-manufacture = "Boe_ESD";
		qcom,mdss-dsi-panel-version = "ILI9881C";
		qcom,mdss-dsi-panel-controller = <&mdss_dsi0>;
		qcom,mdss-dsi-panel-type = "dsi_video_mode";
		qcom,mdss-dsi-panel-destination = "display_1";
		qcom,mdss-dsi-panel-framerate = <60>;
		qcom,mdss-dsi-virtual-channel-id = <0>;
		qcom,mdss-dsi-stream = <0>;
		qcom,mdss-dsi-panel-width = <720>;
		qcom,mdss-dsi-panel-height = <1280>;
		qcom,mdss-dsi-h-front-porch = <132>;
		qcom,mdss-dsi-h-back-porch = <130>;
		qcom,mdss-dsi-h-pulse-width = <24>;
		qcom,mdss-dsi-h-sync-skew = <0>;
		qcom,mdss-dsi-v-back-porch = <24>;
		qcom,mdss-dsi-v-front-porch = <24>;
		qcom,mdss-dsi-v-pulse-width = <8>;
		qcom,mdss-dsi-h-left-border = <0>;
		qcom,mdss-dsi-h-right-border = <0>;
		qcom,mdss-dsi-v-top-border = <0>;
		qcom,mdss-dsi-v-bottom-border = <0>;
		qcom,mdss-dsi-bpp = <24>;
		qcom,mdss-dsi-color-order = <0>;
		qcom,mdss-dsi-underflow-color = <0xff>;
		qcom,mdss-dsi-border-color = <0>;
		qcom,mdss-dsi-on-command = [
			39 01 00 00 00 00 04 FF 98 81 03
			39 01 00 00 00 00 02 01 00
			39 01 00 00 00 00 02 02 00
			39 01 00 00 00 00 02 03 73
			39 01 00 00 00 00 02 04 00
			39 01 00 00 00 00 02 05 00
			39 01 00 00 00 00 02 06 08
			39 01 00 00 00 00 02 07 00
			39 01 00 00 00 00 02 08 00
			39 01 00 00 00 00 02 09 1B
			39 01 00 00 00 00 02 0A 01
			39 01 00 00 00 00 02 0B 01
			39 01 00 00 00 00 02 0C 0D
			39 01 00 00 00 00 02 0D 01
			39 01 00 00 00 00 02 0E 01
			39 01 00 00 00 00 02 0F 26
			39 01 00 00 00 00 02 10 26
			39 01 00 00 00 00 02 11 00
			39 01 00 00 00 00 02 12 00
			39 01 00 00 00 00 02 13 02
			39 01 00 00 00 00 02 14 00
			39 01 00 00 00 00 02 15 00
			39 01 00 00 00 00 02 16 00
			39 01 00 00 00 00 02 17 00
			39 01 00 00 00 00 02 18 00
			39 01 00 00 00 00 02 19 00
			39 01 00 00 00 00 02 1A 00
			39 01 00 00 00 00 02 1B 00
			39 01 00 00 00 00 02 1C 00
			39 01 00 00 00 00 02 1D 00
			39 01 00 00 00 00 02 1E 40
			39 01 00 00 00 00 02 1F 00
			39 01 00 00 00 00 02 20 06
			39 01 00 00 00 00 02 21 01
			39 01 00 00 00 00 02 22 00
			39 01 00 00 00 00 02 23 00
			39 01 00 00 00 00 02 24 00
			39 01 00 00 00 00 02 25 00
			39 01 00 00 00 00 02 26 00
			39 01 00 00 00 00 02 27 00
			39 01 00 00 00 00 02 28 33
			39 01 00 00 00 00 02 29 03
			39 01 00 00 00 00 02 2A 00
			39 01 00 00 00 00 02 2B 00
			39 01 00 00 00 00 02 2C 00
			39 01 00 00 00 00 02 2D 00
			39 01 00 00 00 00 02 2E 00
			39 01 00 00 00 00 02 2F 00
			39 01 00 00 00 00 02 30 00
			39 01 00 00 00 00 02 31 00
			39 01 00 00 00 00 02 32 00
			39 01 00 00 00 00 02 33 00
			39 01 00 00 00 00 02 34 00
			39 01 00 00 00 00 02 35 00
			39 01 00 00 00 00 02 36 00
			39 01 00 00 00 00 02 37 00
			39 01 00 00 00 00 02 38 00
			39 01 00 00 00 00 02 39 00
			39 01 00 00 00 00 02 3A 00
			39 01 00 00 00 00 02 3B 00
			39 01 00 00 00 00 02 3C 00
			39 01 00 00 00 00 02 3D 00
			39 01 00 00 00 00 02 3E 00
			39 01 00 00 00 00 02 3F 00
			39 01 00 00 00 00 02 40 00
			39 01 00 00 00 00 02 41 00
			39 01 00 00 00 00 02 42 00
			39 01 00 00 00 00 02 43 00
			39 01 00 00 00 00 02 44 00
			39 01 00 00 00 00 02 50 01
			39 01 00 00 00 00 02 51 23
			39 01 00 00 00 00 02 52 45
			39 01 00 00 00 00 02 53 67
			39 01 00 00 00 00 02 54 89
			39 01 00 00 00 00 02 55 AB
			39 01 00 00 00 00 02 56 01
			39 01 00 00 00 00 02 57 23
			39 01 00 00 00 00 02 58 45
			39 01 00 00 00 00 02 59 67
			39 01 00 00 00 00 02 5A 89
			39 01 00 00 00 00 02 5B AB
			39 01 00 00 00 00 02 5C CD
			39 01 00 00 00 00 02 5D EF
			39 01 00 00 00 00 02 5E 11
			39 01 00 00 00 00 02 5F 02
			39 01 00 00 00 00 02 60 00
			39 01 00 00 00 00 02 61 07
			39 01 00 00 00 00 02 62 06
			39 01 00 00 00 00 02 63 0E
			39 01 00 00 00 00 02 64 0F
			39 01 00 00 00 00 02 65 0C
			39 01 00 00 00 00 02 66 0D
			39 01 00 00 00 00 02 67 02
			39 01 00 00 00 00 02 68 02
			39 01 00 00 00 00 02 69 02
			39 01 00 00 00 00 02 6A 02
			39 01 00 00 00 00 02 6B 02
			39 01 00 00 00 00 02 6C 02
			39 01 00 00 00 00 02 6D 02
			39 01 00 00 00 00 02 6E 02
			39 01 00 00 00 00 02 6F 02
			39 01 00 00 00 00 02 70 02
			39 01 00 00 00 00 02 71 02
			39 01 00 00 00 00 02 72 02
			39 01 00 00 00 00 02 73 05
			39 01 00 00 00 00 02 74 01
			39 01 00 00 00 00 02 75 02
			39 01 00 00 00 00 02 76 00
			39 01 00 00 00 00 02 77 07
			39 01 00 00 00 00 02 78 06
			39 01 00 00 00 00 02 79 0E
			39 01 00 00 00 00 02 7A 0F
			39 01 00 00 00 00 02 7B 0C
			39 01 00 00 00 00 02 7C 0D
			39 01 00 00 00 00 02 7D 02
			39 01 00 00 00 00 02 7E 02
			39 01 00 00 00 00 02 7F 02
			39 01 00 00 00 00 02 80 02
			39 01 00 00 00 00 02 81 02
			39 01 00 00 00 00 02 82 02
			39 01 00 00 00 00 02 83 02
			39 01 00 00 00 00 02 84 02
			39 01 00 00 00 00 02 85 02
			39 01 00 00 00 00 02 86 02
			39 01 00 00 00 00 02 87 02
			39 01 00 00 00 00 02 88 02
			39 01 00 00 00 00 02 89 05
			39 01 00 00 00 00 02 8A 01
			39 01 00 00 00 00 04 FF 98 81 04
			39 01 00 00 00 00 02 0B 80
			39 01 00 00 00 00 02 0E 17
			39 01 00 00 00 00 02 6C 15
			39 01 00 00 00 00 02 6E 1A
			39 01 00 00 00 00 02 6F 25
			39 01 00 00 00 00 02 3A A4
			39 01 00 00 00 00 02 8D 1F
			39 01 00 00 00 00 02 87 BA
			39 01 00 00 00 00 02 3B 80
			39 01 00 00 00 00 02 7A 10
			39 01 00 00 00 00 02 71 B0
			39 01 00 00 00 00 04 FF 98 81 01
			39 01 00 00 00 00 02 22 0A
			39 01 00 00 00 00 02 53 7D
			39 01 00 00 00 00 02 55 8A
			39 01 00 00 00 00 02 50 85
			39 01 00 00 00 00 02 51 82
			39 01 00 00 00 00 02 31 00
			39 01 00 00 00 00 02 40 33
			39 01 00 00 00 00 02 43 66
			39 01 00 00 00 00 02 60 19
			39 01 00 00 00 00 02 61 01
			39 01 00 00 00 00 02 62 0C
			39 01 00 00 00 00 02 63 00
			39 01 00 00 00 00 04 FF 98 81 05
			39 01 00 00 00 00 02 80 01
			39 01 00 00 00 00 04 FF 98 81 01
			39 01 00 00 00 00 02 34 01
			39 01 00 00 00 00 02 A0 07
			39 01 00 00 00 00 02 A1 16
			39 01 00 00 00 00 02 A2 23
			39 01 00 00 00 00 02 A3 13
			39 01 00 00 00 00 02 A4 17
			39 01 00 00 00 00 02 A5 27
			39 01 00 00 00 00 02 A6 1C
			39 01 00 00 00 00 02 A7 1D
			39 01 00 00 00 00 02 A8 7D
			39 01 00 00 00 00 02 A9 1C
			39 01 00 00 00 00 02 AA 29
			39 01 00 00 00 00 02 AB 71
			39 01 00 00 00 00 02 AC 13
			39 01 00 00 00 00 02 AD 0D
			39 01 00 00 00 00 02 AE 3D
			39 01 00 00 00 00 02 AF 0A
			39 01 00 00 00 00 02 B0 19
			39 01 00 00 00 00 02 B1 63
			39 01 00 00 00 00 02 B2 74
			39 01 00 00 00 00 02 B3 39
			39 01 00 00 00 00 02 C0 06
			39 01 00 00 00 00 02 C1 15
			39 01 00 00 00 00 02 C2 22
			39 01 00 00 00 00 02 C3 14
			39 01 00 00 00 00 02 C4 18
			39 01 00 00 00 00 02 C5 28
			39 01 00 00 00 00 02 C6 1C
			39 01 00 00 00 00 02 C7 1D
			39 01 00 00 00 00 02 C8 7C
			39 01 00 00 00 00 02 C9 1C
			39 01 00 00 00 00 02 CA 29
			39 01 00 00 00 00 02 CB 70
			39 01 00 00 00 00 02 CC 13
			39 01 00 00 00 00 02 CD 0D
			39 01 00 00 00 00 02 CE 3D
			39 01 00 00 00 00 02 CF 0A
			39 01 00 00 00 00 02 D0 1A
			39 01 00 00 00 00 02 D1 62
			39 01 00 00 00 00 02 D2 73
			39 01 00 00 00 00 02 D3 39
			39 01 00 00 00 00 04 FF 98 81 05
			39 01 00 00 00 00 02 00 00
			39 01 00 00 00 00 02 01 00
			39 01 00 00 00 00 02 02 00
			39 01 00 00 00 00 02 03 00
			39 01 00 00 00 00 02 04 00
			39 01 00 00 00 00 02 05 00
			39 01 00 00 00 00 02 06 00
			39 01 00 00 00 00 02 07 00
			39 01 00 00 00 00 02 08 00
			39 01 00 00 00 00 02 09 00
			39 01 00 00 00 00 02 0A 00
			39 01 00 00 00 00 02 0B 00
			39 01 00 00 00 00 02 0C 00
			39 01 00 00 00 00 02 0D 00
			39 01 00 00 00 00 02 0E 00
			39 01 00 00 00 00 02 0F 00
			39 01 00 00 00 00 02 10 00
			39 01 00 00 00 00 02 11 00
			39 01 00 00 00 00 02 12 00
			39 01 00 00 00 00 02 13 00
			39 01 00 00 00 00 02 14 00
			39 01 00 00 00 00 02 15 00
			39 01 00 00 00 00 02 16 00
			39 01 00 00 00 00 02 17 00
			39 01 00 00 00 00 02 18 00
			39 01 00 00 00 00 02 19 00
			39 01 00 00 00 00 02 1A 00
			39 01 00 00 00 00 02 1B 00
			39 01 00 00 00 00 02 1C 00
			39 01 00 00 00 00 02 1D 00
			39 01 00 00 00 00 02 1E 00
			39 01 00 00 00 00 02 1F 00
			39 01 00 00 00 00 02 20 00
			39 01 00 00 00 00 02 21 00
			39 01 00 00 00 00 02 22 00
			39 01 00 00 00 00 02 23 00
			39 01 00 00 00 00 02 24 00
			39 01 00 00 00 00 02 25 00
			39 01 00 00 00 00 02 26 00
			39 01 00 00 00 00 02 27 00
			39 01 00 00 00 00 02 28 00
			39 01 00 00 00 00 02 29 00
			39 01 00 00 00 00 02 2A 00
			39 01 00 00 00 00 02 2B 00
			39 01 00 00 00 00 02 2C 00
			39 01 00 00 00 00 02 2D 00
			39 01 00 00 00 00 02 2E 00
			39 01 00 00 00 00 02 2F 00
			39 01 00 00 00 00 02 30 00
			39 01 00 00 00 00 02 31 00
			39 01 00 00 00 00 02 32 00
			39 01 00 00 00 00 02 33 00
			39 01 00 00 00 00 02 34 00
			39 01 00 00 00 00 02 35 00
			39 01 00 00 00 00 02 36 00
			39 01 00 00 00 00 02 37 00
			39 01 00 00 00 00 02 38 00
			39 01 00 00 00 00 02 39 00
			39 01 00 00 00 00 02 3A 00
			39 01 00 00 00 00 02 3B 00
			39 01 00 00 00 00 02 3C 00
			39 01 00 00 00 00 02 3D 00
			39 01 00 00 00 00 02 3E 00
			39 01 00 00 00 00 02 3F 00
			39 01 00 00 00 00 02 40 00
			39 01 00 00 00 00 02 41 00
			39 01 00 00 00 00 02 42 00
			39 01 00 00 00 00 02 43 00
			39 01 00 00 00 00 02 44 00
			39 01 00 00 00 00 02 45 00
			39 01 00 00 00 00 02 46 00
			39 01 00 00 00 00 02 47 00
			39 01 00 00 00 00 02 48 00
			39 01 00 00 00 00 02 49 00
			39 01 00 00 00 00 02 4A 00
			39 01 00 00 00 00 02 4B 00
			39 01 00 00 00 00 02 4C 00
			39 01 00 00 00 00 02 4D 00
			39 01 00 00 00 00 02 4E 00
			39 01 00 00 00 00 02 4F 00
			39 01 00 00 00 00 02 50 00
			39 01 00 00 00 00 02 51 00
			39 01 00 00 00 00 02 52 00
			39 01 00 00 00 00 02 53 00
			39 01 00 00 00 00 02 54 00
			39 01 00 00 00 00 02 55 00
			39 01 00 00 00 00 02 56 00
			39 01 00 00 00 00 02 57 00
			39 01 00 00 00 00 02 58 00
			39 01 00 00 00 00 02 59 00
			39 01 00 00 00 00 02 5A 00
			39 01 00 00 00 00 02 5B 00
			39 01 00 00 00 00 02 5C 00
			39 01 00 00 00 00 02 5D 00
			39 01 00 00 00 00 02 5E 00
			39 01 00 00 00 00 02 5F 00
			39 01 00 00 00 00 02 60 00
			39 01 00 00 00 00 02 61 00
			39 01 00 00 00 00 02 62 00
			39 01 00 00 00 00 02 63 00
			39 01 00 00 00 00 02 64 00
			39 01 00 00 00 00 02 65 00
			39 01 00 00 00 00 02 66 00
			39 01 00 00 00 00 02 67 00
			39 01 00 00 00 00 02 68 00
			39 01 00 00 00 00 02 69 00
			39 01 00 00 00 00 02 6A 00
			39 01 00 00 00 00 02 6B 00
			39 01 00 00 00 00 02 6C 00
			39 01 00 00 00 00 02 6D 00
			39 01 00 00 00 00 02 6E 00
			39 01 00 00 00 00 02 6F 00
			39 01 00 00 00 00 02 70 00
			39 01 00 00 00 00 02 71 00
			39 01 00 00 00 00 02 72 00
			39 01 00 00 00 00 02 73 00
			39 01 00 00 00 00 02 74 00
			39 01 00 00 00 00 02 75 00
			39 01 00 00 00 00 02 76 00
			39 01 00 00 00 00 02 77 00
			39 01 00 00 00 00 02 78 00
			39 01 00 00 00 00 02 79 00
			39 01 00 00 00 00 02 7A 00
			39 01 00 00 00 00 02 7B 00
			39 01 00 00 00 00 02 7C 00
			39 01 00 00 00 00 02 7D 00
			39 01 00 00 00 00 02 7E 00
			39 01 00 00 00 00 02 7F 00
			39 01 00 00 00 00 04 FF 98 81 06
			39 01 00 00 00 00 02 00 00
			39 01 00 00 00 00 02 01 00
			39 01 00 00 00 00 02 02 00
			39 01 00 00 00 00 02 03 00
			39 01 00 00 00 00 02 04 00
			39 01 00 00 00 00 02 05 00
			39 01 00 00 00 00 02 06 00
			39 01 00 00 00 00 02 07 00
			39 01 00 00 00 00 02 08 00
			39 01 00 00 00 00 02 09 00
			39 01 00 00 00 00 02 0A 00
			39 01 00 00 00 00 02 0B 00
			39 01 00 00 00 00 02 0C 00
			39 01 00 00 00 00 02 0D 00
			39 01 00 00 00 00 02 0E 00
			39 01 00 00 00 00 02 0F 00
			39 01 00 00 00 00 02 10 00
			39 01 00 00 00 00 02 11 00
			39 01 00 00 00 00 02 12 00
			39 01 00 00 00 00 02 13 00
			39 01 00 00 00 00 02 14 00
			39 01 00 00 00 00 02 15 00
			39 01 00 00 00 00 02 16 00
			39 01 00 00 00 00 02 17 00
			39 01 00 00 00 00 02 18 00
			39 01 00 00 00 00 02 19 00
			39 01 00 00 00 00 02 1A 00
			39 01 00 00 00 00 02 1B 00
			39 01 00 00 00 00 02 1C 00
			39 01 00 00 00 00 02 1D 00
			39 01 00 00 00 00 02 1E 00
			39 01 00 00 00 00 02 1F 00
			39 01 00 00 00 00 02 20 00
			39 01 00 00 00 00 02 21 00
			39 01 00 00 00 00 02 22 00
			39 01 00 00 00 00 02 23 00
			39 01 00 00 00 00 02 24 00
			39 01 00 00 00 00 02 25 00
			39 01 00 00 00 00 02 26 00
			39 01 00 00 00 00 02 27 00
			39 01 00 00 00 00 02 28 00
			39 01 00 00 00 00 02 29 00
			39 01 00 00 00 00 02 2A 00
			39 01 00 00 00 00 02 2B 00
			39 01 00 00 00 00 02 2C 00
			39 01 00 00 00 00 02 2D 00
			39 01 00 00 00 00 02 2E 00
			39 01 00 00 00 00 02 2F 00
			39 01 00 00 00 00 02 30 00
			39 01 00 00 00 00 02 31 00
			39 01 00 00 00 00 02 32 00
			39 01 00 00 00 00 02 33 00
			39 01 00 00 00 00 02 34 00
			39 01 00 00 00 00 02 35 00
			39 01 00 00 00 00 02 36 00
			39 01 00 00 00 00 02 37 00
			39 01 00 00 00 00 02 38 00
			39 01 00 00 00 00 02 39 00
			39 01 00 00 00 00 02 3A 00
			39 01 00 00 00 00 02 3B 00
			39 01 00 00 00 00 02 3C 00
			39 01 00 00 00 00 02 3D 00
			39 01 00 00 00 00 02 3E 00
			39 01 00 00 00 00 02 3F 00
			39 01 00 00 00 00 02 40 00
			39 01 00 00 00 00 02 41 00
			39 01 00 00 00 00 02 42 00
			39 01 00 00 00 00 02 43 00
			39 01 00 00 00 00 02 44 00
			39 01 00 00 00 00 02 45 00
			39 01 00 00 00 00 02 46 00
			39 01 00 00 00 00 02 47 00
			39 01 00 00 00 00 02 48 00
			39 01 00 00 00 00 02 49 00
			39 01 00 00 00 00 02 4A 00
			39 01 00 00 00 00 02 4B 00
			39 01 00 00 00 00 02 4C 00
			39 01 00 00 00 00 02 4D 00
			39 01 00 00 00 00 02 4E 00
			39 01 00 00 00 00 02 4F 00
			39 01 00 00 00 00 02 50 00
			39 01 00 00 00 00 02 51 00
			39 01 00 00 00 00 02 52 00
			39 01 00 00 00 00 02 53 00
			39 01 00 00 00 00 02 54 00
			39 01 00 00 00 00 02 55 00
			39 01 00 00 00 00 02 56 00
			39 01 00 00 00 00 02 57 00
			39 01 00 00 00 00 02 58 00
			39 01 00 00 00 00 02 59 00
			39 01 00 00 00 00 02 5A 00
			39 01 00 00 00 00 02 5B 00
			39 01 00 00 00 00 02 5C 00
			39 01 00 00 00 00 02 5D 00
			39 01 00 00 00 00 02 5E 00
			39 01 00 00 00 00 02 5F 00
			39 01 00 00 00 00 02 60 00
			39 01 00 00 00 00 02 61 00
			39 01 00 00 00 00 02 62 00
			39 01 00 00 00 00 02 63 00
			39 01 00 00 00 00 02 64 00
			39 01 00 00 00 00 02 65 00
			39 01 00 00 00 00 02 66 00
			39 01 00 00 00 00 02 67 00
			39 01 00 00 00 00 02 68 00
			39 01 00 00 00 00 02 69 00
			39 01 00 00 00 00 02 6A 00
			39 01 00 00 00 00 02 6B 00
			39 01 00 00 00 00 02 6C 00
			39 01 00 00 00 00 02 6D 00
			39 01 00 00 00 00 02 6E 00
			39 01 00 00 00 00 02 6F 00
			39 01 00 00 00 00 02 70 00
			39 01 00 00 00 00 02 71 00
			39 01 00 00 00 00 02 72 00
			39 01 00 00 00 00 02 73 00
			39 01 00 00 00 00 02 74 00
			39 01 00 00 00 00 02 75 00
			39 01 00 00 00 00 02 76 00
			39 01 00 00 00 00 02 77 00
			39 01 00 00 00 00 02 78 00
			39 01 00 00 00 00 02 79 00
			39 01 00 00 00 00 02 7A 00
			39 01 00 00 00 00 02 7B 00
			39 01 00 00 00 00 02 7C 00
			39 01 00 00 00 00 02 7D 00
			39 01 00 00 00 00 02 7E 00
			39 01 00 00 00 00 02 7F 00
			39 01 00 00 00 00 04 FF 98 81 07
			39 01 00 00 00 00 02 00 00
			39 01 00 00 00 00 02 01 00
			39 01 00 00 00 00 02 02 00
			39 01 00 00 00 00 02 03 81
			39 01 00 00 00 00 02 04 81
			39 01 00 00 00 00 02 05 81
			39 01 00 00 00 00 02 06 81
			39 01 00 00 00 00 02 07 81
			39 01 00 00 00 00 02 08 81
			39 01 00 00 00 00 02 09 82
			39 01 00 00 00 00 02 0A 82
			39 01 00 00 00 00 02 0B 82
			39 01 00 00 00 00 02 0C 82
			39 01 00 00 00 00 02 0D 82
			39 01 00 00 00 00 02 0E 82
			39 01 00 00 00 00 02 0F 83
			39 01 00 00 00 00 02 10 83
			39 01 00 00 00 00 02 11 83
			39 01 00 00 00 00 02 12 83
			39 01 00 00 00 00 02 13 83
			39 01 00 00 00 00 02 14 83
			39 01 00 00 00 00 02 15 84
			39 01 00 00 00 00 02 16 84
			39 01 00 00 00 00 02 17 84
			39 01 00 00 00 00 02 18 84
			39 01 00 00 00 00 02 19 84
			39 01 00 00 00 00 02 1A 84
			39 01 00 00 00 00 02 1B 85
			39 01 00 00 00 00 02 1C 85
			39 01 00 00 00 00 02 1D 85
			39 01 00 00 00 00 02 1E 85
			39 01 00 00 00 00 02 1F 85
			39 01 00 00 00 00 02 20 85
			39 01 00 00 00 00 02 21 86
			39 01 00 00 00 00 02 22 86
			39 01 00 00 00 00 02 23 86
			39 01 00 00 00 00 02 24 86
			39 01 00 00 00 00 02 25 86
			39 01 00 00 00 00 02 26 86
			39 01 00 00 00 00 02 27 87
			39 01 00 00 00 00 02 28 87
			39 01 00 00 00 00 02 29 87
			39 01 00 00 00 00 02 2A 87
			39 01 00 00 00 00 02 2B 87
			39 01 00 00 00 00 02 2C 87
			39 01 00 00 00 00 02 2D 88
			39 01 00 00 00 00 02 2E 88
			39 01 00 00 00 00 02 2F 88
			39 01 00 00 00 00 02 30 88
			39 01 00 00 00 00 02 31 88
			39 01 00 00 00 00 02 32 88
			39 01 00 00 00 00 02 33 89
			39 01 00 00 00 00 02 34 89
			39 01 00 00 00 00 02 35 89
			39 01 00 00 00 00 02 36 89
			39 01 00 00 00 00 02 37 89
			39 01 00 00 00 00 02 38 89
			39 01 00 00 00 00 02 39 8A
			39 01 00 00 00 00 02 3A 8A
			39 01 00 00 00 00 02 3B 8A
			39 01 00 00 00 00 02 3C 8A
			39 01 00 00 00 00 02 3D 8A
			39 01 00 00 00 00 02 3E 8A
			39 01 00 00 00 00 02 3F 8B
			39 01 00 00 00 00 02 40 8B
			39 01 00 00 00 00 02 41 8B
			39 01 00 00 00 00 02 42 8B
			39 01 00 00 00 00 02 43 8B
			39 01 00 00 00 00 02 44 8B
			39 01 00 00 00 00 02 45 8C
			39 01 00 00 00 00 02 46 8C
			39 01 00 00 00 00 02 47 8C
			39 01 00 00 00 00 02 48 8C
			39 01 00 00 00 00 02 49 8C
			39 01 00 00 00 00 02 4A 8C
			39 01 00 00 00 00 02 4B 8D
			39 01 00 00 00 00 02 4C 8D
			39 01 00 00 00 00 02 4D 8D
			39 01 00 00 00 00 02 4E 8D
			39 01 00 00 00 00 02 4F 8D
			39 01 00 00 00 00 02 50 8D
			39 01 00 00 00 00 02 51 8E
			39 01 00 00 00 00 02 52 8E
			39 01 00 00 00 00 02 53 8E
			39 01 00 00 00 00 02 54 8E
			39 01 00 00 00 00 02 55 8E
			39 01 00 00 00 00 02 56 8E
			39 01 00 00 00 00 02 57 8F
			39 01 00 00 00 00 02 58 8F
			39 01 00 00 00 00 02 59 8F
			39 01 00 00 00 00 02 5A 8F
			39 01 00 00 00 00 02 5B 8F
			39 01 00 00 00 00 02 5C 8F
			39 01 00 00 00 00 02 5D 90
			39 01 00 00 00 00 02 5E 90
			39 01 00 00 00 00 02 5F 90
			39 01 00 00 00 00 02 60 90
			39 01 00 00 00 00 02 61 90
			39 01 00 00 00 00 02 62 90
			39 01 00 00 00 00 02 63 91
			39 01 00 00 00 00 02 64 91
			39 01 00 00 00 00 02 65 91
			39 01 00 00 00 00 02 66 91
			39 01 00 00 00 00 02 67 91
			39 01 00 00 00 00 02 68 91
			39 01 00 00 00 00 02 69 92
			39 01 00 00 00 00 02 6A 92
			39 01 00 00 00 00 02 6B 92
			39 01 00 00 00 00 02 6C 92
			39 01 00 00 00 00 02 6D 92
			39 01 00 00 00 00 02 6E 92
			39 01 00 00 00 00 02 6F 93
			39 01 00 00 00 00 02 70 93
			39 01 00 00 00 00 02 71 93
			39 01 00 00 00 00 02 72 93
			39 01 00 00 00 00 02 73 93
			39 01 00 00 00 00 02 74 93
			39 01 00 00 00 00 02 75 94
			39 01 00 00 00 00 02 76 94
			39 01 00 00 00 00 02 77 94
			39 01 00 00 00 00 02 78 94
			39 01 00 00 00 00 02 79 94
			39 01 00 00 00 00 02 7A 94
			39 01 00 00 00 00 02 7B 95
			39 01 00 00 00 00 02 7C 95
			39 01 00 00 00 00 02 7D 95
			39 01 00 00 00 00 02 7E 95
			39 01 00 00 00 00 02 7F 95
			39 01 00 00 00 00 04 FF 98 81 08
			39 01 00 00 00 00 02 00 95
			39 01 00 00 00 00 02 01 96
			39 01 00 00 00 00 02 02 96
			39 01 00 00 00 00 02 03 96
			39 01 00 00 00 00 02 04 96
			39 01 00 00 00 00 02 05 96
			39 01 00 00 00 00 02 06 97
			39 01 00 00 00 00 02 07 97
			39 01 00 00 00 00 02 08 97
			39 01 00 00 00 00 02 09 97
			39 01 00 00 00 00 02 0A 97
			39 01 00 00 00 00 02 0B 97
			39 01 00 00 00 00 02 0C 98
			39 01 00 00 00 00 02 0D 98
			39 01 00 00 00 00 02 0E 98
			39 01 00 00 00 00 02 0F 98
			39 01 00 00 00 00 02 10 98
			39 01 00 00 00 00 02 11 98
			39 01 00 00 00 00 02 12 99
			39 01 00 00 00 00 02 13 99
			39 01 00 00 00 00 02 14 99
			39 01 00 00 00 00 02 15 99
			39 01 00 00 00 00 02 16 99
			39 01 00 00 00 00 02 17 99
			39 01 00 00 00 00 02 18 9A
			39 01 00 00 00 00 02 19 9A
			39 01 00 00 00 00 02 1A 9A
			39 01 00 00 00 00 02 1B 9A
			39 01 00 00 00 00 02 1C 9A
			39 01 00 00 00 00 02 1D 9A
			39 01 00 00 00 00 02 1E 9B
			39 01 00 00 00 00 02 1F 9B
			39 01 00 00 00 00 02 20 9B
			39 01 00 00 00 00 02 21 9B
			39 01 00 00 00 00 02 22 9B
			39 01 00 00 00 00 02 23 9B
			39 01 00 00 00 00 02 24 9C
			39 01 00 00 00 00 02 25 9C
			39 01 00 00 00 00 02 26 9C
			39 01 00 00 00 00 02 27 9C
			39 01 00 00 00 00 02 28 9C
			39 01 00 00 00 00 02 29 9C
			39 01 00 00 00 00 02 2A 9D
			39 01 00 00 00 00 02 2B 9D
			39 01 00 00 00 00 02 2C 9D
			39 01 00 00 00 00 02 2D 9D
			39 01 00 00 00 00 02 2E 9D
			39 01 00 00 00 00 02 2F 9D
			39 01 00 00 00 00 02 30 9E
			39 01 00 00 00 00 02 31 9E
			39 01 00 00 00 00 02 32 9E
			39 01 00 00 00 00 02 33 9E
			39 01 00 00 00 00 02 34 9E
			39 01 00 00 00 00 02 35 9E
			39 01 00 00 00 00 02 36 9F
			39 01 00 00 00 00 02 37 9F
			39 01 00 00 00 00 02 38 9F
			39 01 00 00 00 00 02 39 9F
			39 01 00 00 00 00 02 3A 9F
			39 01 00 00 00 00 02 3B 9F
			39 01 00 00 00 00 02 3C A0
			39 01 00 00 00 00 02 3D A0
			39 01 00 00 00 00 02 3E A0
			39 01 00 00 00 00 02 3F A0
			39 01 00 00 00 00 02 40 A0
			39 01 00 00 00 00 02 41 A0
			39 01 00 00 00 00 02 42 A1
			39 01 00 00 00 00 02 43 A1
			39 01 00 00 00 00 02 44 A1
			39 01 00 00 00 00 02 45 A1
			39 01 00 00 00 00 02 46 A1
			39 01 00 00 00 00 02 47 A1
			39 01 00 00 00 00 02 48 A2
			39 01 00 00 00 00 02 49 A2
			39 01 00 00 00 00 02 4A A2
			39 01 00 00 00 00 02 4B A2
			39 01 00 00 00 00 02 4C A2
			39 01 00 00 00 00 02 4D A2
			39 01 00 00 00 00 02 4E A3
			39 01 00 00 00 00 02 4F A3
			39 01 00 00 00 00 02 50 A3
			39 01 00 00 00 00 02 51 A3
			39 01 00 00 00 00 02 52 A3
			39 01 00 00 00 00 02 53 A3
			39 01 00 00 00 00 02 54 A4
			39 01 00 00 00 00 02 55 A4
			39 01 00 00 00 00 02 56 A4
			39 01 00 00 00 00 02 57 A4
			39 01 00 00 00 00 02 58 A4
			39 01 00 00 00 00 02 59 A4
			39 01 00 00 00 00 02 5A A5
			39 01 00 00 00 00 02 5B A5
			39 01 00 00 00 00 02 5C A5
			39 01 00 00 00 00 02 5D A5
			39 01 00 00 00 00 02 5E A5
			39 01 00 00 00 00 02 5F A5
			39 01 00 00 00 00 02 60 A6
			39 01 00 00 00 00 02 61 A6
			39 01 00 00 00 00 02 62 A6
			39 01 00 00 00 00 02 63 A6
			39 01 00 00 00 00 02 64 A6
			39 01 00 00 00 00 02 65 A6
			39 01 00 00 00 00 02 66 A7
			39 01 00 00 00 00 02 67 A7
			39 01 00 00 00 00 02 68 A7
			39 01 00 00 00 00 02 69 A7
			39 01 00 00 00 00 02 6A A7
			39 01 00 00 00 00 02 6B A7
			39 01 00 00 00 00 02 6C A8
			39 01 00 00 00 00 02 6D A8
			39 01 00 00 00 00 02 6E A8
			39 01 00 00 00 00 02 6F A8
			39 01 00 00 00 00 02 70 A8
			39 01 00 00 00 00 02 71 A8
			39 01 00 00 00 00 02 72 A9
			39 01 00 00 00 00 02 73 A9
			39 01 00 00 00 00 02 74 A9
			39 01 00 00 00 00 02 75 A9
			39 01 00 00 00 00 02 76 A9
			39 01 00 00 00 00 02 77 A9
			39 01 00 00 00 00 02 78 AA
			39 01 00 00 00 00 02 79 AA
			39 01 00 00 00 00 02 7A AA
			39 01 00 00 00 00 02 7B AA
			39 01 00 00 00 00 02 7C AA
			39 01 00 00 00 00 02 7D AA
			39 01 00 00 00 00 02 7E AB
			39 01 00 00 00 00 02 7F AB
			39 01 00 00 00 00 04 FF 98 81 09
			39 01 00 00 00 00 02 00 00
			39 01 00 00 00 00 02 01 00
			39 01 00 00 00 00 02 02 81
			39 01 00 00 00 00 02 03 81
			39 01 00 00 00 00 02 04 82
			39 01 00 00 00 00 02 05 82
			39 01 00 00 00 00 02 06 83
			39 01 00 00 00 00 02 07 83
			39 01 00 00 00 00 02 08 84
			39 01 00 00 00 00 02 09 84
			39 01 00 00 00 00 02 0A 85
			39 01 00 00 00 00 02 0B 85
			39 01 00 00 00 00 02 0C 86
			39 01 00 00 00 00 02 0D 86
			39 01 00 00 00 00 02 0E 87
			39 01 00 00 00 00 02 0F 87
			39 01 00 00 00 00 02 10 88
			39 01 00 00 00 00 02 11 88
			39 01 00 00 00 00 02 12 89
			39 01 00 00 00 00 02 13 89
			39 01 00 00 00 00 02 14 8A
			39 01 00 00 00 00 02 15 8A
			39 01 00 00 00 00 02 16 8B
			39 01 00 00 00 00 02 17 8B
			39 01 00 00 00 00 02 18 8C
			39 01 00 00 00 00 02 19 8C
			39 01 00 00 00 00 02 1A 8D
			39 01 00 00 00 00 02 1B 8D
			39 01 00 00 00 00 02 1C 8E
			39 01 00 00 00 00 02 1D 8E
			39 01 00 00 00 00 02 1E 8F
			39 01 00 00 00 00 02 1F 8F
			39 01 00 00 00 00 02 20 90
			39 01 00 00 00 00 02 21 90
			39 01 00 00 00 00 02 22 91
			39 01 00 00 00 00 02 23 91
			39 01 00 00 00 00 02 24 92
			39 01 00 00 00 00 02 25 92
			39 01 00 00 00 00 02 26 93
			39 01 00 00 00 00 02 27 93
			39 01 00 00 00 00 02 28 94
			39 01 00 00 00 00 02 29 94
			39 01 00 00 00 00 02 2A 95
			39 01 00 00 00 00 02 2B 95
			39 01 00 00 00 00 02 2C 96
			39 01 00 00 00 00 02 2D 96
			39 01 00 00 00 00 02 2E 97
			39 01 00 00 00 00 02 2F 97
			39 01 00 00 00 00 02 30 98
			39 01 00 00 00 00 02 31 98
			39 01 00 00 00 00 02 32 99
			39 01 00 00 00 00 02 33 99
			39 01 00 00 00 00 02 34 9A
			39 01 00 00 00 00 02 35 9A
			39 01 00 00 00 00 02 36 9B
			39 01 00 00 00 00 02 37 9B
			39 01 00 00 00 00 02 38 9C
			39 01 00 00 00 00 02 39 9C
			39 01 00 00 00 00 02 3A 9D
			39 01 00 00 00 00 02 3B 9D
			39 01 00 00 00 00 02 3C 9E
			39 01 00 00 00 00 02 3D 9E
			39 01 00 00 00 00 02 3E 9F
			39 01 00 00 00 00 02 3F 9F
			39 01 00 00 00 00 02 40 A0
			39 01 00 00 00 00 02 41 A0
			39 01 00 00 00 00 02 42 A1
			39 01 00 00 00 00 02 43 A1
			39 01 00 00 00 00 02 44 A2
			39 01 00 00 00 00 02 45 A2
			39 01 00 00 00 00 02 46 A3
			39 01 00 00 00 00 02 47 A3
			39 01 00 00 00 00 02 48 A4
			39 01 00 00 00 00 02 49 A4
			39 01 00 00 00 00 02 4A A5
			39 01 00 00 00 00 02 4B A5
			39 01 00 00 00 00 02 4C A6
			39 01 00 00 00 00 02 4D A6
			39 01 00 00 00 00 02 4E A7
			39 01 00 00 00 00 02 4F A7
			39 01 00 00 00 00 02 50 A8
			39 01 00 00 00 00 02 51 A8
			39 01 00 00 00 00 02 52 A9
			39 01 00 00 00 00 02 53 A9
			39 01 00 00 00 00 02 54 AA
			39 01 00 00 00 00 02 55 AA
			39 01 00 00 00 00 02 56 AB
			39 01 00 00 00 00 02 57 AB
			39 01 00 00 00 00 02 58 AC
			39 01 00 00 00 00 02 59 AC
			39 01 00 00 00 00 02 5A AD
			39 01 00 00 00 00 02 5B AD
			39 01 00 00 00 00 02 5C AE
			39 01 00 00 00 00 02 5D AE
			39 01 00 00 00 00 02 5E AF
			39 01 00 00 00 00 02 5F AF
			39 01 00 00 00 00 02 60 B0
			39 01 00 00 00 00 02 61 B0
			39 01 00 00 00 00 02 62 B1
			39 01 00 00 00 00 02 63 B1
			39 01 00 00 00 00 02 64 B2
			39 01 00 00 00 00 02 65 B2
			39 01 00 00 00 00 02 66 B3
			39 01 00 00 00 00 02 67 B3
			39 01 00 00 00 00 02 68 B4
			39 01 00 00 00 00 02 69 B4
			39 01 00 00 00 00 02 6A B5
			39 01 00 00 00 00 02 6B B5
			39 01 00 00 00 00 02 6C B6
			39 01 00 00 00 00 02 6D B6
			39 01 00 00 00 00 02 6E B7
			39 01 00 00 00 00 02 6F B7
			39 01 00 00 00 00 02 70 B8
			39 01 00 00 00 00 02 71 B8
			39 01 00 00 00 00 02 72 B9
			39 01 00 00 00 00 02 73 B9
			39 01 00 00 00 00 02 74 BA
			39 01 00 00 00 00 02 75 BA
			39 01 00 00 00 00 02 76 BB
			39 01 00 00 00 00 02 77 BB
			39 01 00 00 00 00 02 78 BC
			39 01 00 00 00 00 02 79 BC
			39 01 00 00 00 00 02 7A BD
			39 01 00 00 00 00 02 7B BD
			39 01 00 00 00 00 02 7C BE
			39 01 00 00 00 00 02 7D BE
			39 01 00 00 00 00 02 7E BF
			39 01 00 00 00 00 02 7F BF
			39 01 00 00 00 00 04 FF 98 81 0A
			39 01 00 00 00 00 02 00 C0
			39 01 00 00 00 00 02 01 C0
			39 01 00 00 00 00 02 02 C1
			39 01 00 00 00 00 02 03 C1
			39 01 00 00 00 00 02 04 C2
			39 01 00 00 00 00 02 05 C2
			39 01 00 00 00 00 02 06 C3
			39 01 00 00 00 00 02 07 C3
			39 01 00 00 00 00 02 08 C4
			39 01 00 00 00 00 02 09 C4
			39 01 00 00 00 00 02 0A C5
			39 01 00 00 00 00 02 0B C5
			39 01 00 00 00 00 02 0C C6
			39 01 00 00 00 00 02 0D C6
			39 01 00 00 00 00 02 0E C7
			39 01 00 00 00 00 02 0F C7
			39 01 00 00 00 00 02 10 C8
			39 01 00 00 00 00 02 11 C8
			39 01 00 00 00 00 02 12 C9
			39 01 00 00 00 00 02 13 C9
			39 01 00 00 00 00 02 14 CA
			39 01 00 00 00 00 02 15 CA
			39 01 00 00 00 00 02 16 CB
			39 01 00 00 00 00 02 17 CB
			39 01 00 00 00 00 02 18 CC
			39 01 00 00 00 00 02 19 CC
			39 01 00 00 00 00 02 1A CD
			39 01 00 00 00 00 02 1B CD
			39 01 00 00 00 00 02 1C CE
			39 01 00 00 00 00 02 1D CE
			39 01 00 00 00 00 02 1E CF
			39 01 00 00 00 00 02 1F CF
			39 01 00 00 00 00 02 20 D0
			39 01 00 00 00 00 02 21 D0
			39 01 00 00 00 00 02 22 D1
			39 01 00 00 00 00 02 23 D1
			39 01 00 00 00 00 02 24 D2
			39 01 00 00 00 00 02 25 D2
			39 01 00 00 00 00 02 26 D3
			39 01 00 00 00 00 02 27 D3
			39 01 00 00 00 00 02 28 D4
			39 01 00 00 00 00 02 29 D4
			39 01 00 00 00 00 02 2A D5
			39 01 00 00 00 00 02 2B D5
			39 01 00 00 00 00 02 2C D6
			39 01 00 00 00 00 02 2D D6
			39 01 00 00 00 00 02 2E D7
			39 01 00 00 00 00 02 2F D7
			39 01 00 00 00 00 02 30 D8
			39 01 00 00 00 00 02 31 D8
			39 01 00 00 00 00 02 32 D9
			39 01 00 00 00 00 02 33 D9
			39 01 00 00 00 00 02 34 DA
			39 01 00 00 00 00 02 35 DA
			39 01 00 00 00 00 02 36 DB
			39 01 00 00 00 00 02 37 DB
			39 01 00 00 00 00 02 38 DC
			39 01 00 00 00 00 02 39 DC
			39 01 00 00 00 00 02 3A DD
			39 01 00 00 00 00 02 3B DD
			39 01 00 00 00 00 02 3C DE
			39 01 00 00 00 00 02 3D DE
			39 01 00 00 00 00 02 3E DF
			39 01 00 00 00 00 02 3F DF
			39 01 00 00 00 00 02 40 E0
			39 01 00 00 00 00 02 41 E0
			39 01 00 00 00 00 02 42 E1
			39 01 00 00 00 00 02 43 E1
			39 01 00 00 00 00 02 44 E2
			39 01 00 00 00 00 02 45 E2
			39 01 00 00 00 00 02 46 E3
			39 01 00 00 00 00 02 47 E3
			39 01 00 00 00 00 02 48 E4
			39 01 00 00 00 00 02 49 E4
			39 01 00 00 00 00 02 4A E5
			39 01 00 00 00 00 02 4B E5
			39 01 00 00 00 00 02 4C E6
			39 01 00 00 00 00 02 4D E6
			39 01 00 00 00 00 02 4E E7
			39 01 00 00 00 00 02 4F E7
			39 01 00 00 00 00 02 50 E8
			39 01 00 00 00 00 02 51 E8
			39 01 00 00 00 00 02 52 E9
			39 01 00 00 00 00 02 53 E9
			39 01 00 00 00 00 02 54 EA
			39 01 00 00 00 00 02 55 EA
			39 01 00 00 00 00 02 56 EB
			39 01 00 00 00 00 02 57 EB
			39 01 00 00 00 00 02 58 EC
			39 01 00 00 00 00 02 59 EC
			39 01 00 00 00 00 02 5A ED
			39 01 00 00 00 00 02 5B ED
			39 01 00 00 00 00 02 5C EE
			39 01 00 00 00 00 02 5D EE
			39 01 00 00 00 00 02 5E EF
			39 01 00 00 00 00 02 5F EF
			39 01 00 00 00 00 02 60 F0
			39 01 00 00 00 00 02 61 F0
			39 01 00 00 00 00 02 62 F1
			39 01 00 00 00 00 02 63 F1
			39 01 00 00 00 00 02 64 F2
			39 01 00 00 00 00 02 65 F2
			39 01 00 00 00 00 02 66 F3
			39 01 00 00 00 00 02 67 F3
			39 01 00 00 00 00 02 68 F4
			39 01 00 00 00 00 02 69 F4
			39 01 00 00 00 00 02 6A F5
			39 01 00 00 00 00 02 6B F5
			39 01 00 00 00 00 02 6C F6
			39 01 00 00 00 00 02 6D F6
			39 01 00 00 00 00 02 6E F7
			39 01 00 00 00 00 02 6F F7
			39 01 00 00 00 00 02 70 F8
			39 01 00 00 00 00 02 71 F8
			39 01 00 00 00 00 02 72 F9
			39 01 00 00 00 00 02 73 F9
			39 01 00 00 00 00 02 74 FA
			39 01 00 00 00 00 02 75 FA
			39 01 00 00 00 00 02 76 FB
			39 01 00 00 00 00 02 77 FB
			39 01 00 00 00 00 02 78 FC
			39 01 00 00 00 00 02 79 FC
			39 01 00 00 00 00 02 7A FF
			39 01 00 00 00 00 02 7B FF
			39 01 00 00 00 00 02 7C FF
			39 01 00 00 00 00 02 7D FF
			39 01 00 00 00 00 02 7E FF
			39 01 00 00 00 00 02 7F FF
			39 01 00 00 00 00 04 FF 98 81 00
			39 01 00 00 00 00 02 55 01
			39 01 00 00 00 00 02 51 FF
			39 01 00 00 00 00 02 53 2C
			39 01 00 00 00 00 02 35 00
			05 01 00 00 78 00 02 11 00
			05 01 00 00 14 00 02 29 00];
		qcom,mdss-dsi-off-command = [
			05 01 00 00 32 00 02 28 00
			05 01 00 00 78 00 02 10 00];
		qcom,mdss-dsi-on-command-state = "dsi_lp_mode";
		qcom,mdss-dsi-off-command-state = "dsi_hs_mode";
		qcom,mdss-dsi-panel-status-command = [06 01 00 01 05 00 02 0A 08];
		qcom,mdss-dsi-panel-status-command-state = "dsi_lp_mode";
		qcom,mdss-dsi-panel-status-check-mode = "reg_read";
		qcom,mdss-dsi-panel-status-value = <0x9C>;
		qcom,mdss-dsi-tx-eot-append;
		qcom,mdss-dsi-h-sync-pulse = <1>;
		qcom,mdss-dsi-lp11-init;
		qcom,mdss-dsi-init-delay-us = <50000>;
		qcom,mdss-dsi-traffic-mode = "burst_mode";
		qcom,mdss-dsi-lane-map = <0>;
		qcom,mdss-dsi-bllp-eof-power-mode;
		qcom,mdss-dsi-bllp-power-mode;
		qcom,mdss-dsi-lane-0-state;
		qcom,mdss-dsi-lane-1-state;
		qcom,mdss-dsi-lane-2-state;
		qcom,mdss-dsi-lane-3-state;
		qcom,mdss-dsi-panel-timings = [8B 1E 14 00 44 48 18 22 19 03 04 00];
		qcom,mdss-dsi-t-clk-post = <0x04>;
		qcom,mdss-dsi-t-clk-pre = <0x1C>;
		qcom,mdss-dsi-bl-min-level = <16>;
		qcom,mdss-dsi-bl-max-level = <240>;
		qcom,mdss-dsi-dma-trigger = <4>;
		qcom,mdss-dsi-mdp-trigger = <0>;
		qcom,mdss-dsi-bl-pmic-control-type = "bl_ctrl_wled";
		qcom,mdss-dsi-reset-sequence = <1 10>, <0 1>, <1 15>;
		qcom,mdss-pan-physical-width-dimension = <62>;
		qcom,mdss-pan-physical-height-dimension = <110>;

		cm,mdss-livedisplay-cabc-cmd = [
			15 01 00 00 10 00 02 55 00];
		cm,mdss-livedisplay-cabc-ui-value = <0x01>;
		cm,mdss-livedisplay-cabc-image-value = <0x02>;
		cm,mdss-livedisplay-cabc-video-value = <0x03>;
	};
};
