/*
 * Copyright (c) 2015, The Linux Foundation. All rights reserved.
 *
 * This program is free software; you can redistribute it and/or modify
 * it under the terms of the GNU General Public License version 2 and
 * only version 2 as published by the Free Software Foundation.
 *
 * This program is distributed in the hope that it will be useful,
 * but WITHOUT ANY WARRANTY; without even the implied warranty of
 * MERCHANTABILITY or FITNESS FOR A PARTICULAR PURPOSE.  See the
 * GNU General Public License for more details.
 */

/dts-v1/;

#include "msm8939-v3.0.dtsi"
#include "15018/msm8939-mtp.dtsi"

/ {
	model = "Qualcomm Technologies, Inc. MSM 8939v3.0 MTP 15018 Spectrum";
	compatible = "qcom,msm8939-mtp", "qcom,msm8939", "qcom,mtp";
	qcom,board-id = <8 0>;
};

&soc {
	fpc_fpc1020@0 {
		compatible = "fpc,fpc1020-qsee4";
		fpc,reset-gpio = <&msm_gpio 95 0x00>;
		fpc,irq-gpio = <&msm_gpio 31 0x00>;
		vdd_io-supply = <&pm8916_l5>;
		clocks = <&clock_gcc clk_gcc_blsp1_ahb_clk>,
			 <&clock_gcc clk_gcc_blsp1_qup6_spi_apps_clk>;
		clock-names = "iface_clk", "core_clk";
	};
};
