/* Copyright (c) 2013, The Linux Foundation. All rights reserved.
 *
 * This program is free software; you can redistribute it and/or modify
 * it under the terms of the GNU General Public License version 2 and
 * only version 2 as published by the Free Software Foundation.
 *
 * This program is distributed in the hope that it will be useful,
 * but WITHOUT ANY WARRANTY; without even the implied warranty of
 * MERCHANTABILITY or FITNESS FOR A PARTICULAR PURPOSE.  See the
 * GNU General Public License for more details.
 */

/*---------------------------------------------------------------------------
 * This file is autogenerated file using gcdb parser. Please do not edit it.
 * Update input XML file to add a new entry or update variable in this file
 * VERSION = "1.0"
 *---------------------------------------------------------------------------*/
&mdss_mdp {
	dsi_oppo14017synaptics_720p_video: qcom,mdss_dsi_oppo14017synaptics_720p_video {
		qcom,cont-splash-enabled;
		qcom,mdss-dsi-panel-name = "oppo14017synaptics 720p video mode dsi panel";
		qcom,mdss-dsi-panel-manufacture = "JDI";
		qcom,mdss-dsi-panel-version = "OTM1282C";
		qcom,mdss-dsi-panel-controller = <&mdss_dsi0>;
		qcom,mdss-dsi-panel-type = "dsi_video_mode";
		qcom,mdss-dsi-panel-destination = "display_1";
		qcom,mdss-dsi-panel-framerate = <60>;
		qcom,mdss-dsi-virtual-channel-id = <0>;
		qcom,mdss-dsi-stream = <0>;
		qcom,mdss-dsi-panel-width = <720>;
		qcom,mdss-dsi-panel-height = <1280>;
		qcom,mdss-dsi-h-front-porch = <140>;
		qcom,mdss-dsi-h-back-porch = <164>;
		qcom,mdss-dsi-h-pulse-width = <8>;
		qcom,mdss-dsi-h-sync-skew = <0>;
		qcom,mdss-dsi-v-back-porch = <3>;
		qcom,mdss-dsi-v-front-porch = <6>;
		qcom,mdss-dsi-v-pulse-width = <1>;	
		
		qcom,mdss-dsi-h-left-border = <0>;
		qcom,mdss-dsi-h-right-border = <0>;
		qcom,mdss-dsi-v-top-border = <0>;
		qcom,mdss-dsi-v-bottom-border = <0>;
		qcom,mdss-dsi-bpp = <24>;
		qcom,mdss-dsi-color-order = <0>;
		qcom,mdss-dsi-underflow-color = <0xff>;
		qcom,mdss-dsi-border-color = <0>;
		qcom,mdss-dsi-on-command = [
			39 01 00 00 00 00 04 FF 12 82 01
			15 01 00 00 00 00 02 00 80
			39 01 00 00 00 00 03 FF 12 82
			15 01 00 00 00 00 02 00 00
			15 01 00 00 00 00 02 1C 02
			15 01 00 00 00 00 02 00 A0
			39 01 00 00 00 00 04 C1 E0 E0 10			
			15 01 00 00 00 00 02 00 00
			39 01 00 00 00 00 19 E1 00 05 0A 12 19 1F 29 39 44 54 61 6B 8C 84 79 67 4E 36 27 1F 16 0D 09 03
			15 01 00 00 00 00 02 00 00
			39 01 00 00 00 00 19 E2 00 05 0A 12 19 1F 29 39 44 54 61 6B 8C 84 79 67 4E 36 27 1F 16 0D 09 03
			15 01 00 00 00 00 02 00 00
			39 01 00 00 00 00 19 E3 37 39 3A 3D 40 43 49 52 57 62 6B 72 87 7F 75 63 4B 35 26 1E 16 0D 09 03		
			15 01 00 00 00 00 02 00 00
			39 01 00 00 00 00 19 E4 37 39 3A 3D 40 43 49 52 57 62 6B 72 87 7F 75 63 4B 35 26 1E 16 0D 09 03
			15 01 00 00 00 00 02 00 00
			39 01 00 00 00 00 19 E5 23 25 28 2C 30 34 3B 47 4E 5C 66 6F 89 82 77 65 4D 36 27 1E 16 0E 09 03		
			15 01 00 00 00 00 02 00 00
			39 01 00 00 00 00 19 E6 23 25 28 2C 30 34 3B 47 4E 5C 66 6F 89 82 77 65 4D 36 27 1E 16 0E 09 03
				
			39 01 00 00 00 00 02 00 00
			39 01 00 00 00 00 02 59 03
				
			15 01 00 00 00 00 02 00 A0
			39 01 00 00 00 00 0D D6 75 4d 7d 4d 09 9a 01 cd 79 00 75 1a
				
			15 01 00 00 00 00 02 00 B0
			39 01 00 00 00 00 0D D6 75 26 75 26 0d 00 7d 00 15 00 0d 80
				
			15 01 00 00 00 00 02 00 C0
			39 01 00 00 00 00 0D D6 55 11 33 9a 11 89 00 11 11 1a 11 1a
				
			15 01 00 00 00 00 02 00 D0
			39 01 00 00 00 00 07 D6 00 11 00 00 11 55
				
			15 01 00 00 00 00 02 00 E0
			39 01 00 00 00 00 0D D6 3c 11 54 4d 11 44 00 11 09 0d 11 0d
				
			15 01 00 00 00 00 02 00 F0
			39 01 00 00 00 00 07 D6 00 11 00 00 11 2b

			39 01 00 00 00 00 02 00 00
			39 01 00 00 00 00 02 59 00
				
			39 01 00 00 00 00 02 00 00
			39 01 00 00 00 00 02 55 90
				
				
			15 01 00 00 00 00 02 00 80
			39 01 00 00 00 00 03 FF 00 00 
			15 01 00 00 00 00 02 00 00
			39 01 00 00 00 00 04 FF 00 00 00
			
			39 01 00 00 00 00 02 35 00
				
			39 01 00 00 01 00 05 2a 00 00 02 CF
				
			39 01 00 00 01 00 05 2b 00 00 04 FF
				
			05 01 00 00 00 00 02 20 00
				
			15 01 00 00 10 00 02 44 ff

			15 01 00 00 00 00 02 00 00
			39 01 00 00 00 00 04 ff 12 82 01
			15 01 00 00 00 00 02 00 80	
			39 01 00 00 00 00 03 ff 12 82	
			15 01 00 00 00 00 02 00 a0	
			15 01 00 00 00 00 02 a7 3f	
			15 01 00 00 00 00 02 00 e0	
			15 01 00 00 00 00 02 a7 23	
			15 01 00 00 00 00 02 00 a0	
			15 01 00 00 00 00 02 a9 3f			
			
			39 01 00 00 00 00 02 00 B0
			39 01 00 00 00 00 02 CA 0C				
			39 01 00 00 00 00 02 00 B3
			39 01 00 00 00 00 02 CA 50
			39 01 00 00 01 00 02 51 ff
			15 01 00 00 01 00 02 55 03
			15 01 00 00 01 00 02 53 2c
				
				
			05 01 00 00 50 00 02 11 00		
			05 01 00 00 32 00 02 29 00
			39 01 00 00 00 00 02 2c 00];
		qcom,mdss-dsi-off-command = [
			05 01 00 00 32 00 02 28 00
			05 01 00 00 78 00 02 10 00];
		qcom,mdss-dsi-on-command-state = "dsi_lp_mode";
		qcom,mdss-dsi-off-command-state = "dsi_hs_mode";
		qcom,mdss-dsi-h-sync-pulse = <1>;
		qcom,mdss-dsi-traffic-mode = <2>;
		qcom,mdss-dsi-lane-map = <0>;
		qcom,mdss-dsi-bllp-eof-power-mode;
		qcom,mdss-dsi-bllp-power-mode;
		qcom,mdss-dsi-lane-0-state;
		qcom,mdss-dsi-lane-1-state;
		qcom,mdss-dsi-lane-2-state;
		qcom,mdss-dsi-lane-3-state;
		qcom,mdss-dsi-panel-timings = [75 18 10 00 3A 3C 14 1A 13 03 04 00];
		qcom,mdss-dsi-t-clk-post = <0x20>;
		qcom,mdss-dsi-t-clk-pre = <0x2c>;
		qcom,mdss-dsi-bl-min-level = <1>;
		qcom,mdss-dsi-bl-max-level = <255>;
		qcom,mdss-dsi-dma-trigger = <4>;
		qcom,mdss-dsi-mdp-trigger = <0>;
		qcom,mdss-dsi-bl-pmic-control-type = "bl_ctrl_wled";
		qcom,mdss-dsi-reset-sequence = <1 20>, <0 1>, <1 20>;
		qcom,mdss-pan-physical-width-dimension = <59>;
		qcom,mdss-pan-physical-height-dimension = <104>;

		cm,mdss-livedisplay-cabc-cmd = [15 01 00 00 10 00 02 55 00];
		cm,mdss-livedisplay-cabc-ui-value = <0x01>;
		cm,mdss-livedisplay-cabc-image-value = <0x02>;
		cm,mdss-livedisplay-cabc-video-value = <0x03>;
	};
};
