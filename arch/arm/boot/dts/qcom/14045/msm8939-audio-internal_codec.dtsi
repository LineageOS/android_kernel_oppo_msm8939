/* Copyright (c) 2014-2015, The Linux Foundation. All rights reserved.
 *
 * This program is free software; you can redistribute it and/or modify
 * it under the terms of the GNU General Public License version 2 and
 * only version 2 as published by the Free Software Foundation.
 *
 * This program is distributed in the hope that it will be useful,
 * but WITHOUT ANY WARRANTY; without even the implied warranty of
 * MERCHANTABILITY or FITNESS FOR A PARTICULAR PURPOSE.  See the
 * GNU General Public License for more details.
 */

#include "../msm8939-audio-internal_codec.dtsi"

&soc {
	sound {
		qcom,msm-snd-card-id = <3>;
		qcom,msm-ext-pa = "secondary", "quaternary";
		qcom,msm-mbhc-hphl-swh = <1>;
		qcom,msm-hs-micbias-type = "external";
		qcom,msm-micbias2-ext-cap;
		qcom,audio-routing =
			"RX_BIAS", "MCLK",
			"SPK_RX_BIAS", "MCLK",
			"INT_LDO_H", "MCLK",
			"MIC BIAS External", "Handset Mic",
			"MIC BIAS External2", "Headset Mic",
			"MIC BIAS External", "Secondary Mic",
			"AMIC1", "MIC BIAS External",
			"AMIC2", "MIC BIAS External2",
			"AMIC3", "MIC BIAS External",
			"DMIC1", "MIC BIAS Internal1",
			"MIC BIAS Internal1", "Digital Mic1",
			"DMIC2", "MIC BIAS Internal1",
			"MIC BIAS Internal1", "Digital Mic2";
		pinctrl-names = "cdc_lines_act",
				"cdc_lines_sus",
				"cdc_lines_quat_sec_ext_act",
				"cdc_lines_quat_sec_ext_sus";
		pinctrl-2 = <&cdc_pdm_lines_act &cdc_ext_pa_act
				&cdc_ext_pa_ws_act &ext_cdc_tlmm_lines_act
				&mclk_lines_act>;
		pinctrl-3 = <&cdc_pdm_lines_sus &cdc_ext_pa_sus
				&cdc_ext_pa_ws_sus &ext_cdc_tlmm_lines_sus
				&mclk_lines_sus>;
		/delete-property/ qcom,cdc-us-euro-gpios;
	};
};
