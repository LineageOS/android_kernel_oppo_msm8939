## drivers/input/touchscreen/gt1x/Kconfig
```kconfig
#ifdef VENDOR_EDIT
#Added by Tong.han@Bsp.group.Tp for gt1x_ic driver,2015-01-21 
config GT1X_OPPO
#	default y
	bool "TP gt1x_ic enable or not for OPPO"
	---help---
	say Y to enable driver for Touchpanel useing gt1x_ic
#endif
```

## drivers/input/touchscreen/synaptics_oppo/Kconfig
```kconfig
config TOUCHSCREEN_SYNAPTICS_OPPO
	bool "Synaptics touchscreen (OPPO variant)"
	help
	  Say Y here if you have a Synaptics touchscreen connected
	  to your system (OPPO variant).

	  If unsure, say N.
```

## drivers/misc/remote/Kconfig
```kconfig
config UEI
	bool "enable or disable uei remote"
	help
		say y to support uei remote
```

## drivers/platform/oppo/Kconfig
```kconfig
# OPPO configuration options

config MACH_OPPO
	bool "OPPO device"
	depends on ARCH_MSM
	help
	  Support for OPPO products

config MACH_OPPO_MSM8939
	bool "OPPO MSM8939"
	depends on ARCH_MSM8916
	select MACH_OPPO
	help
	  Support for MSM8939 OPPO variants

menu "OPPO board selection"

config MACH_14005
	bool "R5/R5s board"
	select MACH_OPPO_MSM8939
	select SND_SOC_TFA9890
	help
	  Support for the R5/R5s variants

config MACH_15011
	bool "R7f board"
	select MACH_OPPO_MSM8939
	select SND_SOC_AK4375
	select SND_SOC_TFA9890
	help
	  Support for the R7f variant

config MACH_15018
	bool "R7plusf board"
	select MACH_OPPO_MSM8939
	select SND_SOC_AK4375
	select SND_SOC_TFA9890
	help
	  Support for the R7plusf variant

config MACH_15022
	bool "R7sf board"
	select MACH_OPPO_MSM8939
	select SND_SOC_AK4375
	select SND_SOC_TFA9890
	help
	  Support for the R7sf variant

config MACH_15109
	bool "F1f board"
	select MACH_OPPO_MSM8939
	select SND_SOC_TS4621
	help
	  Support for the F1f variant

endmenu
```

## drivers/sensors/Kconfig
```kconfig
config SENSORS
	bool "Sensors Class Support"
	help
	  This option enables the sensor sysfs class in /sys/class/sensors.
	  You'll need this to do anything useful with sensorss. If unsure, say N.

config SENSORS_SSC
	bool "Enable Sensors Driver Support for SSC"
	help
	  Add support for sensors SSC driver.
	  This driver is used for exercising sensors use case,
	  time syncing with ADSP clock.

config SENSORS_OPPO_FTM
	bool "OPPO sensor calibration interface"
	default y if MACH_OPPO
	help
	  This option enables the OPPO sensor calibration interface
```

## drivers/soc/oppo/Kconfig
```kconfig
menu "OPPO specific options"

config OPPO_DEVICE_INFO
	bool "OPPO device info driver"
	default y if MACH_OPPO
	help
	  Say Y to enable OPPO device info driver

endmenu
```
